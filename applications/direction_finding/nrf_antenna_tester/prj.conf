## CMakeLists.txt
```
# SPDX-License-Identifier: Apache-2.0

cmake_minimum_required(VERSION 3.13.1)
include($ENV{ZEPHYR_BASE}/cmake/app/boilerplate.cmake NO_POLICY_SCOPE)
project("nrf_ant_tester" VERSION 0.1)

set(NRF_SUPPORTED_BUILD_TYPES
  ZDebug
  ZRelease
  )

if (NOT CMAKE_BUILD_TYPE)
  set(CMAKE_BUILD_TYPE ZDebug)
endif()

zephyr_compile_definitions(
   ARM_MATH_CM4
)

zephyr_include_directories(
    .
 )

target_sources(app PRIVATE src/main.c
	src/if.c
	src/protocol.c
	src/ble.c
	src/dfe_local_config.c
)

target_include_directories(app PRIVATE $ENV{ZEPHYR_BASE}/samples/bluetooth)
target_include_directories(app PRIVATE $ENV{ZEPHYR_BASE}/subsys/bluetooth/controller)
```

## Kconfig
```
#
# Copyright (c) 2020 Nordic Semiconductor ASA
#
# SPDX-License-Identifier: LicenseRef-BSD-5-Clause-Nordic
#

menu "nRF Antenna Tester"

config AOA_LOCATOR_UART_PORT
	string "Name of the UART port"
	default "UART_0"

config AOA_LOCATOR_DATA_SEND_WAIT_MS
	int "Number of miliseconds to wait after data is sent over UART."
	default 40
	range 1 100
	help
		The time to wait after a data packet is send.
		It is here because of the PC tool limitations,
		to give it a time for data processing before sending next packet.

config ANT_TEST_WAIT_TIME_FOR_CTE_MS
	int "Number of miliseconds to wait for CTE arrival."
	default 1000
	range 1 5000

config ANT_TEST_NUMBER_OF_CTE_TO_COLLECT
	int "Number of CTE packages to be collected for single antenna"
	default 1
	range 1 10
	help
	  Number of CTE packets to be collected for single patch antenna
	  testing purposes.

config ANT_TEST_PHASE_OFFSET_DEVIATION_RANGE_DEG
	int "Maximum deviation of a phase offset between samples"
	default 5
	range 1 10
	help
	  Maximum deviation of a phase offset between consecutive
	  samples. The unit is degree. 
	
module = DF_APP
module-str = Direction Finding
source "subsys/logging/Kconfig.template.log_config"

endmenu

menu "Zephyr Kernel"
source "$ZEPHYR_BASE/Kconfig.zephyr"
endmenu
```

## prj.conf
```kconfig
# General Kernel Options
CONFIG_MAIN_STACK_SIZE=2048
CONFIG_HEAP_MEM_POOL_SIZE=2048
CONFIG_SYSTEM_WORKQUEUE_STACK_SIZE=2048
CONFIG_NEWLIB_LIBC=y
CONFIG_DEBUG=y
CONFIG_DEBUG_OPTIMIZATIONS=y

# BT options
CONFIG_BT=y
CONFIG_BT_OBSERVER=y
CONFIG_BT_DEBUG_LOG=y
CONFIG_BT_CTLR=y
CONFIG_BT_CTLR_DF_SUBSYSTEM=y

# Uart driver and UART configuration
CONFIG_SERIAL=y
CONFIG_UART_NRFX=y
CONFIG_UART_INTERRUPT_DRIVEN=y

# Enable the Direction finding subsystem
CONFIG_BT_CTLR_DF_SUBSYSTEM=y
# Enable receive of CTE(DFE) extension by Bluetooth stack
CONFIG_BT_CTLR_DFE_RX=y
# Set length of CTE
CONFIG_BT_CTLR_DFE_NUMBER_OF_8US=5
# Set antennas switching time
CONFIG_BT_CTLR_DFE_SWITCH_SPACING_2US=y
# Enable regular sampling configuration
CONFIG_BT_CTLR_DFE_SAMPLE_SPACING_250NS=y
CONFIG_BT_CTLR_DFE_SAMPLE_SPACING_REF_250NS=y

# Enable logging
CONFIG_LOG=y
CONFIG_LOG_MODE_OVERFLOW=y
CONFIG_LOG_BUFFER_SIZE=4096
CONFIG_LOG_STRDUP_BUF_COUNT=16
CONFIG_LOG_STRDUP_MAX_STRING=256
CONFIG_LOG_PRINTK=y

#CONFIG_LOG_BACKEND_RTT=y

CONFIG_USE_SEGGER_RTT=y
CONFIG_RTT_CONSOLE=y
CONFIG_UART_CONSOLE=n
CONFIG_SEGGER_RTT_BUFFER_SIZE_UP=4096

#enable RTT shell
CONFIG_SHELL=y
CONFIG_SHELL_BACKEND_SERIAL=n
CONFIG_SHELL_BACKEND_RTT=y
CONFIG_SHELL_PROMPT_RTT="nrf-ant-tester:~$ "
```

## src/main.c
```c
/*
 * Copyright (c) 2020 Nordic Semiconductor ASA
 *
 * SPDX-License-Identifier: LicenseRef-BSD-5-Clause-Nordic
 */

#include <assert.h>
#include <string.h>

#include <stdlib.h>
#include <kernel.h>
#include <zephyr/types.h>
#include <bluetooth/dfe_data.h>
#include <shell/shell.h>
#include <shell/shell_rtt.h>

#include "if.h"
#include "protocol.h"
#include "dfe_local_config.h"
#include "ble.h"
#include "antenna_test.h"

#define MODULE df_main
#include <logging/log.h>
LOG_MODULE_REGISTER(MODULE, CONFIG_DF_APP_LOG_LEVEL);

/** @brief Number of ms to wait for a data before printing no data note
 */
#define WAIT_FOR_DATA_BEFORE_PRINT (1000)

/** @brief Shell command handler responsible for antenna testing procedure
 *
 * The command handler accepts single argument that is verbosity.
 * Allowed verbosity levels are in range: @ref TEST_VERBOSITY_LOW to
 * @ref TEST_VERBOSITY_HIGH.
 *
 * @param[in] shell	pointer to shell object
 * @param[in] argc	number of command arguments
 * @param[in] argv	array providing command arguments
 *
 * @retval	0 always return zero
 */
static int start_test(const struct shell *shell, size_t argc, const char **argv)
{
	int verbosity = 1;

	if(argc > 1) {
		int user_verbosity = atoi(argv[1]);
		if (user_verbosity >= TEST_VERBOSITY_LOW &&
			user_verbosity <= TEST_VERBOSITY_HIGH) {
			verbosity = user_verbosity;
		} else {
			shell_print(shell, "Error, verbosity level out of range: %d",
						user_verbosity);
		}
	}

	shell_print(shell, "Antenna matrix test started");

	int err = run_antenna_test_suite(verbosity);

	if(err) {
		shell_print(shell, "Antenna matrix test FAILED");
	}

	shell_print(shell, "Antenna matrix test SUCCESS");

	return 0;
}

SHELL_CMD_ARG_REGISTER(test, NULL, "Start antennas test. Optionally accepts " \
					   "verbosity level 1-3.", start_test, 0, 1);

/** @brief Main function of the test example.
 *
 */
void main(void)
{
	LOG_INF("Starting AoA Locator CL!");
	/* initialize UART interface to provide I/Q samples */
	struct if_data* iface = if_initialization();

	if (iface == NULL) {
		LOG_ERR("Locator stopped!");
		return;
	}

	int err;

	err = protocol_initialization(iface);
	if (err) {
		LOG_ERR("Locator stopped!");
		return;
	}

	LOG_INF("Initialize Bluetooth");
	ble_initialization();

	 while(1)
	 {
	 	k_sleep(K_MSEC(CONFIG_AOA_LOCATOR_DATA_SEND_WAIT_MS));
	 }

	LOG_INF("nRF antenna tester End");
}
```

## src/antenna_test.c
```c
/*
 * Copyright (c) 2020 Nordic Semiconductor ASA
 *
 * SPDX-License-Identifier: LicenseRef-BSD-5-Clause-Nordic
 */
#include <string.h>
#include <assert.h>
#include <kernel.h>
#include <stdio.h>

#include "antenna_test.h"
#include "protocol.h"
#include "ble.h"
#include "dfe_local_config.h"
#include "dfe_samples_data.h"
#include "iq_samples_statistics.h"

/** @brief The highest antenna number that may be set for test */
#define ANT_TEST_MAX_ANT_NUMBER 12
/** @brief Value set in I or Q if over-saturation detected by radio */
#define IQ_OVERSATURATION_VAL (-32768)
/** @brief Frequency of a constant tone */
#define CTE_FREQUENCY_HZ 250000

#define MODULE ant_test
#include <logging/log.h>
LOG_MODULE_REGISTER(MODULE, CONFIG_DF_APP_LOG_LEVEL);

/** @brief Queue defined by BLE Controller to provide IQ samples data
 */
extern struct k_msgq df_packet_msgq;

/** @brief Initializes radio to run DFE
 *
 * @param[in]	sampl_conf pointer to sampling configuration
 * @param[in]	ant_conf pointer to antennas configuration
 *
 * @return 0 DFE was initialized successfully, non-zero value otherwise
 */
static int initlialize_dfe(const struct dfe_sampling_config* sampl_conf,
			   const struct dfe_antenna_config* ant_conf);

/** @brief Send IQ data
 *
 * @param[in] mapped_data	Pointer to IQ samples mapped to antennas
 * @param[in] sampl_conf	Pointer to sampling configuration
 *
 * return 0 if samples were sent successfully, other value means error
 */
static int send_iq_data(const struct dfe_mapped_packet *mapped_data,
			const struct dfe_sampling_config* sampl_conf);

/** @brief Collects IQ samples from Bluetooth controller
 *
 * Collects IQ samples and maps them to antennas numbers.
 *
 * @param[out] mapped_data	Pointer where to store IQ samples
 * 				mapped to antenna number
 * @param[in] ampl_conf		Pointer to sampling configuration
 * @param[in] ant_conf		Pointer to antenna configuration
 *
 * @retval 0	If samples were collected successfully
 * @retval -1	Timeout, no data were collected
 */
static int collect_iq_samples(struct dfe_mapped_packet *mapped_data,
			      const struct dfe_sampling_config* sampl_conf,
			      const struct dfe_antenna_config* ant_conf);

/** @brief Checks if any of IQ samples pairs is zero.
 *
 * Any samples (I,Q) should not hold zeroes.
 * If that happened it would mean there is no signal
 * because magnitude is zero.
 *
 * @param[in] mapped_data	Pointer to IQ samples mapped to antennas
 * @param[in] verbosity		Level of test log verbosity
 *
 * @return true if test finished successfully, false otherwise
 */
static bool test_are_iq_data_not_zeros(const struct dfe_mapped_packet *mapped_data,
				      enum test_verbosity_level verbosity)
{
	LOG_DBG("Test IQ data are not zeros started");

	int zeros_count = 0;
	int samples_tested = mapped_data->ref_data.samples_num;

	if (verbosity >= TEST_VERBOSITY_MED) {
		protocol_send_msg("[TEST] Check if IQ data are zeros:\r\n");
	}
	/* Check reference period */
	const struct dfe_ref_samples *ref_data = &mapped_data->ref_data;
	for(int idx = 0; idx < ref_data->samples_num; ++idx) {
		if (ref_data->data[idx].i == 0 &&
			ref_data->data[idx].q == 0) {
			++zeros_count;
			if(verbosity >= TEST_VERBOSITY_HIGH) {
				protocol_send_msg("\tSample: %d : I=%.3f, Q=%.3f ", idx,
						  ref_data->data[idx].i, ref_data->data[idx].q);
			}
		}
	}

	size_t index;
	/* Check regular samples */
	const struct dfe_samples *samples_data = &mapped_data->sampl_data[0];
	for(int idx = 0; idx < mapped_data->header.length; ++idx) {
		index = idx * samples_data->samples_num;
		const union dfe_iq_f *iq = &samples_data[idx].data[0];
		for(int iq_idx = 0; iq_idx < samples_data->samples_num; ++iq_idx) {
			if (iq[iq_idx].i == 0.0 && iq[iq_idx].q == 0.0) {
				++zeros_count;
				if(verbosity >= TEST_VERBOSITY_HIGH) {
					protocol_send_msg("\tSample: %d : I=%.3f, Q=%.3f ", index + iq_idx,
							 ref_data->data[idx].i, ref_data->data[idx].q);
				}
			}
		}
		samples_tested += samples_data->samples_num;
	}

	/* send summary */
	if (verbosity >= TEST_VERBOSITY_MED) {
		protocol_send_msg("\tNumber of samples tested: %d\r\n", samples_tested);
		protocol_send_msg("\tNumber of samples with zeros: %d\r\n", zeros_count);
	}
	if (zeros_count) {
		protocol_send_msg("\tTest FAILED\r\n");
	} else {
		protocol_send_msg("\tTest SUCCESS\r\n");
	}

	LOG_DBG("Test IQ data are not zeros finished");
	return (zeros_count == 0); //!< no zeros found mean success
}

/** @brief Checks if any of IQ samples holds over saturation information.
 *
 * Any samples pair should not hold value -32768 in I and Q data.
 * That means over saturation. If single value of pair I and Q has such value
 * there is something very wrong.
 *
 * @param[in] mapped_data	Pointer to IQ samples mapped to antennas
 * @param[in] verbosity		Level of test log verbosity
 *
 * @return 0 if test finished successfully, not zero otherwise
 */
static int test_are_iq_data_oversaturated(const struct dfe_mapped_packet *mapped_data,
					  enum test_verbosity_level verbosity)
{
	LOG_DBG("Test IQ data are not zeros started");

	int over_sat_count = 0;
	int samples_tested = mapped_data->ref_data.samples_num;

	protocol_send_msg("[TEST] Check if IQ data are over saturated:\r\n");

	/* Check reference period */
	const struct dfe_ref_samples *ref_data = &mapped_data->ref_data;
	for(int idx = 0; idx < ref_data->samples_num; ++idx) {
		if (ref_data->data[idx].i == IQ_OVERSATURATION_VAL &&
			ref_data->data[idx].q == IQ_OVERSATURATION_VAL) {
			++over_sat_count;
			if (verbosity >= TEST_VERBOSITY_HIGH) {
					protocol_send_msg("\tOversaturation in sample: %d \r\n", idx);
				}
		} else if ((ref_data->data[idx].i == IQ_OVERSATURATION_VAL ||
			    ref_data->data[idx].q == IQ_OVERSATURATION_VAL)) {
			if (verbosity >= TEST_VERBOSITY_HIGH) {
				protocol_send_msg("\tCorrupted sample: %d {I,Q}: {%f,  %f}\r\n",
						  idx, ref_data->data[idx].i, ref_data->data[idx].q);
			}
		}
	}

	/* Check regular samples */
	const struct dfe_samples *samples_data = &mapped_data->sampl_data[0];
	for(int idx = 0; idx < mapped_data->header.length; ++idx) {
		const union dfe_iq_f *iq = &samples_data[idx].data[0];
		for(int iq_idx = 0; iq_idx < samples_data->samples_num; ++iq_idx) {
			if (iq[idx].i == IQ_OVERSATURATION_VAL &&
				iq[idx].q == IQ_OVERSATURATION_VAL) {
				++over_sat_count;
				if (verbosity >= TEST_VERBOSITY_HIGH) {
					protocol_send_msg("\tOversaturation in sample: %d \r\n",
							  (idx * samples_data->samples_num + idx));
				}
			} else if ((iq[idx].i == IQ_OVERSATURATION_VAL ||
					   iq[idx].q == IQ_OVERSATURATION_VAL)) {
				if (verbosity >= TEST_VERBOSITY_HIGH) {
					protocol_send_msg("\tCorrupted sample: %d {I,Q}: {%f,  %f}\r\n",
							  (idx * samples_data->samples_num + idx),
							  iq[idx].i, iq[idx].q);
				}
			}
		}
		samples_tested += samples_data->samples_num;
	}

	/* send summary */
	if (verbosity >= TEST_VERBOSITY_MED) {
		protocol_send_msg("\tNumber of samples tested: %d\r\n", samples_tested);
		protocol_send_msg("\tNumber of over saturated samples: %d\r\n", over_sat_count);
	}
	if (over_sat_count) {
		protocol_send_msg("\tTest FAILED\r\n");
	} else {
		protocol_send_msg("\tTest SUCCESS\r\n");
	}

	LOG_DBG("Test IQ data are not zeros finished");
	return (over_sat_count == 0); //!< No over saturated samples found means success
}


/** @brief Check if IQ samples collected after reference are out of error
 * range.
 *
 * Evaluates phase value change of phase between consecutive samples.
 * The change is compared with expected phase, the difference should be in
 * provided range (-phase_range, phase_range).
 *
 * @param[in] mapped_data		Pointer to IQ samples mapped to antennas
 * @param[in] phase_range_deg	Range to be checked if phase is in between
 * @param[in] expected_phase_change	Value of expected phase change between
 * 					consecutive samples
 * @param[in] verbosity			Level of test log verbosity
 *
 * @return true if test finished successfully, false otherwise
 */
static bool test_if_phase_offset_in_error_range(const struct dfe_mapped_packet *mapped_data,
					       const struct dfe_sampling_config* sampl_conf,
					       float phase_range_deg,
					       float expected_phase_change,
					       enum test_verbosity_level verbosity)
{
	LOG_DBG("Test if phase offset between samples is in range");

	const union dfe_iq_f *iq1;
	float phase1;
	float phase2;
	float phase_diff;
	float diff_from_expected;
	size_t index;
	bool out_of_range;
	size_t samples_out_of_range = 0;
	size_t sampl_num;

	protocol_send_msg("[TEST]  Check if phase offset between samples is in range:\r\n");

	/* Check sample offset from average */
	const struct dfe_samples *samples_data = &mapped_data->sampl_data[0];
	for(int idx = 0; idx < mapped_data->header.length; ++idx) {
		iq1 = &samples_data[idx].data[0];
		index = idx * samples_data->samples_num;

		if (idx == mapped_data->header.length-1) {
			sampl_num = samples_data->samples_num -1;
		} else {
			sampl_num = samples_data->samples_num;
		}
		for(int iq_idx = 0; iq_idx < sampl_num; ++iq_idx) {
			out_of_range = false;
			phase1 = eval_sample_phase(iq1[iq_idx]);

			if(iq_idx >= samples_data->samples_num-1) {
				iq1 = &samples_data[idx+1].data[0];
				phase2 = eval_sample_phase(iq1[0]);
			} else {
				phase2 = eval_sample_phase(iq1[iq_idx+1]);
			}

			phase_diff = phase2 - phase1;
			phase_diff = wrapp_phase_around_pi(phase_diff);
			diff_from_expected = fabs(phase_diff - expected_phase_change);

			phase_diff = rad_to_deg(phase_diff);
			diff_from_expected = rad_to_deg(diff_from_expected);

			if( diff_from_expected > phase_range_deg) {
				out_of_range = true;
				samples_out_of_range++;
			}

			if(verbosity >= TEST_VERBOSITY_HIGH) {
				protocol_send_msg("\tSample: %d phase1: %.3f, phase2: %.3f , abs. diff. %.3f, diff. from expected: %.3f. allowed abs. diff.: %.3f ",
						  (index + iq_idx), rad_to_deg(phase1), rad_to_deg(phase2), phase_diff, diff_from_expected, phase_range_deg);
				if (out_of_range) {
					protocol_send_msg("Sample FAILED. \r\n");
				} else {
					protocol_send_msg("Sample CORRECT. \r\n");
				}
			}
		}
	}

	if (verbosity >= TEST_VERBOSITY_MED) {
		protocol_send_msg("\tTested samples: %d\r\n", (mapped_data->header.length * mapped_data->sampl_data[0].samples_num) - 1);
		protocol_send_msg("\tTested failed: %d\r\n", samples_out_of_range);
	}
	if (samples_out_of_range != 0) {
			protocol_send_msg("\tTest FAILED\r\n");
	} else {
		protocol_send_msg("\tTest SUCCESS\r\n");
	}

	return (samples_out_of_range == 0);
}

/** @brief Evaluates magnitude of IQ samples collected after
 * reference period.
 *
 * @param[in] mapped_data	Pointer to IQ samples mapped to antennas
 * @param[in] verbosity		Level of test log verbosity
 *
 */
static void stat_evaluate_magnitude_of_samples(const struct dfe_mapped_packet *mapped_data,
					     enum test_verbosity_level verbosity)
{
	LOG_DBG("Test if phase offset between samples is in range");

	const union dfe_iq_f *iq1;
	float magnitude;
	size_t index;

	if(verbosity >= TEST_VERBOSITY_HIGH) {
		protocol_send_msg("[STAT]  Evaluate samples magnitude:\r\n");
	}

	/* Check sample offset from average */
	const struct dfe_samples *samples_data = &mapped_data->sampl_data[0];
	for(int idx = 0; idx < mapped_data->header.length; ++idx) {
		iq1 = &samples_data[idx].data[0];
		index = idx * samples_data->samples_num;

		for(int iq_idx = 0; iq_idx < samples_data->samples_num; ++iq_idx) {
			magnitude = eval_sample_magnitude(iq1[iq_idx]);
			if(verbosity >= TEST_VERBOSITY_HIGH) {
				protocol_send_msg("\tSample: %d magnitude: %.3f \r\n",
						  (index + iq_idx), magnitude);
			}
		}
	}
}

/** @brief Antenna test procedure
 *
 * Test procedure is run for single antenna.
 * It is run number of times provided by @p number_of_cte_to_analyze.
 *
 * @param[in] antenna_num		Number of antenna to test
 * @param[in] number_of_cte_to_analyze	Number of CTE to be collected and tested
 * @param[in] verbosity			Level of test log verbosity
 *
 * @return true if test finished successfully, false otherwise
 */
static bool test_antenna(u8_t antenna_num, u8_t number_of_cte_to_analyze,
			enum test_verbosity_level verbosity)
{
	assert(antenna_num != 0);
	assert(antenna_num <= ANT_TEST_MAX_ANT_NUMBER);

	int err;
	bool test_result = true;
	const struct dfe_sampling_config* sampl_conf = NULL;
	const struct dfe_antenna_config* ant_conf = NULL;

	sampl_conf = dfe_get_sampling_config();
	ant_conf = dfe_get_antenna_config();

	dfe_set_single_antenna_for_whole_cte(antenna_num);
	err = initlialize_dfe(sampl_conf, ant_conf);
	if (err) {
		LOG_ERR("Error while DFE initialization: %d", err);
		return false;
	}
	err = bt_start_scanning();
	if (err) {
		return false;
	}

	static struct dfe_mapped_packet df_mapped_data;
	u16_t samples_spacing_ns = dfe_get_sample_spacing_ref_ns(sampl_conf->sample_spacing_ref);

	float avg_phase_off_sampl;
	float avg_phase_off_periods;
	float avg_magnitude;
	float expected_phase_diff;

	expected_phase_diff= get_expected_phase_offset(CTE_FREQUENCY_HZ, samples_spacing_ns);

	memset(&df_mapped_data, 0, sizeof(df_mapped_data));

	for( u8_t idx = 0; idx < number_of_cte_to_analyze; ++idx) {
		err = collect_iq_samples(&df_mapped_data, sampl_conf, ant_conf);
		if (err) {
			LOG_ERR("Error while collecting IQ data, CTE numb: %d", idx);
			return false;
		}

		evaluate_stats_in_ref(&df_mapped_data.ref_data, sampl_conf,
				      CTE_FREQUENCY_HZ,
				      &avg_phase_off_sampl, &avg_phase_off_periods,
				      &avg_magnitude);
		protocol_send_msg("[STAT] Reference statistics:\r\n");
		if (verbosity >= TEST_VERBOSITY_MED) {
			protocol_send_msg("\tAvg. phase offset between samples [deg]: %.3f \r\n", avg_phase_off_sampl);
			protocol_send_msg("\tAvg. phase offset between periods [deg]: %.3f \r\n", avg_phase_off_periods);
			protocol_send_msg("\tAvg. magnitude: %.3f \r\n", avg_magnitude);
		}
		if (!test_are_iq_data_not_zeros(&df_mapped_data, verbosity)) {
			test_result = false;
		}
		if (!test_are_iq_data_oversaturated(&df_mapped_data, verbosity)) {
			test_result = false;
		}
		if (!test_if_phase_offset_in_error_range(&df_mapped_data, sampl_conf,
						(float)CONFIG_ANT_TEST_PHASE_OFFSET_DEVIATION_RANGE_DEG,
						    expected_phase_diff, verbosity)) {
			test_result = false;
		}
		stat_evaluate_magnitude_of_samples(&df_mapped_data, verbosity);

		if (verbosity >= TEST_VERBOSITY_HIGH) {
			protocol_send_msg("[STAT] Raw data:\r\n");
			err = send_iq_data(&df_mapped_data, sampl_conf);
			if (err) {
				LOG_ERR("Error while collecting IQ data, CTE numb: %d", idx);
				return false;
			}
		}
	}

	err = bt_stop_scanning();
	if (err) {
		return false;
	}

	return test_result;
}

bool run_antenna_test_suite(enum test_verbosity_level verbosity)
{
	bool result;
	bool global_result = true;
	bool ant_test_results[ANT_TEST_MAX_ANT_NUMBER];

	protocol_send_msg("[TEST] Start antennas matrix test\r\n");

	for (int ant_idx = 1; ant_idx <= ANT_TEST_MAX_ANT_NUMBER; ++ant_idx) {
		protocol_send_msg("[TEST] Antenna %d test START.\r\n", ant_idx);
		result = test_antenna(ant_idx, CONFIG_ANT_TEST_NUMBER_OF_CTE_TO_COLLECT, verbosity);
		if (!result) {
			protocol_send_msg("[TEST] Antenna %d test FILED. Error: %d\r\n", ant_idx, result);
		} else {
			protocol_send_msg("[TEST] Antenna %d test SUCCSESS\r\n", ant_idx);
		}
		ant_test_results[ant_idx-1] = result;
	}

	protocol_send_msg("[SUMMARY]\r\n");
	for (int ant_idx = 0; ant_idx < ANT_TEST_MAX_ANT_NUMBER; ++ant_idx) {
		if (!ant_test_results[ant_idx]) {
			protocol_send_msg("[TEST] Antenna %d test FILED.\r\n", ant_idx+1);
			global_result = false;
		} else {
			protocol_send_msg("[TEST] Antenna %d test SUCCSESS\r\n", ant_idx+1);
		}
	}
	protocol_send_msg("[TEST] End antennas matrix test\r\n");

	return global_result;
}

/****************************************************************************
 * Helper functions for setup and reporting
 ****************************************************************************/
static int initlialize_dfe(const struct dfe_sampling_config* sampl_conf,
			   const struct dfe_antenna_config* ant_conf)
{
	const struct dfe_ant_gpio* ant_gpio = NULL;
	u8_t ant_gpio_len = 0;

	ant_gpio_len = dfe_get_ant_gpios_config_len();
	ant_gpio = dfe_get_ant_gpios_config();

	LOG_DBG("Initialize DFE");
	int err = dfe_init(sampl_conf, ant_conf, ant_gpio, ant_gpio_len);

	if (err) {
		LOG_ERR("Locator stopped!");
		return err;
	}

	return 0;
}

static int collect_iq_samples(struct dfe_mapped_packet *mapped_data,
			      const struct dfe_sampling_config* sampl_conf,
			      const struct dfe_antenna_config* ant_conf)
{
	assert( mapped_data != NULL);

	struct dfe_packet df_data_packet;
	memset(&df_data_packet, 0, sizeof(df_data_packet));

	k_msgq_get(&df_packet_msgq, &df_data_packet,
		   K_MSEC(CONFIG_ANT_TEST_WAIT_TIME_FOR_CTE_MS));
	if (df_data_packet.hdr.length == 0) {
		LOG_DBG("No data received.");
		return -1;
	}

	LOG_DBG("Data arrived...");

	dfe_map_iq_samples_to_antennas(mapped_data, &df_data_packet, sampl_conf,
				       ant_conf);
	return  0;
}

static int send_iq_data(const struct dfe_mapped_packet *mapped_data,
			const struct dfe_sampling_config* sampl_conf)
{
	int err = protocol_handling(sampl_conf, mapped_data);

	if (err) {
		LOG_ERR("Error in protocol handling!");
		LOG_ERR("Locator stopped!");
		protocol_send_msg("[TEST] Test failed\r\n");
		return err;
	}
	return 0;
}
```

## src/antenna_test.h
```c
/*
 * Copyright (c) 2020 Nordic Semiconductor ASA
 *
 * SPDX-License-Identifier: LicenseRef-BSD-5-Clause-Nordic
 */

#ifndef DF_ANTENNA_TEST_H_
#define DF_ANTENNA_TEST_H_

/** @brief Verbosity level of test output */
enum test_verbosity_level {
	/** Log most important information as success, fail */
	TEST_VERBOSITY_LOW = 1,
	/** Log information about test substeps evaluation results for */
	TEST_VERBOSITY_MED,
	/** Log detailed information for every tested IQ sample */
	TEST_VERBOSITY_HIGH
};

/* @brief Run antenna tests suite
 *
 * @param[in] verbosity level of test log verbosity
 *
 * @return 0 if test successful, otherwise a (negative) error code.
 */
int run_antenna_test_suite(enum test_verbosity_level verbosity);

#endif /* DF_ANTENNA_TEST_H_ */
```

## src/ble.c
```c
/*
 * Copyright (c) 2020 Nordic Semiconductor ASA
 *
 * SPDX-License-Identifier: LicenseRef-BSD-5-Clause-Nordic
 */

#include <misc/printk.h>
#include <bluetooth/bluetooth.h>
#include <bluetooth/hci.h>

#include "ble.h"

#define MODULE df_ble
#include <logging/log.h>
LOG_MODULE_REGISTER(MODULE, CONFIG_DF_APP_LOG_LEVEL);

int ble_initialization(void)
{
	LOG_INF("Initialization started");

	int err = bt_enable(NULL);

	if (err)
	{
		LOG_ERR("Initialization failed (err %d)", err);
	}

	return err;
}


int bt_start_scanning()
{
	struct bt_le_scan_param scan_param = {
		.type       = BT_HCI_LE_SCAN_PASSIVE,
		.filter_dup = BT_HCI_LE_SCAN_FILTER_DUP_DISABLE,
		.interval   = 0x0020,
		.window     = 0x0020,
	};
	int err;

	err = bt_le_scan_start(&scan_param, NULL);
	if (err && err != -EALREADY)
	{
		LOG_ERR("Start scanning failed (err %d)", err);

	}
	return err;
}

int bt_stop_scanning()
{
	int err = bt_le_scan_stop();

	if (err && err != -EALREADY)
	{
		LOG_ERR("Stop scanning failed (err %d)", err);

	}

	return err;
}
```

## src/ble.h
```c
/*
 * Copyright (c) 2020 Nordic Semiconductor ASA
 *
 * SPDX-License-Identifier: LicenseRef-BSD-5-Clause-Nordic
 */


#ifndef __BLE_H
#define __BLE_H

/** @brief Initialize Bluetooth stack and starts scanning
 */
int ble_initialization();

/** @brief Starts Bluetooth scanning
 *
 * @return 0 if success, otherwise a (negative) error code.
 */
int bt_start_scanning();

/** @brief Stops Bluetooth scanning
 *
 * @return 0 if success, otherwise a (negative) error code.
 */
int bt_stop_scanning();

#endif
```

## src/dfe_local_config.c
```c
/*
 * Copyright (c) 2020 Nordic Semiconductor ASA
 *
 * SPDX-License-Identifier: LicenseRef-BSD-5-Clause-Nordic
 */

#include <stddef.h>
#include <stdbool.h>
#include <assert.h>
#include <zephyr/types.h>
#include <kernel.h>
#include <nrf.h>

#include "dfe_local_config.h"

#define MODULE df_config
#include <logging/log.h>
LOG_MODULE_REGISTER(MODULE, CONFIG_DF_APP_LOG_LEVEL);

const static struct dfe_sampling_config g_sampl_config = {
	.dfe_mode = RADIO_DFEMODE_DFEOPMODE_AoA,
	.start_of_sampl = RADIO_DFECTRL1_DFEINEXTENSION_CRC,
	.number_of_8us = CONFIG_BT_CTLR_DFE_NUMBER_OF_8US,
	.en_sampling_on_crc_error = false,
	.dfe_trigger_task_only = true,
	.sampling_type = RADIO_DFECTRL1_SAMPLETYPE_IQ,
	.sample_spacing_ref = CONFIG_BT_CTLR_DFE_SAMPLE_SPACING_REF_VAL,
	.sample_spacing = CONFIG_BT_CTLR_DFE_SAMPLE_SPACING_VAL,
	.sample_offset = 1,
	.switch_spacing = CONFIG_BT_CTLR_DFE_SWITCH_SPACING_VAL,
	.switch_offset = 0,
	.guard_period_us = 4,
	.ref_period_us = 8,
};

static struct dfe_antenna_config g_ant_conf = {
		.ref_ant_idx = 11,
		.idle_ant_idx = 11,
		.ant_gpio_pattern = {0, 5, 6, 4, 9, 10, 8, 13, 14, 12, 1, 2, 0},
		.ant_gpio_pattern_len = 13,
		.antennae_switch_idx = {12,1,2,10,3,9,4,8,7,6,5},
		.antennae_switch_idx_len = 11,
		.gpio = {3,4,28,29},
	};

const static struct dfe_ant_gpio g_gpio_conf[4] = {
		{0, 3}, {1,4}, {2, 28}, {3,29}
};

/** @brief Creates switching pattern array
 *
 * The function converts provided antenna indices into array of
 * switch patterns that will be applied by radios DFE module to switch antennas.
 *
 * @param[in,out] array			pointer where to store patterns
 * @param[in] len				Length of @p array
 * @param[in] gpio_patterns		array of GPIO patterns
 * @param[in] gpio_patterns_len	length of @p gpio_patterns
 * @param[in] switch_array		array with antenna indices
 * @param[in] switch_array_len	length of @p switch_array
 *
 * @retval 0		switch pattern array created successfully
 * @retval -EINVAL	one of pointers is NULL or one of lengths is zero
 */
static int create_switching_pattern_array(u8_t *array, u8_t len,
		const u8_t *gpio_patterns, u8_t gpio_patterns_len,
		const u8_t *switch_array, u8_t switch_array_len);

/** @brief Evaluates duration of antenna switching period
 *
 * @param[in] sampling_conf	Sampling configuration
 *
 * @return Duration in [ns]
 */
static u32_t get_switching_duration_ns(const struct dfe_sampling_config *sampling_conf);

/** @brief Converts antenna switch spacing settings value to nanoseconds.
 *
 * @param[in] spacing	Value of antenna switching setting
 *
 * @return Sample spacing in [ns]
 */
static u16_t get_switch_spacing_ns(u8_t spacing);

/** @brief Converts antenna switch spacing settings value to nanoseconds.
 *
 * Function verifies if oversampling is enabled. That means we would receive
 * samples during antenna switching period.
 *
 * @param[in] sampling_conf	Sampling configuration
 *
 * @retval true		If oversampling is enables
 * @retval false	If oversampling is disabled
 */
static inline bool is_oversampling_enabled(const struct dfe_sampling_config *sampling_conf);

/** @brief Provides number of effective antennas used during antenna switching
 * period.
 *
 * @param[in] sampl_conf	Sampling configuration
 *
 * @return Number of antennas used to collect IQ samples except reference period
 */
static uint8_t get_effective_ant_num(const struct dfe_sampling_config *sampling_conf);

/** @brief Provides number of samples collected in single sampling slot
 *
 * @param[in] sampl_conf	Sampling configuration
 *
 * @return Number of samples collected in sampling slot
 */
static u16_t get_sampling_slot_samples_num(const struct dfe_sampling_config *sampling_conf);

const struct dfe_sampling_config* dfe_get_sampling_config()
{
	return &g_sampl_config;
}

const struct dfe_antenna_config* dfe_get_antenna_config()
{
	return &g_ant_conf;
}

const struct dfe_ant_gpio* dfe_get_ant_gpios_config()
{
	return &g_gpio_conf[0];
}

u8_t dfe_get_ant_gpios_config_len()
{
	return ARRAY_SIZE(g_gpio_conf);
}

int dfe_init(const struct dfe_sampling_config *sampl_conf,
	     const struct dfe_antenna_config *ant_conf,
	     const struct dfe_ant_gpio *ant_gpio, u8_t ant_gpio_len)
{
	assert(sampl_conf != NULL);
	assert(ant_conf != NULL);
	assert(ant_gpio != NULL);
	assert(ant_gpio_len != 0);

	int err = 0;

	err = dfe_set_mode(sampl_conf->dfe_mode);
	if (err) {
		LOG_ERR("DFE mode is unknown");
		return -EINVAL;
	}

	err = dfe_set_duration(sampl_conf->number_of_8us);
	if(err) {
		LOG_ERR("Number of 8us periods is out of allowed range!");
		return err;
	}

	err = dfe_set_start_point(sampl_conf->start_of_sampl);
	if(err) {
		LOG_ERR("DFE start point value is out of allowed range!");
		return err;
	}

	dfe_set_sample_on_crc_error(sampl_conf->en_sampling_on_crc_error);

	dfe_set_trig_dfe_start_task_only(true);

	err = dfe_set_sampling_spacing_ref(sampl_conf->sample_spacing_ref);
	if(err) {
		LOG_ERR("Reference sample spacing value is out of range!");
		return err;
	}
	err = dfe_set_sampling_type(sampl_conf->sampling_type);
	if(err) {
		LOG_ERR("Sampling type value is out of range!");
		return err;
	}
	err = dfe_set_sample_spacing(sampl_conf->sample_spacing);
	if(err) {
		LOG_ERR("Sample spacing value is out of range!");
		return err;
	}
	err = dfe_set_backoff_gain(0);
	if(err) {
		LOG_ERR("Gain backoff value is out of range!");
		return err;
	}
	err = dfe_set_switch_offset(sampl_conf->switch_offset);
	if(err) {
		LOG_ERR("Switch offset value is out of range!");
		return err;
	}
	err = dfe_set_sample_offset(sampl_conf->sample_offset);
	if(err) {
		LOG_ERR("Sampling offset value is out of range!");
		return err;
	}

	err = dfe_set_ant_switch_spacing(sampl_conf->switch_spacing);
	if(err) {
		LOG_ERR("Antenna switch spacing is out of range!");
		return err;
	}

	err = dfe_set_ant_gpios(ant_gpio, ant_gpio_len);
	if(err) {
		LOG_ERR("Number of GPIO for antennas switching is to large!");
		return err;
	}

	u8_t pattern_array[ant_conf->antennae_switch_idx_len];
	err = create_switching_pattern_array(pattern_array,
				       ant_conf->antennae_switch_idx_len,
				       ant_conf->ant_gpio_pattern,
				       ant_conf->ant_gpio_pattern_len,
				       ant_conf->antennae_switch_idx,
				       ant_conf->antennae_switch_idx_len);
	if(err) {
		LOG_ERR("Preparation of switch patterns array failed!");
		return err;
	}

	err = dfe_set_ant_gpio_patterns(ant_conf->ant_gpio_pattern[ant_conf->idle_ant_idx],
					ant_conf->ant_gpio_pattern[ant_conf->ref_ant_idx],
					pattern_array,
					ant_conf->antennae_switch_idx_len);
	if(err) {
		LOG_ERR("Initialization of gpio patterns failed!");
		return err;
	}
	return 0;
}

void dfe_map_iq_samples_to_antennas(struct dfe_mapped_packet *mapped_data,
				  const struct dfe_packet *raw_data,
				  const struct dfe_sampling_config *sampling_conf,
				  const struct dfe_antenna_config *ant_config)
{
	assert(raw_data != NULL);
	assert(mapped_data != NULL);

	u16_t ref_samples_num = dfe_get_ref_samples_num(sampling_conf);
	mapped_data->ref_data.antenna_id = ant_config->ref_ant_idx;

	for(uint16_t idx = 0; idx < ref_samples_num; ++idx) {
		mapped_data->ref_data.data[idx].i = raw_data->data[idx].iq.i;
		mapped_data->ref_data.data[idx].q = raw_data->data[idx].iq.q;
	}
	mapped_data->ref_data.samples_num = ref_samples_num;

	/* Depending on DFE duration, the number of antennas used for sample
	 * may be greater than the number of antennas in configuration.
	 * If there is time left after end of antennas sequence, then radio
	 * starts to use the same antennas again.
	 */
	u16_t effective_ant_num = get_effective_ant_num(sampling_conf);

	u8_t samples_num = get_sampling_slot_samples_num(sampling_conf);

	u8_t effective_sample_idx;

	bool oversampl = is_oversampling_enabled(sampling_conf);

	if (oversampl) {
		effective_ant_num = (effective_ant_num*2);
	}

	for(u16_t ant_idx = 0; ant_idx < effective_ant_num; ++ant_idx) {
		u8_t ant;
		struct dfe_samples *sample = &mapped_data->sampl_data[ant_idx];

		if (oversampl) {
			if (ant_idx & 0x1) {
				ant = 255;
			} else {
				u8_t idx = (ant_idx >> 1) % ant_config->antennae_switch_idx_len;
				ant = ant_config->antennae_switch_idx[idx];
			}
		} else {
			u8_t idx = ant_idx % ant_config->antennae_switch_idx_len;
			ant = ant_config->antennae_switch_idx[idx];
		}

		sample->antenna_id = ant;

		for(u8_t sample_idx = 0; sample_idx < samples_num; ++sample_idx) {
			effective_sample_idx = ref_samples_num + (ant_idx * samples_num) + sample_idx;
			sample->data[sample_idx].i = raw_data->data[effective_sample_idx].iq.i;
			sample->data[sample_idx].q = raw_data->data[effective_sample_idx].iq.q;
		}
		sample->samples_num = samples_num;
	}

	mapped_data->header.length = effective_ant_num;
	mapped_data->header.frequency = raw_data->hdr.frequency;
}


static int create_switching_pattern_array(u8_t *array, u8_t len,
					  const u8_t *gpio_patterns,
					  u8_t gpio_patterns_len,
					  const u8_t *switch_array,
					  u8_t switch_array_len)
{

	if (array == NULL || len == 0 || gpio_patterns == NULL ||
	    gpio_patterns_len == 0 || switch_array == NULL ||
	    switch_array_len == 0 || len < switch_array_len) {
		return -EINVAL;
	}

	for (u8_t idx = 0; idx < switch_array_len; ++idx) {
		if (switch_array[idx] >= gpio_patterns_len)
			return -ERANGE;
	}

	for (u8_t idx = 0; idx < len; ++idx) {
		array[idx] = gpio_patterns[switch_array[idx]];
	}

	return 0;
}

static u32_t get_switching_duration_ns(const struct dfe_sampling_config *sampling_conf)
{
	assert(sampling_conf != NULL);

	u32_t swiching_duration_us = ((sampling_conf->number_of_8us * DFE_US(8)) -
			(sampling_conf->guard_period_us + sampling_conf->ref_period_us));

	return (swiching_duration_us * DFE_NS(1000));
}

static uint8_t get_effective_ant_num(const struct dfe_sampling_config *sampling_conf)
{
	assert(sampling_conf != NULL);

	u32_t switching_duration_ns = get_switching_duration_ns(sampling_conf);
	u32_t switch_spacing_ns = get_switch_spacing_ns(sampling_conf->switch_spacing);

	return (uint8_t)(switching_duration_ns / switch_spacing_ns);
}

static u16_t get_switch_spacing_ns(u8_t spacing) {

	u16_t spacing_ns = 0;
	switch(spacing) {
		case 0:
			spacing_ns = DFE_NS(8000);
			break;
		case RADIO_DFECTRL1_TSWITCHSPACING_4us:
			spacing_ns = DFE_NS(4000);
			break;
		case RADIO_DFECTRL1_TSWITCHSPACING_2us:
			spacing_ns = DFE_NS(2000);
			break;
		case RADIO_DFECTRL1_TSWITCHSPACING_1us:
			spacing_ns = DFE_NS(1000);
			break;
		default:
			return -1;
	}
	return spacing_ns;
}

u16_t dfe_get_sample_spacing_ns(u8_t sampling)
{
	u16_t sampling_ns = 0;
	switch(sampling) {
		case RADIO_DFECTRL1_TSAMPLESPACING_4us:
			sampling_ns = DFE_NS(4000);
			break;
		case RADIO_DFECTRL1_TSAMPLESPACING_2us:
			sampling_ns = DFE_NS(2000);
			break;
		case RADIO_DFECTRL1_TSAMPLESPACING_1us:
			sampling_ns = DFE_NS(1000);
			break;
		case RADIO_DFECTRL1_TSAMPLESPACING_500ns:
			sampling_ns = DFE_NS(500);
			break;
		case RADIO_DFECTRL1_TSAMPLESPACING_250ns:
			sampling_ns = DFE_NS(250);
			break;
		case RADIO_DFECTRL1_TSAMPLESPACING_125ns:
			sampling_ns = DFE_NS(125);
			break;
		default:
			sampling_ns = -1;
	}
	return sampling_ns;
}

u16_t dfe_get_sample_spacing_ref_ns(u8_t sampling) {

	u16_t sampling_ns = 0;
	switch(sampling) {
		case RADIO_DFECTRL1_TSAMPLESPACINGREF_4us:
			sampling_ns = DFE_NS(4000);
			break;
		case RADIO_DFECTRL1_TSAMPLESPACINGREF_2us:
			sampling_ns = DFE_NS(2000);
			break;
		case RADIO_DFECTRL1_TSAMPLESPACINGREF_1us:
			sampling_ns = DFE_NS(1000);
			break;
		case RADIO_DFECTRL1_TSAMPLESPACINGREF_500ns:
			sampling_ns = DFE_NS(500);
			break;
		case RADIO_DFECTRL1_TSAMPLESPACINGREF_250ns:
			sampling_ns = DFE_NS(250);
			break;
		case RADIO_DFECTRL1_TSAMPLESPACINGREF_125ns:
			sampling_ns = DFE_NS(125);
			break;
		default:
			sampling_ns = -1;
	}
	return sampling_ns;
}

static u16_t get_sampling_slot_samples_num(const struct dfe_sampling_config *sampling_conf)
{
	assert(sampling_conf != NULL);

	u16_t sample_spacing_ns = dfe_get_sample_spacing_ns(sampling_conf->sample_spacing);
	u16_t swich_spacing_ns = get_switch_spacing_ns(sampling_conf->switch_spacing);
	/* Switch spacing time is a duration between antenna switch so it holds
	 * swich slot and sample slot. Because of that in case of over sampling
	 * we take as valid samples only half of them. In case sampling duration
	 * is greater or equal all samples are valid.
	 * of
	 */
	assert(sample_spacing_ns != 0);

	if (swich_spacing_ns > sample_spacing_ns) {
		return swich_spacing_ns / (sample_spacing_ns * 2);
	} else {
		return sample_spacing_ns / sample_spacing_ns;
	}
}

u16_t dfe_get_ref_samples_num(const struct dfe_sampling_config* sampling_conf)
{
	assert(sampling_conf != NULL);

	u16_t sample_spacing_ns = dfe_get_sample_spacing_ref_ns(sampling_conf->sample_spacing_ref);
	return sampling_conf->ref_period_us * DFE_NS(1000) / sample_spacing_ns;
}

static inline bool is_oversampling_enabled(const struct dfe_sampling_config *sampling_conf)
{
	assert(sampling_conf != NULL);

	if (sampling_conf->switch_spacing > sampling_conf->sample_spacing) {
		return false;
	} else {
		return true;
	}
}

u16_t dfe_delay_before_first_sampl(const struct dfe_sampling_config* sampling_conf)
{
	assert(sampling_conf != NULL);

	u16_t swich_spacing_ns = get_switch_spacing_ns(sampling_conf->switch_spacing);
	u16_t ref_spacing_ns = dfe_get_sample_spacing_ref_ns(sampling_conf->sample_spacing_ref);

	assert(swich_spacing_ns != 0);
	return (swich_spacing_ns >> 1) + ref_spacing_ns;
}

void dfe_set_single_antenna_for_whole_cte(u8_t antenna_num)
{
	assert(antenna_num < g_ant_conf.ant_gpio_pattern_len);

	g_ant_conf.ref_ant_idx = antenna_num;
	g_ant_conf.idle_ant_idx = antenna_num;
	memset(g_ant_conf.antennae_switch_idx, antenna_num,
		   g_ant_conf.antennae_switch_idx_len);
}
```

## src/dfe_local_config.h
```c
/*
 * Copyright (c) 2020 Nordic Semiconductor ASA
 *
 * SPDX-License-Identifier: LicenseRef-BSD-5-Clause-Nordic
 */


#ifndef SRC_DFE_LOCAL_CONFIG_H_
#define SRC_DFE_LOCAL_CONFIG_H_

#include <stdbool.h>
#include <bluetooth/dfe_config.h>
#include <bluetooth/dfe_data.h>
#include "dfe_samples_data.h"

#define DFE_NS(ns)	(ns)
#define DFE_US(us)	(us)

/** @brief DFE antennas switching configuration structure
 */
struct dfe_antenna_config{
	/** Index of antenna used for reference period */
	u8_t ref_ant_idx;
	/** Index of antenna used at start of CTE and after end of CTE
	* (suggested to use the same antenna as for ref period)
	* */
	u8_t idle_ant_idx;
	 /** The array stores values that should be set to GPIO to enable antenna
	 * with given index. The index of the particular value is the antenna
	 * number. Single bit of the value is set as a value for single GPIO pin.
	 */
	u8_t ant_gpio_pattern[16];
	u8_t ant_gpio_pattern_len;
	/**Array stores indices of antennas to be enabled in particular switch state.
	 * The array does not include reference period antenna and idle antenna.
	 */
	u8_t antennae_switch_idx[48];
	u8_t antennae_switch_idx_len;
	/** GPIOS used to switch antennae. */
	u32_t gpio[8];
};

/** @brief DFE Sampling configuration structure
 */
struct dfe_sampling_config {
	/** Mode of DFE, currently we support on AoA */
	u8_t dfe_mode;
	/** Start point when CTE is added and start point when switching/sampling
	 * is done: after CRC, during packet payload
	 */
	u8_t start_of_sampl;
	/** Length of AoA/AoD procedure in number of 8[us] */
	u8_t number_of_8us;
	/** Process sampling even if CRC error occurs */
	bool en_sampling_on_crc_error;
	/** Limits start DFE to be triggered by TASKS_DFESTART only */
	bool dfe_trigger_task_only;
	/** Type of samples: I/Q or magnitude/phase */
	u8_t sampling_type;
	/** Interval between samples in REFERENCE period */
	u8_t sample_spacing_ref;
	/** Interval between samples in SWITCH period */
	u8_t sample_spacing;
	/** Time delay relative to beginning of reference period before starting
	 * sampling, number of 16M cycles ?
	 */
	s16_t sample_offset;
	/** Time between consecutive antenna switches in SWITCH period of CTE */
	u16_t switch_spacing;
	/** Time delay after end of CRC before starting switching, number of 16M cycles */
	s16_t switch_offset;
	/** Length of guard period - BT defines that to be 4[us] */
	u8_t guard_period_us;
	/** length of reference period - BT defines that to be 8[us] */
	u8_t ref_period_us;
};

/** @brief Returns instance of DFE sampling configuration data structure.
 *
 * @return instance of sampling configuration
 */
const struct dfe_sampling_config *dfe_get_sampling_config();

/** @brief Returns instance of DFE sampling configuration data structure.
 *
 * @return instance of sampling configuration
 */
const struct dfe_antenna_config *dfe_get_antenna_config();

/** @brief Returns configuration of GPIOs that should be used to drive antenna
 * switching by DFE module.
 *
 * @return pointer to GPIOs array
 */
const struct dfe_ant_gpio* dfe_get_ant_gpios_config();

/** @brief Returns length of array returned by @ref dfe_get_ant_gpios_config
 *
 * @return length of array of GPIOs to drive antenna switches
 */
u8_t dfe_get_ant_gpios_config_len();

/** @brief Initializes DFE in Bluetooth controller
 *
 * @param[in] sampl_conf	Sampling configuration
 * @param[in] ant_conf		Antenna switching configuration
 * @param[in] ant_gpio		Array of GPIOs to use to drive antenna switches
 * @param[in] ant_gpio_len	Length of @p ant_gpio array
 *
 * @return Returns zero if DFE is initialized successfully, non zero value in
 * 		   other case.
 */
int dfe_init(const struct dfe_sampling_config *sampl_conf,
	     const struct dfe_antenna_config *ant_conf,
	     const struct dfe_ant_gpio *ant_gpio, u8_t ant_gpio_len);

/** @brief Maps IQ samples to antennas.
 *
 * Maps IQ samples to antennas used to collect particular samples.
 * Radio provides raw IQ samples without information about time and antenna
 * used to collect them.
 *
 * @param[out] 	mapped_data	Storage for mapped IQ samples
 * @param[in] 	raw_data	Raw IQ samples received from BLE controller
 * @param[in] 	sampl_conf	Sampling configuration
 * @param[in] 	ant_conf	Antenna switching configuration
 */
void dfe_map_iq_samples_to_antennas(struct dfe_mapped_packet *mapped_data,
				  const struct dfe_packet *raw_data,
				  const struct dfe_sampling_config *sampling_conf,
				  const struct dfe_antenna_config *ant_config);

/** @brief Evaluates delay between last reference sample and first sample in
 * antenna switching period.
 *
 * @param[in] sampling_conf	Sampling configuration data
 *
 * @return	Time delay in [ns]
 */
u16_t dfe_delay_before_first_sampl(const struct dfe_sampling_config* sampling_conf);
/** @brief Converts sample spacing settings value to nanoseconds.
 *
 * @param[in] sampling	Spacing configuration value
 *
 * @return Sample spacing in [ns]
 */
u16_t dfe_get_sample_spacing_ns(u8_t sampling);
/** @brief Converts reference sample spacing settings value to nanoseconds.
 *
 * @param[in] sampling	Sampling configuration value
 *
 * @return Sample spacing in [ns]
 */
u16_t dfe_get_sample_spacing_ref_ns(u8_t sampling);

/** @brief Evaluates number of samples collected in reference period
 *
 * @param[in] sampling_conf	Sampling configuration
 *
 * @return Number of samples
 */
u16_t dfe_get_ref_samples_num(const struct dfe_sampling_config* sampling_conf);

void dfe_set_single_antenna_for_whole_cte(u8_t antenna_num);

#endif /* SRC_DFE_LOCAL_CONFIG_H_ */
```

## src/dfe_samples_data.h
```c
/*
 * Copyright (c) 2020 Nordic Semiconductor ASA
 *
 * SPDX-License-Identifier: LicenseRef-BSD-5-Clause-Nordic
 */

#ifndef SRC_DFE_SAMPLES_DATA_H_
#define SRC_DFE_SAMPLES_DATA_H_

#include <stdint.h>
#include <zephyr/types.h>
#include <bluetooth/dfe_data.h>

/** @brief IQ samples package header structure
 */
struct dfe_header {
	uint32_t length;
	uint32_t frequency;
} __attribute__((packed));

/** @brief IQ sample data structure
 *
 * The data are stored as a union.
 * Second member data is an array that is a helper used by math ARM functions.
 */
union dfe_iq_f {
	struct {
		float i; //!< 12bit
		float q; //!< 12bit
	};
	float data[2];
} __attribute__((packed));

/* Max length of SWITH PERIOD supported by our radio is 8us.
 * Smallest samples spacing is 125ns.
 * Max total number of gathered samples is 32 (that includes only sampling slots)
 */
#define DF_SAMPLES_COUNT (32)

/** @brief IQ samples collected for single antenna data structure
 *
 */
struct dfe_samples {
	union dfe_iq_f data[DFE_SAMPLES_PER_SLOT_NUM];
	uint8_t samples_num;
	uint8_t antenna_id;
} __attribute__((packed));

/** @brief IQ samples collected during reference period
 *
 * This structure differs from @see dfe_samples by size of data array.
 * Number of samples in reference period is bigger than number of samples
 * for single antenna in switching period.
 */
struct dfe_ref_samples {
	union dfe_iq_f data[DFE_REF_SAMPLES_NUM];
	uint8_t samples_num;
	uint8_t antenna_id;
} __attribute__((packed));


/* Max length of CTE is 160us. With removed guard period(4us) and reference period(8us)
 * we have 148us. Smallest reasonable antenna switching period is 2us.
 * That gives us up to 74 samples set per antenna.
 */
#define DF_MAX_EFFECTIVE_ANT_COUNT (32)
/** @brief Single DFE IQ samples mapped to antennas
 *
 * The structure holds data for a single DFE run.
 * It consists of a header, reference period IQ samples and
 * antenna switching period IQ samples.
 */
struct dfe_mapped_packet {
	struct dfe_header header;
	struct dfe_ref_samples ref_data;
	struct dfe_samples sampl_data[DFE_TOTAL_SLOTS_NUM];
} __attribute__((packed));

#endif /* SRC_DFE_SAMPLES_DATA_H_ */
```

## src/if.c
```c
/*
 * Copyright (c) 2020 Nordic Semiconductor ASA
 *
 * SPDX-License-Identifier: LicenseRef-BSD-5-Clause-Nordic
 */

#include <errno.h>
#include <device.h>
#include <drivers/uart.h>

#include "if.h"

#define MODULE df_if
#include <logging/log.h>
LOG_MODULE_REGISTER(MODULE, CONFIG_DF_APP_LOG_LEVEL);

/** @brief Storage for internals of output interface handling functionality */
static struct if_data g_if;

/** @brief UART ISR handler.
 *
 * The function is responsible for a logging information if
 * UART is interrupted when TX is ready.
 *
 * @param[in] dev	UARD device
 */
static void if_uart_app_isr(struct device *dev);

/** @brief Send data via UART
 *
 * @param[in] buffer	Data to be send
 * @param[in] length	Size of memory in @p buffer
 */
static void uart_send(uint8_t *buffer, uint16_t length);

struct if_data *if_initialization(void)
{
	g_if.dev = device_get_binding(CONFIG_AOA_LOCATOR_UART_PORT);
	if (!g_if.dev) {
		LOG_ERR("UART Device not found or cannot be used");
		return NULL;
	}

	uart_irq_rx_disable(g_if.dev);
	uart_irq_tx_disable(g_if.dev);
	uart_irq_callback_set(g_if.dev, if_uart_app_isr);
	uart_irq_rx_enable(g_if.dev);

	g_if.send = uart_send;

	return &g_if;
}

static void if_uart_app_isr(struct device *dev)
{
	while (uart_irq_update(dev) && uart_irq_is_pending(dev))
	{
		if (!uart_irq_rx_ready(dev))
		{
			if (uart_irq_tx_ready(dev))
			{
				LOG_DBG("ISR transmit ready");
			}
			else
			{
				LOG_DBG("ISR spurious interrupt");
			}

			break;
		}
	}
}

static void uart_send(uint8_t *buffer, uint16_t length)
{
	size_t i = 0;

	for(i=0; i<length; i++)
	{
		uart_poll_out(g_if.dev, buffer[i]);
	}
}
```
