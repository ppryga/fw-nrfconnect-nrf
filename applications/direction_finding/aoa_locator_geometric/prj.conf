## CMakeLists.txt
```
# SPDX-License-Identifier: Apache-2.0

cmake_minimum_required(VERSION 3.13.1)
include($ENV{ZEPHYR_BASE}/cmake/app/boilerplate.cmake NO_POLICY_SCOPE)
project("aoa_locator_geometric" VERSION 0.1)

set(NRF_SUPPORTED_BUILD_TYPES
  ZDebug
  ZRelease
  )

if (NOT CMAKE_BUILD_TYPE)
  set(CMAKE_BUILD_TYPE ZDebug)
endif()

zephyr_compile_definitions(
   ARM_MATH_CM4
)

zephyr_include_directories(
    .
 )

target_sources(app PRIVATE src/main.c
	src/if.c
	src/protocol.c
	src/ble.c
	src/dfe_local_config.c
)

target_include_directories(app PRIVATE $ENV{ZEPHYR_BASE}/samples/bluetooth)
target_include_directories(app PRIVATE $ENV{ZEPHYR_BASE}/subsys/bluetooth/controller)
```

## Kconfig
```
#
# Copyright (c) 2018 Nordic Semiconductor ASA
#
# SPDX-License-Identifier: LicenseRef-BSD-5-Clause-Nordic
#

menu "Aoa Locator Connection Less CTE"

config AOA_LOCATOR_UART_PORT
	string "Name of the UART port"
	default "UART_0"

config AOA_LOCATOR_DATA_SEND_WAIT_MS
	int "Number of miliseconds to wait after data is sent over UART."
	default 40
	range 1 100
	help
		The time to wait after a data packet is send.
		It is here because of the PC tool limitations,
		to give it a time for data processing before sending next packet.

endmenu

menu "Zephyr Kernel"
source "$ZEPHYR_BASE/Kconfig.zephyr"
endmenu
```

## prj.conf
```kconfig
#Set name of final binaries (*.hex and *.elf)
CONFIG_KERNEL_BIN_NAME="aoa_locator_geometric"

# General Kernel Options
CONFIG_MAIN_STACK_SIZE=2048
CONFIG_HEAP_MEM_POOL_SIZE=2048
CONFIG_SYSTEM_WORKQUEUE_STACK_SIZE=2048
CONFIG_NEWLIB_LIBC=y
CONFIG_DEBUG=y
CONFIG_DEBUG_OPTIMIZATIONS=y

# BT options
CONFIG_BT=y
CONFIG_BT_OBSERVER=y
CONFIG_BT_DEBUG_LOG=y
CONFIG_BT_CTLR=y
CONFIG_BT_CTLR_DF_SUBSYSTEM=y

# Uart driver and UART configuration
CONFIG_SERIAL=y
CONFIG_UART_NRFX=y
CONFIG_UART_INTERRUPT_DRIVEN=y

# Enable the Direction finding subsystem
CONFIG_BT_CTLR_DF_SUBSYSTEM=y
# Enable receive of CTE(DFE) extension by Bluetooth stack
CONFIG_BT_CTLR_DFE_RX=y
# Set length of CTE
CONFIG_BT_CTLR_DFE_NUMBER_OF_8US=2
# Set antennas switching time
CONFIG_BT_CTLR_DFE_SWITCH_SPACING_2US=y
# Enable regular sampling configuration
CONFIG_BT_CTLR_DFE_SAMPLE_SPACING_1US=y
CONFIG_BT_CTLR_DFE_SAMPLE_SPACING_REF_1US=y
```

## src/main.c
```c
/*
 * Copyright (c) 2020 Nordic Semiconductor ASA
 *
 * SPDX-License-Identifier: LicenseRef-BSD-5-Clause-Nordic
 */

#include <assert.h>
#include <string.h>
#include <complex.h>
#include <math.h>

#include <kernel.h>
#include <zephyr/types.h>
#include <sys/printk.h>
#include <bluetooth/dfe_data.h>

#include "if.h"
#include "protocol.h"
#include "dfe_local_config.h"
#include "ble.h"
#include "dfresults.h"


/** @brief Number of ms to wait for a data before printing no data note
 */
#define WAIT_FOR_DATA_BEFORE_PRINT (1000)

/** @brief Queue defined by BLE Controller to provide IQ samples data
 */
extern struct k_msgq df_packet_msgq;
/** @brief Compute average phase difference between samples in reference
 *
 * The function computes average difference between samples from reference period.
 *
 * @param ref_data Reference data samples
 *
 * @return The average phase offset between samples
 */
static float compute_phase_avg_diffrence(const struct dfe_ref_samples *ref_data)
{
	assert(ref_data != NULL);

	uint16_t samples_num = ref_data->samples_num;
	float complex z1 = 0, z2 = 0;
	float sum= 0.0;

	for(uint16_t idx=0; idx<samples_num-1; ++idx)
	{
		float temp;
		z1 = ref_data->data[idx].i   + ref_data->data[idx].q*I;
		z2 = ref_data->data[idx+1].i + ref_data->data[idx+1].q*I;
		temp = cargf(z1/z2);

		sum += temp;
	}

	return sum / (samples_num - 1);
}

/** @brief Function that shifts phase of I/Q samples back into one point in time
 *
 * The samples are sampled one after another.
 * The mathematical model used to calculate the AoA requires all the samples
 * to be taken in single moment in time.
 * The function here calculates phase shift between samples in reference period
 * and uses it to correct the phase for the samples in reference and sampling
 * periods in such a way like they were all taken in the same time.
 *
 * @param[in,out]  data		Pointer to I/Q samples. After end of evaluation
 * 				the data are overwritten with corrected values.
 * @param[in]      slot_samples_num Number of samples in single slot.
 */
static void phase_time_machine(struct dfe_mapped_packet *data,
			       uint16_t slot_samples_num)
{
	float complex phase_correction;
	float complex source_phase, out_phase;
	float phase_diff = compute_phase_avg_diffrence(&data->ref_data);

	/* correct phase in ref. period*/
	for(uint16_t idx=0; idx<data->ref_data.samples_num; ++idx)
	{
		source_phase = data->ref_data.data[idx].i + data->ref_data.data[idx].q*I;
		float total_fix = phase_diff * (float)idx;
		phase_correction = cosf(total_fix) + sinf(total_fix)*I;
		out_phase = source_phase * phase_correction;
		data->ref_data.data[idx].i = crealf(out_phase);
		data->ref_data.data[idx].q = cimagf(out_phase);
	}

	/* correct phase in switching period.
	 * Pay attention that sampling is started just after first switch slot,
	 * that means there is additional time delay of TSWITCHING/2 */
	uint16_t time_delay = data->ref_data.samples_num + slot_samples_num;
	uint16_t switch_sampl_num = slot_samples_num * 2;
	uint16_t sample_effective_delay;
	float phase_effective_offset;

	for( uint16_t ant_idx = 0; ant_idx<data->header.length; ++ant_idx) {
		for(uint16_t idx = 0; idx < data->sampl_data[ant_idx].samples_num; ++idx) {
			source_phase = data->sampl_data[ant_idx].data[idx].i +
				       data->sampl_data[ant_idx].data[idx].q*I;

			sample_effective_delay = time_delay + idx + (ant_idx * switch_sampl_num);
			phase_effective_offset = phase_diff * sample_effective_delay;
			phase_correction = cosf(phase_effective_offset) + sinf(phase_effective_offset)*I;
			out_phase = source_phase * phase_correction;
			data->sampl_data[ant_idx].data[idx].i = crealf(out_phase);
			data->sampl_data[ant_idx].data[idx].q = cimagf(out_phase);
		}
	}
}

/**
 * @brief Calculate sum of the samples
 *
 * @param sampl_data Data chunk to calculate sum of
 *
 * @return The sum of the samples in data chunk
 */
static float complex antenna_samples_sum(const struct dfe_samples* sampl_data)
{
	float complex sum = 0;

	for (u16_t i = 0; i < sampl_data->samples_num; ++i)
	{
		sum += sampl_data->data[i].i + sampl_data->data[i].q*I;
	}
	return sum;
}

/**
 * @brief Calculate phase difference between antennas
 *
 * The selected antennas phases are averaged and then the wave angle is calculated.
 *
 * @note This function expects the angles to be corrected to frequency 0 (DC).
 *
 * @param mapped_data The data do process
 * @param a1          First antenna number
 * @param a2          Second antenna number
 *
 * @return The phase difference between phases on antennas 1 and 2.
 */
static float antenna_data_to_phase_diff(const struct dfe_mapped_packet *mapped_data, u8_t a1, u8_t a2)
{
	float complex sum1 = 0, sum2 = 0;

	for (u16_t idx=0; idx<mapped_data->header.length; ++idx)
	{
		const struct dfe_samples* sampl_data = &mapped_data->sampl_data[idx];
		if (sampl_data->antenna_id == a1)
			sum1 += antenna_samples_sum(sampl_data);
		if (sampl_data->antenna_id == a2)
			sum2 += antenna_samples_sum(sampl_data);
	}
	return cargf(sum1/sum2);
}

/**
 * @brief Calculate the phase difference into angle in radians
 *
 * @param phase Phase difference between antennas
 * @param d     Distance between antennas
 * @param freq  Radio frequency to calculate wavelength
 *
 * @return The calculated angle
 */
static float phase_to_angle(float phase, float d, float freq)
{
	float arg = (phase * (float)WAVE_SPEED) / (2 * (float)PI * freq * d);

	if (arg > 1.0f)
		arg = 1.0f;
	else if (arg < -1.0f)
		arg = -1.0f;
	return acos(arg);
}

/** @brief Main function of the example.
 *
 * The function is responsible for:
 * - initialization of UART output
 * - initialization of Direction Finding in Bluetooth stack
 * - initialization of Bluetooth stack
 * - receive DFE data from Bluetooth controller
 * - mapping received data to antenna numbers
 * - forwarding data by UART
 *
 * Following steps: data receive, mapping and their forwarding
 * is done in never ending loop.
 */
void main(void)
{
	printk("Starting AoA Locator Geometric!\r\n");
	/* initialize UART interface to provide I/Q samples */
	struct if_data* iface = if_initialization();

	if (iface == NULL) {
		printk("Locator stopped!\r\n");
		return;
	}

	int err;

	err = protocol_initialization(iface);
	if (err) {
		printk("Locator stopped!\r\n");
		return;
	}

	const struct dfe_sampling_config* sampl_conf = NULL;
	const struct dfe_antenna_config* ant_conf = NULL;
	const struct dfe_ant_gpio* ant_gpio = NULL;
	u8_t ant_gpio_len = 0;

	sampl_conf = dfe_get_sampling_config();
	ant_conf = dfe_get_antenna_config();
	ant_gpio_len = dfe_get_ant_gpios_config_len();
	ant_gpio = dfe_get_ant_gpios_config();

	assert(sampl_conf != NULL);
	assert(ant_conf != NULL);
	assert(ant_gpio != NULL);
	assert(ant_gpio_len != 0);

	printk("Initialize DFE\r\n");
	err = dfe_init(sampl_conf, ant_conf, ant_gpio, ant_gpio_len);
	if (err) {
		printk("Locator stopped!\r\n");
		return;
	}

	printk("Initialize Bluetooth\r\n");
	ble_initialization();

	while(1)
	{
		static struct dfe_packet df_data_packet;
		static struct dfe_mapped_packet df_data_mapped;
		static struct dfresults results = {0};

		memset(&df_data_packet, 0, sizeof(df_data_packet));
		memset(&df_data_mapped, 0, sizeof(df_data_mapped));
		k_msgq_get(&df_packet_msgq, &df_data_packet, K_MSEC(WAIT_FOR_DATA_BEFORE_PRINT));
		if (df_data_packet.hdr.length != 0) {
			dfe_map_iq_samples_to_antennas(&df_data_mapped,
						       &df_data_packet,
						       sampl_conf, ant_conf);
			remove_samples_from_switch_slot(&df_data_mapped, sampl_conf);
			phase_time_machine(&df_data_mapped, dfe_get_sampling_slot_samples_num(sampl_conf));

			results.phase = antenna_data_to_phase_diff(
				&df_data_mapped, DFE_ANT1, DFE_ANT2);
			results.azimuth = phase_to_angle(
				results.phase,
				DFE_ANT_D,
				(float)df_data_mapped.header.frequency * 1.0e6f);

			err = protocol_handling(sampl_conf, &df_data_mapped, &results);
			if (err) {
				printk("Error in protocol handling!\r\n");
				printk("Locator stopped!\r\n");
				return;
			}
		}
		else
		{
			printk("\r\nNo data received.");
		}
	 	k_sleep(K_MSEC(CONFIG_AOA_LOCATOR_DATA_SEND_WAIT_MS));
	}
}
```

## src/dfe_local_config.c
```c
/*
 * Copyright (c) 2020 Nordic Semiconductor ASA
 *
 * SPDX-License-Identifier: LicenseRef-BSD-5-Clause-Nordic
 */

#include <stddef.h>
#include <stdbool.h>
#include <assert.h>
#include <zephyr/types.h>
#include <kernel.h>
#include <nrf.h>

#include "dfe_local_config.h"

const static struct dfe_sampling_config g_sampl_config = {
	.dfe_mode = RADIO_DFEMODE_DFEOPMODE_AoA,
	.start_of_sampl = RADIO_DFECTRL1_DFEINEXTENSION_CRC,
	.number_of_8us = CONFIG_BT_CTLR_DFE_NUMBER_OF_8US,
	.en_sampling_on_crc_error = false,
	.dfe_trigger_task_only = true,
	.sampling_type = RADIO_DFECTRL1_SAMPLETYPE_IQ,
	.sample_spacing_ref = CONFIG_BT_CTLR_DFE_SAMPLE_SPACING_REF_VAL,
	.sample_spacing = CONFIG_BT_CTLR_DFE_SAMPLE_SPACING_VAL,
	.sample_offset = 1,
	.switch_spacing = CONFIG_BT_CTLR_DFE_SWITCH_SPACING_VAL,
	.switch_offset = 0,
	.guard_period_us = 4,
	.ref_period_us = 8,
};

const static struct dfe_antenna_config g_ant_conf = {
		.ref_ant_idx = DFE_ANT1,
		.idle_ant_idx = DFE_ANT1,
		.ant_gpio_pattern = {0, 5, 6, 4, 9, 10, 8, 13, 14, 12, 1, 2, 0},
		.ant_gpio_pattern_len = 13,
		.antennae_switch_idx = {DFE_ANT1, DFE_ANT2},
		.antennae_switch_idx_len = 2,
	};

const static struct dfe_ant_gpio g_gpio_conf[4] = {
		{0, 3}, {1,4}, {2, 28}, {3,29}
};

/** @brief Creates switching pattern array
 *
 * The function converts provided antenna indices into array of
 * switch patterns that will be applied by radios DFE module to switch antennas.
 *
 * @param[in,out] array			pointer where to store patterns
 * @param[in] len				Length of @p array
 * @param[in] gpio_patterns		array of GPIO patterns
 * @param[in] gpio_patterns_len	length of @p gpio_patterns
 * @param[in] switch_array		array with antenna indices
 * @param[in] switch_array_len	length of @p switch_array
 *
 * @retval 0		switch pattern array created successfully
 * @retval -EINVAL	one of pointers is NULL or one of lengths is zero
 */
static int create_switching_pattern_array(u8_t *array, u8_t len,
		const u8_t *gpio_patterns, u8_t gpio_patterns_len,
		const u8_t *switch_array, u8_t switch_array_len);

/** @brief Evaluates duration of antenna switching period
 *
 * @param[in] sampling_conf	Sampling configuration
 *
 * @return Duration in [ns]
 */
static u32_t get_switching_duration_ns(const struct dfe_sampling_config *sampling_conf);

/** @brief Converts antenna switch spacing settings value to nanoseconds.
 *
 * @param[in] spacing	Value of antenna switching setting
 *
 * @return Sample spacing in [ns]
 */
static u16_t get_switch_spacing_ns(u8_t spacing);

/** @brief Evaluates number of samples collected in reference period
 *
 * @param[in] sampling_conf	Sampling configuration
 *
 * @return Number of samples
 */
static u16_t get_ref_samples_num(const struct dfe_sampling_config* sampling_conf);

/** @brief Converts antenna switch spacing settings value to nanoseconds.
 *
 * Function verifies if oversampling is enabled. That means we would receive
 * samples during antenna switching period.
 *
 * @param[in] sampling_conf	Sampling configuration
 *
 * @retval true		If oversampling is enables
 * @retval false	If oversampling is disabled
 */
static inline bool is_oversampling_enabled(const struct dfe_sampling_config *sampling_conf);

/** @brief Provides number of effective antennas used during antenna switching
 * period.
 *
 * @param[in] sampl_conf	Sampling configuration
 *
 * @return Number of antennas used to collect IQ samples except reference period
 */
static uint8_t get_effective_ant_num(const struct dfe_sampling_config *sampling_conf);

/** @brief Provides number of samples collected in single sampling slot
 *
 * @param[in] sampl_conf	Sampling configuration
 *
 * @return Number of samples collected in sampling slot
 */
static u16_t get_sampling_slot_samples_num(const struct dfe_sampling_config *sampling_conf);

const struct dfe_sampling_config* dfe_get_sampling_config()
{
	return &g_sampl_config;
}

const struct dfe_antenna_config* dfe_get_antenna_config()
{
	return &g_ant_conf;
}

const struct dfe_ant_gpio* dfe_get_ant_gpios_config()
{
	return &g_gpio_conf[0];
}

u8_t dfe_get_ant_gpios_config_len()
{
	return ARRAY_SIZE(g_gpio_conf);
}

int dfe_init(const struct dfe_sampling_config *sampl_conf,
	     const struct dfe_antenna_config *ant_conf,
	     const struct dfe_ant_gpio *ant_gpio, u8_t ant_gpio_len)
{
	assert(sampl_conf != NULL);
	assert(ant_conf != NULL);
	assert(ant_gpio != NULL);
	assert(ant_gpio_len != 0);

	int err = 0;

	err = dfe_set_mode(sampl_conf->dfe_mode);
	if (err) {
		printk("[DFE] - DFE mode is unknown\n");
		return -EINVAL;
	}

	err = dfe_set_duration(sampl_conf->number_of_8us);
	if(err) {
		printk("Error! Number of 8us periods is out of allowed range!\r\n");
		return err;
	}

	err = dfe_set_start_point(sampl_conf->start_of_sampl);
	if(err) {
		printk("Error! DFE start point value is out of allowed range!\r\n");
		return err;
	}

	dfe_set_sample_on_crc_error(sampl_conf->en_sampling_on_crc_error);

	dfe_set_trig_dfe_start_task_only(true);

	err = dfe_set_sampling_spacing_ref(sampl_conf->sample_spacing_ref);
	if(err) {
		printk("Error! Reference sample spacing value is out of range!\r\n");
		return err;
	}
	err = dfe_set_sampling_type(sampl_conf->sampling_type);
	if(err) {
		printk("Error! Sampling type value is out of range!\r\n");
		return err;
	}
	err = dfe_set_sample_spacing(sampl_conf->sample_spacing);
	if(err) {
		printk("Error! Sample spacing value is out of range!\r\n");
		return err;
	}
	err = dfe_set_backoff_gain(0);
	if(err) {
		printk("Error! Gain backoff value is out of range!\r\n");
		return err;
	}
	err = dfe_set_switch_offset(sampl_conf->switch_offset);
	if(err) {
		printk("Error! Switch offset value is out of range!\r\n");
		return err;
	}
	err = dfe_set_sample_offset(sampl_conf->sample_offset);
	if(err) {
		printk("Error! Sampling offset value is out of range!\r\n");
		return err;
	}

	err = dfe_set_ant_switch_spacing(sampl_conf->switch_spacing);
	if(err) {
		printk("Error! Antenna switch spacing is out of range!\r\n");
		return err;
	}

	err = dfe_set_ant_gpios(ant_gpio, ant_gpio_len);
	if(err) {
		printk("Error! Number of GPIO for antennas switching is to large!\r\n");
		return err;
	}

	u8_t pattern_array[ant_conf->antennae_switch_idx_len];
	err = create_switching_pattern_array(pattern_array,
				       ant_conf->antennae_switch_idx_len,
				       ant_conf->ant_gpio_pattern,
				       ant_conf->ant_gpio_pattern_len,
				       ant_conf->antennae_switch_idx,
				       ant_conf->antennae_switch_idx_len);
	if(err) {
		printk("Error! Preparation of switch patterns array failed!\r\n");
		return err;
	}

	err = dfe_set_ant_gpio_patterns(ant_conf->ant_gpio_pattern[ant_conf->idle_ant_idx],
					ant_conf->ant_gpio_pattern[ant_conf->ref_ant_idx],
					pattern_array,
					ant_conf->antennae_switch_idx_len);
	if(err) {
		printk("Error! Initialization of gpio patterns failed!\r\n");
		return err;
	}
	return 0;
}

void dfe_map_iq_samples_to_antennas(struct dfe_mapped_packet *mapped_data,
				  const struct dfe_packet *raw_data,
				  const struct dfe_sampling_config *sampling_conf,
				  const struct dfe_antenna_config *ant_config)
{
	assert(raw_data != NULL);
	assert(mapped_data != NULL);

	u16_t ref_samples_num = get_ref_samples_num(sampling_conf);
	mapped_data->ref_data.antenna_id = ant_config->ref_ant_idx;

	for(uint16_t idx = 0; idx < ref_samples_num; ++idx) {
		mapped_data->ref_data.data[idx].i = raw_data->data[idx].iq.i;
		mapped_data->ref_data.data[idx].q = raw_data->data[idx].iq.q;
	}
	mapped_data->ref_data.samples_num = ref_samples_num;

	/* Depending on DFE duration, the number of antennas used for sample
	 * may be greater than the number of antennas in configuration.
	 * If there is time left after end of antennas sequence, then radio
	 * starts to use the same antennas again.
	 */
	u16_t effective_ant_num = get_effective_ant_num(sampling_conf);

	u8_t samples_num = get_sampling_slot_samples_num(sampling_conf);

	u8_t effective_sample_idx;

	bool oversampl = is_oversampling_enabled(sampling_conf);

	if (oversampl) {
		effective_ant_num = (effective_ant_num*2);
	}

	for(u16_t ant_idx = 0; ant_idx < effective_ant_num; ++ant_idx) {
		u8_t ant;
		struct dfe_samples *sample = &mapped_data->sampl_data[ant_idx];

		if (oversampl) {
			if (ant_idx & 0x1) {
				ant = 255;
			} else {
				u8_t idx = (ant_idx >> 1) % ant_config->antennae_switch_idx_len;
				ant = ant_config->antennae_switch_idx[idx];
			}
		} else {
			u8_t idx = ant_idx % ant_config->antennae_switch_idx_len;
			ant = ant_config->antennae_switch_idx[idx];
		}

		sample->antenna_id = ant;

		for(u8_t sample_idx = 0; sample_idx < samples_num; ++sample_idx) {
			effective_sample_idx = ref_samples_num + (ant_idx * samples_num) + sample_idx;
			sample->data[sample_idx].i = raw_data->data[effective_sample_idx].iq.i;
			sample->data[sample_idx].q = raw_data->data[effective_sample_idx].iq.q;
		}
		sample->samples_num = samples_num;
	}

	mapped_data->header.length = effective_ant_num;
	mapped_data->header.frequency = raw_data->hdr.frequency;
}

int remove_samples_from_switch_slot(struct dfe_mapped_packet *data,
				    const struct dfe_sampling_config *sampling_conf)
{
	assert(data != NULL);
	assert(sampling_conf != NULL);

	u16_t effective_ant_num = dfe_get_effective_ant_num(sampling_conf);

	if (effective_ant_num <= 0) {
		return -1;
	}

	/* update length to new effective antenna number */
	data->header.length = effective_ant_num;

	bool oversampl = is_oversampling_enabled(sampling_conf);

	if (oversampl) {
		effective_ant_num = (effective_ant_num*2);
	}

	u16_t out_idx = 0;
	u16_t in_idx = 0;

	for( ; in_idx < effective_ant_num; ++in_idx) {
		assert(in_idx >= out_idx);
		const struct dfe_samples *sample_in = &data->sampl_data[in_idx];

		if (sample_in->antenna_id != DFE_ANT_UNKNONW) {
			struct dfe_samples *sample_out = &data->sampl_data[out_idx];

			sample_out->antenna_id = sample_in->antenna_id;
			sample_out->samples_num = sample_in->samples_num;

			for(u8_t sample_idx = 0; sample_idx <= sample_in->samples_num; ++sample_idx) {
				sample_out->data[sample_idx].i = sample_in->data[sample_idx].i;
				sample_out->data[sample_idx].q = sample_in->data[sample_idx].q;
			}
			++out_idx;
		}
	}
	return 0;
}

static int create_switching_pattern_array(u8_t *array, u8_t len,
					  const u8_t *gpio_patterns,
					  u8_t gpio_patterns_len,
					  const u8_t *switch_array,
					  u8_t switch_array_len)
{

	if (array == NULL || len == 0 || gpio_patterns == NULL ||
	    gpio_patterns_len == 0 || switch_array == NULL ||
	    switch_array_len == 0 || len < switch_array_len) {
		return -EINVAL;
	}

	for (u8_t idx = 0; idx < switch_array_len; ++idx) {
		if (switch_array[idx] >= gpio_patterns_len)
			return -ERANGE;
	}

	for (u8_t idx = 0; idx < len; ++idx) {
		array[idx] = gpio_patterns[switch_array[idx]];
	}

	return 0;
}

static u32_t get_switching_duration_ns(const struct dfe_sampling_config *sampling_conf)
{
	assert(sampling_conf != NULL);

	u32_t swiching_duration_us = ((sampling_conf->number_of_8us * DFE_US(8)) -
			(sampling_conf->guard_period_us + sampling_conf->ref_period_us));

	return (swiching_duration_us * DFE_NS(1000));
}

static uint8_t get_effective_ant_num(const struct dfe_sampling_config *sampling_conf)
{
	assert(sampling_conf != NULL);

	u32_t switching_duration_ns = get_switching_duration_ns(sampling_conf);
	u32_t switch_spacing_ns = get_switch_spacing_ns(sampling_conf->switch_spacing);

	return (uint8_t)(switching_duration_ns / switch_spacing_ns);
}

static u16_t get_switch_spacing_ns(u8_t spacing) {

	u16_t spacing_ns = 0;
	switch(spacing) {
		case 0:
			spacing_ns = DFE_NS(8000);
			break;
		case RADIO_DFECTRL1_TSWITCHSPACING_4us:
			spacing_ns = DFE_NS(4000);
			break;
		case RADIO_DFECTRL1_TSWITCHSPACING_2us:
			spacing_ns = DFE_NS(2000);
			break;
		case RADIO_DFECTRL1_TSWITCHSPACING_1us:
			spacing_ns = DFE_NS(1000);
			break;
		default:
			return -1;
	}
	return spacing_ns;
}

u16_t dfe_get_sample_spacing_ns(u8_t sampling)
{
	u16_t sampling_ns = 0;
	switch(sampling) {
		case RADIO_DFECTRL1_TSAMPLESPACING_4us:
			sampling_ns = DFE_NS(4000);
			break;
		case RADIO_DFECTRL1_TSAMPLESPACING_2us:
			sampling_ns = DFE_NS(2000);
			break;
		case RADIO_DFECTRL1_TSAMPLESPACING_1us:
			sampling_ns = DFE_NS(1000);
			break;
		case RADIO_DFECTRL1_TSAMPLESPACING_500ns:
			sampling_ns = DFE_NS(500);
			break;
		case RADIO_DFECTRL1_TSAMPLESPACING_250ns:
			sampling_ns = DFE_NS(250);
			break;
		case RADIO_DFECTRL1_TSAMPLESPACING_125ns:
			sampling_ns = DFE_NS(125);
			break;
		default:
			sampling_ns = -1;
	}
	return sampling_ns;
}

u16_t dfe_get_sample_spacing_ref_ns(u8_t sampling) {

	u16_t sampling_ns = 0;
	switch(sampling) {
		case RADIO_DFECTRL1_TSAMPLESPACINGREF_4us:
			sampling_ns = DFE_NS(4000);
			break;
		case RADIO_DFECTRL1_TSAMPLESPACINGREF_2us:
			sampling_ns = DFE_NS(2000);
			break;
		case RADIO_DFECTRL1_TSAMPLESPACINGREF_1us:
			sampling_ns = DFE_NS(1000);
			break;
		case RADIO_DFECTRL1_TSAMPLESPACINGREF_500ns:
			sampling_ns = DFE_NS(500);
			break;
		case RADIO_DFECTRL1_TSAMPLESPACINGREF_250ns:
			sampling_ns = DFE_NS(250);
			break;
		case RADIO_DFECTRL1_TSAMPLESPACINGREF_125ns:
			sampling_ns = DFE_NS(125);
			break;
		default:
			sampling_ns = -1;
	}
	return sampling_ns;
}

static u16_t get_sampling_slot_samples_num(const struct dfe_sampling_config *sampling_conf)
{
	assert(sampling_conf != NULL);

	u16_t sample_spacing_ns = dfe_get_sample_spacing_ns(sampling_conf->sample_spacing);
	u16_t swich_spacing_ns = get_switch_spacing_ns(sampling_conf->switch_spacing);
	/* Switch spacing time is a duration between antenna switch so it holds
	 * swich slot and sample slot. Because of that in case of over sampling
	 * we take as valid samples only half of them. In case sampling duration
	 * is greater or equal all samples are valid.
	 * of
	 */
	assert(sample_spacing_ns != 0);

	if (swich_spacing_ns > sample_spacing_ns) {
		return swich_spacing_ns / (sample_spacing_ns * 2);
	} else {
		return sample_spacing_ns / sample_spacing_ns;
	}
}

static u16_t get_ref_samples_num(const struct dfe_sampling_config* sampling_conf)
{
	assert(sampling_conf != NULL);

	u16_t sample_spacing_ns = dfe_get_sample_spacing_ref_ns(sampling_conf->sample_spacing_ref);
	return sampling_conf->ref_period_us * DFE_NS(1000) / sample_spacing_ns;
}

static inline bool is_oversampling_enabled(const struct dfe_sampling_config *sampling_conf)
{
	assert(sampling_conf != NULL);

	if (sampling_conf->switch_spacing > sampling_conf->sample_spacing) {
		return false;
	} else {
		return true;
	}
}

u16_t dfe_delay_before_first_sampl(const struct dfe_sampling_config* sampling_conf)
{
	assert(sampling_conf != NULL);

	u16_t swich_spacing_ns = get_switch_spacing_ns(sampling_conf->switch_spacing);
	u16_t ref_spacing_ns = dfe_get_sample_spacing_ref_ns(sampling_conf->sample_spacing_ref);

	assert(swich_spacing_ns != 0);
	return (swich_spacing_ns >> 1) + ref_spacing_ns;
}

uint8_t dfe_get_effective_ant_num(const struct dfe_sampling_config *sampling_conf)
{
	assert(sampling_conf != NULL);

	u32_t switching_duration_ns = get_switching_duration_ns(sampling_conf);
	u32_t switch_spacing_ns = dfe_get_switch_spacing_ns(sampling_conf->switch_spacing);

	return (uint8_t)(switching_duration_ns / switch_spacing_ns);
}

u16_t dfe_get_switch_spacing_ns(u8_t spacing)
{
	u16_t spacing_ns = 0;
	switch(spacing) {
		case 0:
			spacing_ns = DFE_NS(8000);
			break;
		case RADIO_DFECTRL1_TSWITCHSPACING_4us:
			spacing_ns = DFE_NS(4000);
			break;
		case RADIO_DFECTRL1_TSWITCHSPACING_2us:
			spacing_ns = DFE_NS(2000);
			break;
		case RADIO_DFECTRL1_TSWITCHSPACING_1us:
			spacing_ns = DFE_NS(1000);
			break;
		default:
			return -1;
	}
	return spacing_ns;
}

u16_t dfe_get_sampling_slot_samples_num(const struct dfe_sampling_config *sampling_conf)
{
	assert(sampling_conf != NULL);

	u16_t sample_spacing_ns = dfe_get_sample_spacing_ns(sampling_conf->sample_spacing);
	u16_t swich_spacing_ns = dfe_get_switch_spacing_ns(sampling_conf->switch_spacing);
	/* Switch spacing time is a duration between antenna switch so it holds
	 * switch slot and sample slot. Because of that in case of over sampling
	 * we take as valid samples only half of them. In case sampling duration
	 * is greater or equal all samples are valid.
	 * of
	 */
	assert(sample_spacing_ns != 0);

	if (swich_spacing_ns > sample_spacing_ns) {
		return swich_spacing_ns / (sample_spacing_ns * 2);
	} else {
		return sample_spacing_ns / sample_spacing_ns;
	}
}
```

## src/dfe_local_config.h
```c
/*
 * Copyright (c) 2020 Nordic Semiconductor ASA
 *
 * SPDX-License-Identifier: LicenseRef-BSD-5-Clause-Nordic
 */


#ifndef SRC_DFE_LOCAL_CONFIG_H_
#define SRC_DFE_LOCAL_CONFIG_H_

#include <bluetooth/dfe_config.h>
#include <bluetooth/dfe_data.h>
#include "dfe_samples_data.h"

#define DFE_NS(ns)	(ns)
#define DFE_US(us)	(us)

/** Macro for unknown antenna index */
#define DFE_ANT_UNKNONW (255)

/**
 * @brief First (reference) antenna
 */
#define DFE_ANT1 12

/**
 * @brief Second antenna
 */
#define DFE_ANT2 1

/**
 * @brief Antenna distance
 */
#define DFE_ANT_D 0.05

/**
 * @brief Speed of the wavefront in m/s.
 *
 * Equals speed of light.
 */
#define WAVE_SPEED 299792458

/** PI constant */
#define PI 3.14159265358979323846

/** @brief DFE antennas switching configuration structure
 */
struct dfe_antenna_config{
	/** Index of antenna used for reference period */
	u8_t ref_ant_idx;
	/** Index of antenna used at start of CTE and after end of CTE
	* (suggested to use the same antenna as for ref period)
	* */
	u8_t idle_ant_idx;
	 /** The array stores values that should be set to GPIO to enable antenna
	 * with given index. The index of the particular value is the antenna
	 * number. Single bit of the value is set as a value for single GPIO pin.
	 */
	u8_t ant_gpio_pattern[16];
	u8_t ant_gpio_pattern_len;
	/**Array stores indices of antennas to be enabled in particular switch state.
	 * The array does not include reference period antenna and idle antenna.
	 */
	u8_t antennae_switch_idx[48];
	u8_t antennae_switch_idx_len;
};

/** @brief DFE Sampling configuration structure
 */
struct dfe_sampling_config {
	/** Mode of DFE, currently we support on AoA */
	u8_t dfe_mode;
	/** Start point when CTE is added and start point when switching/sampling
	 * is done: after CRC, during packet payload
	 */
	u8_t start_of_sampl;
	/** Length of AoA/AoD procedure in number of 8[us] */
	u8_t number_of_8us;
	/** Process sampling even if CRC error occurs */
	bool en_sampling_on_crc_error;
	/** Limits start DFE to be triggered by TASKS_DFESTART only */
	bool dfe_trigger_task_only;
	/** Type of samples: I/Q or magnitude/phase */
	u8_t sampling_type;
	/** Interval between samples in REFERENCE period */
	u8_t sample_spacing_ref;
	/** Interval between samples in SWITCH period */
	u8_t sample_spacing;
	/** Time delay relative to beginning of reference period before starting
	 * sampling, number of 16M cycles ?
	 */
	s16_t sample_offset;
	/** Time between consecutive antenna switches in SWITCH period of CTE */
	u16_t switch_spacing;
	/** Time delay after end of CRC before starting switching, number of 16M cycles */
	s16_t switch_offset;
	/** Length of guard period - BT defines that to be 4[us] */
	u8_t guard_period_us;
	/** length of reference period - BT defines that to be 8[us] */
	u8_t ref_period_us;
};

/** @brief Returns instance of DFE sampling configuration data structure.
 *
 * @return instance of sampling configuration
 */
const struct dfe_sampling_config *dfe_get_sampling_config();

/** @brief Returns instance of DFE sampling configuration data structure.
 *
 * @return instance of sampling configuration
 */
const struct dfe_antenna_config *dfe_get_antenna_config();

/** @brief Returns configuration of GPIOs that should be used to drive antenna
 * switching by DFE module.
 *
 * @return pointer to GPIOs array
 */
const struct dfe_ant_gpio* dfe_get_ant_gpios_config();

/** @brief Returns length of array returned by @ref dfe_get_ant_gpios_config
 *
 * @return length of array of GPIOs to drive antenna switches
 */
u8_t dfe_get_ant_gpios_config_len();

/** @brief Initializes DFE in Bluetooth controller
 *
 * @param[in] sampl_conf	Sampling configuration
 * @param[in] ant_conf		Antenna switching configuration
 * @param[in] ant_gpio		Array of GPIOs to use to drive antenna switches
 * @param[in] ant_gpio_len	Length of @p ant_gpio array
 *
 * @return Returns zero if DFE is initialized successfully, non zero value in
 * 		   other case.
 */
int dfe_init(const struct dfe_sampling_config *sampl_conf,
	     const struct dfe_antenna_config *ant_conf,
	     const struct dfe_ant_gpio *ant_gpio, u8_t ant_gpio_len);

/** @brief Maps IQ samples to antennas.
 *
 * Maps IQ samples to antennas used to collect particular samples.
 * Radio provides raw IQ samples without information about time and antenna
 * used to collect them.
 *
 * @param[out] 	mapped_data	Storage for mapped IQ samples
 * @param[in] 	raw_data	Raw IQ samples received from BLE controller
 * @param[in] 	sampl_conf	Sampling configuration
 * @param[in] 	ant_conf	Antenna switching configuration
 */
void dfe_map_iq_samples_to_antennas(struct dfe_mapped_packet *mapped_data,
				  const struct dfe_packet *raw_data,
				  const struct dfe_sampling_config *sampling_conf,
				  const struct dfe_antenna_config *ant_config);

/** @brief Removes samples collected in antenna switch slots
 *
 * If samples spacing is shorter than antenna switch spacing then part of samples
 * are collected during antenna switching slots. That samples may be invalid
 * and introduce error. Because of that they are removed from mapped samples set
 * before following steps of evaluation.
 *
 * @param[out]	data		Storage for mapped IQ samples
 * @param[in]	sampl_conf	Sampling configuration
 */
int remove_samples_from_switch_slot(struct dfe_mapped_packet *data,
				    const struct dfe_sampling_config *sampling_conf);

/** @brief Evaluates delay between last reference sample and first sample in
 * antenna switching period.
 *
 * @param[in] sampling_conf	Sampling configuration data
 *
 * @return	Time delay in [ns]
 */
u16_t dfe_delay_before_first_sampl(const struct dfe_sampling_config* sampling_conf);
/** @brief Converts sample spacing settings value to nanoseconds.
 *
 * @param[in] sampling	Spacing configuration value
 *
 * @return Sample spacing in [ns]
 */
u16_t dfe_get_sample_spacing_ns(u8_t sampling);
/** @brief Converts reference sample spacing settings value to nanoseconds.
 *
 * @param[in] sampling	Sampling configuration value
 *
 * @return Sample spacing in [ns]
 */
u16_t dfe_get_sample_spacing_ref_ns(u8_t sampling);

/** @brief Converts antenna switch spacing settings value to nanoseconds.
 *
 * @param[in] spacing	Value of antenna switching setting
 *
 * @return Sample spacing in [ns]
 */
u16_t dfe_get_switch_spacing_ns(u8_t spacing);

/** @brief Provides number of samples collected in single sampling slot
 *
 * @param[in] sampl_conf	Sampling configuration
 *
 * @return Number of samples collected in sampling slot
 */
u16_t dfe_get_sampling_slot_samples_num(const struct dfe_sampling_config *sampling_conf);

/** @brief Provides number of effective antennas used during antenna switching
 * period.
 *
 * @param[in] sampl_conf	Sampling configuration
 *
 * @return Number of antennas used to collect IQ samples except reference period
 */
uint8_t dfe_get_effective_ant_num(const struct dfe_sampling_config *sampling_conf);

#endif /* SRC_DFE_LOCAL_CONFIG_H_ */
```

## src/dfresults.h
```c
/*
 * Copyright (c) 2020 Nordic Semiconductor ASA
 *
 * SPDX-License-Identifier: LicenseRef-BSD-5-Clause-Nordic
 */
#ifndef __DFRESULTS_H
#define __DFRESULTS_H
#include <zephyr/types.h>

/**
 * @brief Calculation results
 *
 * The results of the angle calculation.
 * This structure is used to print out the data.
 */
struct dfresults {
	/**
	 * @brief The phase difference between antennas
	 */
	float phase;
	/**
	 * @brief Calculated aziumth angle in radians.
	 */
	float azimuth;
};

#endif /* __DFRESULTS_H */
```

## src/protocol.c
```c
/*
 * Copyright (c) 2018 Nordic Semiconductor ASA
 *
 * SPDX-License-Identifier: LicenseRef-BSD-5-Clause-Nordic
 */

#include <stddef.h>
#include <stdio.h>
#include <string.h>
#include <errno.h>
#include <assert.h>
#include <math.h>
#include <complex.h>

#include <sys/printk.h>
#include <sys/util.h>

#include "protocol.h"
#include "if.h"



#define SAMPLING_TIME_UNIT (125) //!< smallest possible time between samples [ns]

static struct protocol_data g_protocol_data;


static u16_t protocol_iq_samples_to_string(const struct dfe_sampling_config* sampl_conf,
					   const struct dfe_mapped_packet *mapped_data,
					   char *buffer, uint16_t length)
{
	u16_t strlen = 0;
	u16_t time_u = dfe_get_sample_spacing_ref_ns(sampl_conf->sample_spacing_ref) / SAMPLING_TIME_UNIT;
	u16_t ref_idx;

	for(ref_idx = 0; ref_idx < mapped_data->ref_data.samples_num; ++ref_idx)
	{
		strlen += snprintf(&buffer[strlen], length-strlen,
				   "IQ:%d,%d,%d,%d,%d\r\n",
				   ref_idx,
				   time_u * ref_idx,
				   (int)mapped_data->ref_data.antenna_id,
				   (int)mapped_data->ref_data.data[ref_idx].q,
				   (int)mapped_data->ref_data.data[ref_idx].i);
	}
	/* compute delay  between last sample in reference period and first sample
	 * in antenna switching period.
	 */
	u16_t delay =  dfe_delay_before_first_sampl(sampl_conf) / SAMPLING_TIME_UNIT;
	delay += (time_u * (ref_idx-1));
	time_u = dfe_get_sample_spacing_ns(sampl_conf->sample_spacing) / SAMPLING_TIME_UNIT;

	for(u16_t idx=0; idx<mapped_data->header.length; ++idx)
	{
		const struct dfe_samples* sampl_data = &mapped_data->sampl_data[idx];

		for(u16_t jdx = 0; jdx < sampl_data->samples_num; ++jdx)
		{
			u16_t idx_offset = (sampl_data->samples_num * idx) + jdx;

			strlen += snprintf(&buffer[strlen], length-strlen,
					   "IQ:%d,%d,%d,%d,%d\r\n", ref_idx + idx_offset,
					   delay + (idx_offset) * time_u,
					   (int)sampl_data->antenna_id,
					   (int)sampl_data->data[jdx].q,
					   (int)sampl_data->data[jdx].i);
		}
	}

	return strlen;
}

/** @brief Converts provided IQ samples into string
 *
 * The function stores provided IQ samples into a buffer.
 * Format of a stored data is fixed:
 * - header
 * - sampling settings
 * - not used fields for evaluated angles
 * - IQ samples
 * - footer
 *
 * @param[in]     sampl_config Configuration of sampling
 * @param[in]     mapped_data  IQ samples mapped to antennas
 * @param[in]     results      The algorithm results
 * @param[in,out] buffer       Memory to store string representation
 * @param[in]     len          length of memory provided by @p buffer
 *
 * @return Number of characters stored in transmission buffer.
 */
static u16_t protocol_convert_to_string(const struct dfe_sampling_config* sampl_conf,
					const struct dfe_mapped_packet *mapped_data,
					const struct dfresults *results,
					char *buffer, uint16_t length)
{
	u16_t strlen = 0;
	strlen += snprintf(buffer, length-strlen, "DF_BEGIN\r\n");

	strlen += snprintf(&buffer[strlen], length-strlen, "FR: %u\r\n", mapped_data->header.frequency);
	strlen += snprintf(&buffer[strlen], length-strlen, "MA:%d\r\n", (int)((float)(180.0 / PI) * results->phase));
	strlen += snprintf(&buffer[strlen], length-strlen, "KA:%d\r\n", (int)((float)(180.0 / PI) * results->azimuth));
	strlen += protocol_iq_samples_to_string(sampl_conf, mapped_data, &buffer[strlen], length-strlen);

	strlen += snprintf(&buffer[strlen], length-strlen, "DF_END\r\n");

	return strlen;
}

int protocol_initialization(struct if_data* iface)
{
	if (iface == NULL) {
		printk("[PROTOCOL] - iface is NULL, cannot initialize\r\n");
		return -EINVAL;
	}

	g_protocol_data.uart = iface;
	return 0;
}

int protocol_handling(const struct dfe_sampling_config *sampl_conf,
		      const struct dfe_mapped_packet *mapped_data,
		      const struct dfresults *results)
{
	assert(sampl_conf != NULL);
	assert(mapped_data != NULL);
	uint16_t length = 0;

	length = protocol_convert_to_string(sampl_conf, mapped_data, results,
					    g_protocol_data.string_packet,
					    PROTOCOL_STRING_BUFFER_SIZE);
	g_protocol_data.uart->send(g_protocol_data.string_packet, length);

	return 0;
}
```

## src/protocol.h
```c
/*
 * Copyright (c) 2020 Nordic Semiconductor ASA
 *
 * SPDX-License-Identifier: LicenseRef-BSD-5-Clause-Nordic
 */

#ifndef __PROTOCOL_H
#define __PROTOCOL_H

#include <zephyr/types.h>
#include <bluetooth/dfe_data.h>
#include "dfe_local_config.h"
#include "if.h"
#include "dfresults.h"

/** @brief Header added to data message send via UART
 */
#define PROTOCOL_HEAD				"+AoA"
/** @brief Length of a string buffer used to send data via UART
 */
#define PROTOCOL_STRING_BUFFER_SIZE		10240

/** @brief UARD data transmission structure */
struct protocol_data
{
	/** @brief Member to access UARD port
	 */
	struct if_data *uart;
	/** @brief Transmission data buffer
	 */
	char string_packet[PROTOCOL_STRING_BUFFER_SIZE];
};

/** @brief Initializes data transfer internals.
 *
 * @param[in] iface Pointer to interface data
 *
 * @retval 0 successful initialization
 * @retval -EINVAL if @p iface is NULL
 */
int protocol_initialization(struct if_data *iface);

/** @brief Puts mapped IQ samples into transfer buffer.
 *
 * The function stores IQ samples including information like: mapped antenna
 * index, time delay from the beginning of CTE reception (first sample).
 * Pay attention that antenna index 255 means sample taken during switch period.
 * Time data related with particular samples is an integer value.
 * The unit of the value is 125[us]. E.g. Time 4 means 4*125=500[us].
 *
 * @param[in] smapl_conf  Pointer to sampling configuration
 * @param[in] mapped_data Pointer to IQ samples mapped to antennas
 * @param[in] results     Calculated results
 */
int protocol_handling(const struct dfe_sampling_config *sampl_conf,
		      const struct dfe_mapped_packet *mapped_data,
		      const struct dfresults *results);
#endif
```
