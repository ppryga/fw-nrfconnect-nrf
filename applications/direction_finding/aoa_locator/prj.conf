## CMakeLists.txt
```
#
# Copyright (c) 2018 Nordic Semiconductor ASA
#
# SPDX-License-Identifier: LicenseRef-BSD-5-Clause-Nordic
#

cmake_minimum_required(VERSION 3.13.1)
include($ENV{ZEPHYR_BASE}/cmake/app/boilerplate.cmake NO_POLICY_SCOPE)
project("aoa_locator")

include(${CMAKE_CURRENT_SOURCE_DIR}/version.cmake)

set(NRF_SUPPORTED_BUILD_TYPES
	ZDebug
	ZRelease
  )

if (NOT CMAKE_BUILD_TYPE)
	set(CMAKE_BUILD_TYPE ZDebug)
endif()

zephyr_compile_definitions(
	ARM_MATH_CM4
)

zephyr_include_directories(
	.
 )

target_sources(app PRIVATE src/main.c
	src/dfe_local_config.c
	src/if.c
	src/protocol.c
	src/ble.c
	src/float_ring_buffer.c
	src/average_results.c
	src/dfe_data_preprocess.c
	src/app_version.c
)

#Include DF library
set(DF_LIB_BASE_PATH ${CMAKE_CURRENT_SOURCE_DIR}/../../../../df_aoa_library)
#target_link_directories(app PUBLIC ${DF_LIB_BASE_PATH}/lib)
target_link_libraries(app PRIVATE ${DF_LIB_BASE_PATH}/lib/libdf-fpv4-sp-d16-${ZEPHYR_TOOLCHAIN_VARIANT}.a)
target_include_directories(app PRIVATE ${DF_LIB_BASE_PATH}/include)
target_include_directories(app PRIVATE ${PROJECT_BINARY_DIR}/include)

target_include_directories(app PRIVATE $ENV{ZEPHYR_BASE}/samples/bluetooth)
target_include_directories(app PRIVATE $ENV{ZEPHYR_BASE}/subsys/bluetooth/controller)

configure_file("${PROJECT_SOURCE_DIR}/app_version.h.in" "${PROJECT_BINARY_DIR}/include/app_version.h")
include_directories()

zephyr_linker_sources(ROM_START app_version_sections.ld)
```

## Kconfig
```
#
# Copyright (c) 2018 Nordic Semiconductor ASA
#
# SPDX-License-Identifier: LicenseRef-BSD-5-Clause-Nordic
#

menu "Aoa Locator Connection Less CTE"

config AOA_LOCATOR_UART_PORT
	string "Name of the UART port"
	default "UART_0"

config AOA_LOCATOR_DATA_SEND_WAIT_MS
	int "Number of miliseconds to wait after data is sent over UART."
	default 40
	range 1 100
	help
		The time to wait after a data packet is send.
		It is here because of the PC tool limitations,
		to give it a time for data processing before sending next packet.

config AOA_LOCATOR_PDDA_COARSE_STEP
	int "Step in degrees during coarse step of PDDA correlation"
	default 14
	range 1 30
	help
		The step in degrees in first PDDA correlation.
		First step is responsible for rough estimation of the angle.

config AOA_LOCATOR_PDDA_FINE_STEP
	int "Step in degrees during fine step of PDDA correlation"
	default 3
	range 0 30
	help
		The step in degrees in second PDDA correlation.
		Second step is responsible for fine estimation of the angle.
		If set to 0, no fine step is executed.

endmenu

menu "Zephyr Kernel"
source "$ZEPHYR_BASE/Kconfig.zephyr"
endmenu
```

## prj.conf
```kconfig
#
# Copyright (c) 2018 Nordic Semiconductor ASA
#
# SPDX-License-Identifier: LicenseRef-BSD-5-Clause-Nordic
#

#Set name of final binaries (*.hex and *.elf)
CONFIG_KERNEL_BIN_NAME="aoa_locator"

# General Kernel Options
CONFIG_MAIN_STACK_SIZE=10240
CONFIG_HEAP_MEM_POOL_SIZE=2048
CONFIG_SYSTEM_WORKQUEUE_STACK_SIZE=2048
CONFIG_NEWLIB_LIBC=y
CONFIG_DEBUG=y
CONFIG_DEBUG_OPTIMIZATIONS=y
CONFIG_FPU=y

# BT options
CONFIG_BT=y
CONFIG_BT_OBSERVER=y
CONFIG_BT_DEBUG_LOG=y
CONFIG_BT_CTLR=y
CONFIG_BT_CTLR_DF_SUBSYSTEM=y

# Uart driver and UART configuration
CONFIG_SERIAL=y
CONFIG_UART_NRFX=y
CONFIG_UART_INTERRUPT_DRIVEN=y

# Enable the Direction finding subsystem
CONFIG_BT_CTLR_DF_SUBSYSTEM=y
# Enable receive of CTE(DFE) extension by Bluetooth stack
CONFIG_BT_CTLR_DFE_RX=y
# Set length of CTE
CONFIG_BT_CTLR_DFE_NUMBER_OF_8US=5
# Set antennas switching time
CONFIG_BT_CTLR_DFE_SWITCH_SPACING_2US=y
# Enable regular sampling configuration
CONFIG_BT_CTLR_DFE_SAMPLE_SPACING_1US=y
CONFIG_BT_CTLR_DFE_SAMPLE_SPACING_REF_1US=y
```

## src/main.c
```c
/*
 * Copyright (c) 2020 Nordic Semiconductor ASA
 *
 * SPDX-License-Identifier: LicenseRef-BSD-5-Clause-Nordic
 */

#include <assert.h>
#include <string.h>

#include <kernel.h>
#include <zephyr/types.h>
#include <sys/printk.h>
#include <bluetooth/dfe_data.h>

#include "if.h"
#include "protocol.h"
#include "dfe_local_config.h"
#include "dfe_data_preprocess.h"
#include "ble.h"

#include "aoa.h"
#include "if.h"
#include "ble.h"
#include "protocol.h"

#include "average_results.h"
#include "float_ring_buffer.h"

/** @brief Number of ms to wait for a data before printing no data note
 */
#define WAIT_FOR_DATA_BEFORE_PRINT (1000)

/** @brief Antennas are placed around center and create square,
 * this is number of antennas on single edge of matrix.
 */
#define AOA_MATRIX_SIZE		4
#define ANTENA_DISTANCE 	(0.05f)
#define BLE_WAVE_LEN		(0.125f)
#define AOA_DISTANCE		(ANTENA_DISTANCE/BLE_WAVE_LEN)
#define AOA_FREQUENCY		250000
#define AOA_DEGTORAD		(PI/180)

/** @brief Instance of a data structure to provide access to system calls
 * from aoa_library.
 */
static const struct aoa_system_interface sys_iface =
{
	.uptime_get = k_uptime_get,
};

/** @brief Queue defined by BLE Controller to provide IQ samples data
 */
extern struct k_msgq df_packet_msgq;

/** @brief Variable to store handle received from aoa_library initialization
 */
static void* handle;

/** @brief Variable to store results of AoA evaluation
 */
static struct aoa_results results = {0};
/** @brief Variable to store filtered results of AoA evaluation
 */
static struct aoa_results avg_results;

/** buffer for IQ samples */
static struct dfe_iq_data_storage iq_storage = {
	.slots_num = DFE_TOTAL_SLOTS_NUM,
	.samples_num = DFE_SAMPLES_PER_SLOT_NUM,
};

static struct dfe_slot_samples_storage slots_storage = {
		.slots_num = DFE_TOTAL_SLOTS_NUM,
};

/** @brief Main function of the example.
 *
 * The function is responsible for:
 * - initialization of UART output
 * - initialization of Direction Finding in Bluetooth stack
 * - initialization of Bluetooth stack
 * - initialization of angle of arrival library
 * - receive DFE data from Bluetooth controller
 * - mapping received data to antenna numbers
 * - store raw IQ samples in a transfer buffer
 * - remove IQ samples gathered during antenna switchign
 * - evaluate angle of arrival
 * - filter evaluated angles
 * - store angles in transfer data
 * - forwarding data by UART
 *
 * Steps between receive and forward data are processed in infinite loop.
 */
void main(void)
{
	printk("Starting AoA Locator!\r\n");
	/* initialize UART interface to provide I/Q samples */
	struct if_data* iface = if_initialization();

	if (iface == NULL) {
		printk("Locator stopped!\r\n");
		return;
	}

	int err;

	err = data_transfer_init(iface);
	if (err) {
		printk("Locator stopped!\r\n");
		return;
	}

	const struct dfe_sampling_config* sampl_conf = NULL;
	const struct dfe_antenna_config* ant_conf = NULL;
	const struct dfe_ant_gpio* ant_gpio = NULL;
	u8_t ant_gpio_len = 0;

	sampl_conf = dfe_get_sampling_config();
	ant_conf = dfe_get_antenna_config();
	ant_gpio_len = dfe_get_ant_gpios_config_len();
	ant_gpio = dfe_get_ant_gpios_config();

	assert(sampl_conf != NULL);
	assert(ant_conf != NULL);
	assert(ant_gpio != NULL);
	assert(ant_gpio_len != 0);

	printk("Initialize DFE\r\n");
	err = dfe_init(sampl_conf, ant_conf, ant_gpio, ant_gpio_len);
	if (err) {
		printk("Locator stopped!\r\n");
		return;
	}

	printk("Initialize Bluetooth\r\n");
	ble_initialization();

	struct aoa_configuration aoa_config = {
		.matrix_size = AOA_MATRIX_SIZE,
		//.antennas_num = ant_config->antennae_switch_idx_len,
		.sampling_slots_num = dfe_get_sampling_slots_num(sampl_conf),
		.reference_period = sampl_conf->ref_period_us,
		.ant_switch_spacing = dfe_get_switch_spacing_ns(sampl_conf->switch_spacing) / DFE_NS(1000),
		.sample_spacing_ref = dfe_get_sample_spacing_ref_ns(sampl_conf->sample_spacing_ref),
		.sample_spacing = dfe_get_sample_spacing_ns(sampl_conf->sample_spacing),
		.slot_samples_num = dfe_get_sampling_slot_samples_num(sampl_conf),
		.frequency = AOA_FREQUENCY,
		.array_distance = AOA_DISTANCE,
		.pdda_coarse_step = CONFIG_AOA_LOCATOR_PDDA_COARSE_STEP,
		.pdda_fine_step   = CONFIG_AOA_LOCATOR_PDDA_FINE_STEP
	};

	if (!aoa_initialize(&sys_iface, &aoa_config, &handle)) {
		printk("Aoa initialized\r\n");
	}

	while(1)
	{
		static struct dfe_packet df_data_packet;
		static struct dfe_mapped_packet df_data_mapped;

		//static struct dfe_mapped_packet df_data_cleanet;

		memset(&df_data_packet, 0, sizeof(df_data_packet));
		memset(&df_data_mapped, 0, sizeof(df_data_mapped));
		//memset(&df_data_cleanet, 0, sizeof(df_data_cleanet));
		k_msgq_get(&df_packet_msgq, &df_data_packet, K_MSEC(WAIT_FOR_DATA_BEFORE_PRINT));
		if (df_data_packet.hdr.length != 0) {
			printk("\r\nData arrived...\r\n");

			dfe_map_iq_samples_to_antennas(&df_data_mapped,
										   &iq_storage,
										   &slots_storage,
										   &df_data_packet,
										   sampl_conf, ant_conf);

			data_tranfer_prepare_header();
			data_transfer_prepare_samples(sampl_conf,&df_data_mapped);

			remove_samples_from_switch_slot(&df_data_mapped, sampl_conf);
			int err = aoa_handling(handle, &df_data_mapped, &results);
			if (err) {
				printk("AoA_Handling error: %d! Stopping the evaluation.\r\n", err);
				break;
			}

			err = low_pass_filter_FIR(&results, &avg_results);
			if (err) {
				printk("Averaging error: %d\r\n", err);
				break;
			}
			results.filtered_result.azimuth = avg_results.raw_result.azimuth;
			results.filtered_result.elevation = avg_results.raw_result.elevation;

			data_tranfer_prepare_results(sampl_conf, &results);
			data_tranfer_prepare_footer();
			data_tranfer_send();
		}
		else
		{
			printk("\r\nNo data received.");
		}
		k_sleep(K_MSEC(CONFIG_AOA_LOCATOR_DATA_SEND_WAIT_MS));
	}
}
```

## src/average_results.c
```c
#include <errno.h>
#include <stdbool.h>
#include <assert.h>
#include <math.h>

#include "average_results.h"
#include "float_ring_buffer.h"

#ifndef M_PI
/** PI constant */
#define M_PI		3.14159265358979323846
#endif

/** Convert angle in degrees to complex number
 *
 * Converted angle is a unit vector represented in form of
 * real and imaginary part, because of that it is a complex
 * representation of angle.
 *
 * @param[in] angle	Angle value in degrees
 *
 * @retrun Returns structure that represents complex number.
 */
static struct complex angle_to_complex(float angle);

/** Convert complex number to angle in degrees
 *
 * Converts a unit vector represented in form of
 * real and imaginary part to angle in degrees.
 *
 * @param[in] vector	Complex number that represent angle
 *
 * @retrun Returns angle value in degrees.
 */
float complex_to_angle(struct complex vector);

/** Convert angle in degrees to angle in radians
 *
 * @param[in] angle_deg	Angle value in degrees
 *
 * @retrun Returns angle value in radians
 */
static inline float deg_to_radian(float angle_deg)
{
	return (M_PI / 180.0f) * angle_deg;
}

/** Convert angle in radians to angle in degrees
 *
 * @param[in] angle_rad	Angle value in radians
 *
 * @retrun Returns angle value in degrees
 */
static inline float radian_to_deg(float angle_rad)
{
	return (180.0f / M_PI) * angle_rad;
}

int average_results(const struct aoa_results *results, struct aoa_results* average)
{
	static struct float_ring_buffer azimuth_buffer;
	static struct float_ring_buffer elevation_buffer;

	static struct complex g_azimuth_sum;
	static struct complex g_elevation_sum;

	if (results == NULL || average == NULL) {
		return -EINVAL;
	}

	static bool init = false;

	if (init == false) {
		ring_buffer_init(&azimuth_buffer);
		ring_buffer_init(&elevation_buffer);

		g_azimuth_sum.real = 0.0;
		g_azimuth_sum.imag = 0.0;
		g_elevation_sum.real = 0.0;
		g_elevation_sum.imag = 0.0;

		init = true;
	}

	struct complex oldest_data = { 0.0, 0.0 };

	if( ring_buffer_is_full(&azimuth_buffer)) {
		ring_buffer_pop(&azimuth_buffer, &oldest_data);
	}

	struct complex angle = angle_to_complex(results->raw_result.azimuth);

	g_azimuth_sum.real = g_azimuth_sum.real - oldest_data.real + angle.real;
	g_azimuth_sum.imag = g_azimuth_sum.imag - oldest_data.imag + angle.imag;
	ring_buffer_push(&azimuth_buffer, &angle);
	size_t len = ring_buffer_len(&azimuth_buffer);

	average->raw_result.azimuth = complex_to_angle(g_azimuth_sum);

	oldest_data.real = 0.0;
	oldest_data.imag = 0.0;
	if( ring_buffer_is_full(&elevation_buffer)) {
		ring_buffer_pop(&elevation_buffer, &oldest_data);
	}

	angle = angle_to_complex(results->raw_result.elevation);

	g_elevation_sum.real = g_elevation_sum.real - oldest_data.real + angle.real;
	g_elevation_sum.imag = g_elevation_sum.imag - oldest_data.imag + angle.imag;
	ring_buffer_push(&elevation_buffer, &angle);
	len = ring_buffer_len(&elevation_buffer);

	average->raw_result.elevation = complex_to_angle(g_elevation_sum);

	return 0;
}

int low_pass_filter_IIR(const struct aoa_results *results, struct aoa_results* filtered, float alpha)
{
	if (results == NULL || filtered == NULL) {
		return -EINVAL;
	}

	if (alpha < 0 || alpha > 1) {
		return -EINVAL;
	}

	static float azimuth_sum = 0.0;
	static float elevation_sum = 0.0;

	// LPF -> Y[n] = (1-a)*Y[n-1] + (a*current) = Y[n-1] - a*(Y[n-1] - current);
	azimuth_sum = azimuth_sum - (alpha * (azimuth_sum - results->raw_result.azimuth));
	elevation_sum = elevation_sum - (alpha * (elevation_sum - results->raw_result.elevation));

	filtered->raw_result.azimuth = azimuth_sum;
	filtered->raw_result.elevation = elevation_sum;

	return 0;
}

int low_pass_filter_FIR(const struct aoa_results *results, struct aoa_results* filtered)
{
	if (results == NULL || filtered == NULL) {
		return -EINVAL;
	}

	static struct float_ring_buffer azimuth_buffer;
	static struct float_ring_buffer elevation_buffer;

	static bool init = false;
	if (init == false) {
		ring_buffer_init(&azimuth_buffer);
		ring_buffer_init(&elevation_buffer);

		init = true;
	}

	struct complex angle;

	angle = angle_to_complex(results->raw_result.azimuth);
	ring_buffer_push(&azimuth_buffer, &angle);
	angle = angle_to_complex(results->raw_result.elevation);
	ring_buffer_push(&elevation_buffer, &angle);

	struct complex azimuth_filtered = { 0.0, 0.0 };
	struct complex elevation_filtered = { 0.0, 0.0 };

	size_t len = ring_buffer_len(&azimuth_buffer);
	float alpha = (len == 1) ? 1.0: 2.0/(float)len;
	float dt = alpha/(len+1);

	//for more than one sample do not start from 1.0;
//	if(dt != alpha) {
//		alpha -= dt;
//	}
	alpha = dt;

	struct float_ring_buffer_iter iter;

	ring_buffer_get_iterator(&azimuth_buffer, &iter);

	struct complex sample = {0.0, 0.0};
	while(ring_buffer_iter_is_end(&iter) == false){
		ring_buffer_iter_read(&iter, &sample);

		azimuth_filtered.real += (sample.real * alpha);
		azimuth_filtered.imag += (sample.imag * alpha);
		alpha += dt;

		ring_buffer_iter_advance(&iter);
	}

	ring_buffer_get_iterator(&elevation_buffer, &iter);

	alpha = dt;

	while(ring_buffer_iter_is_end(&iter) == false) {
		ring_buffer_iter_read(&iter, &sample);

		elevation_filtered.real += (sample.real * alpha);
		elevation_filtered.imag += (sample.imag * alpha);
		alpha += dt;
		ring_buffer_iter_advance(&iter);
	}

	filtered->raw_result.azimuth = complex_to_angle(azimuth_filtered);
	filtered->raw_result.elevation = complex_to_angle(elevation_filtered);

	return 0;
}

static struct complex angle_to_complex(float angle)
{
	assert( angle >= 0.0f && angle < 360.0f );

	float_t angle_rad = deg_to_radian(angle);

	struct complex complex_angle;

	complex_angle.real = cos(angle_rad);
	complex_angle.imag = sin(angle_rad);

	return complex_angle;
}

float complex_to_angle(const struct complex vector)
{
	float angle_rad;

	angle_rad = atan2f(vector.imag, vector.real);
	float angle_deg = radian_to_deg(angle_rad);

	angle_deg = (angle_deg >= 0.0f) ? angle_deg : (360.0f + angle_deg);
	return angle_deg;
}
```

## src/average_results.h
```c
#ifndef SRC_AVERAGE_RESULTS_H_
#define SRC_AVERAGE_RESULTS_H_

#include "aoa.h"

/** @brief Evaluates average value of azimuth and elevation angles
 *
 * The function evaluates average values of azimuth and elevation angles
 * form current value and number of historical data stored in ring buffer.
 * Number of historical items stored in ring buffer is equivalent to max
 * ring buffer capacity @see FR_INTERNAL_BUFFER_SIZE.
 *
 * Current result is stored in the ring buffer to be used in a next call
 * as historical data.
 *
 * @param[in] results	current results
 * @param[out] average	averaged results
 *
 * @retval		zero if average evaluated successfully
 * @retval		-EINVAL if @p results or @p average is a NULL pointer
 */
int average_results(const struct aoa_results *results, struct aoa_results* average);

/** @brief Does IIR filtration of azimuth and elevation angles
 *
 * The function uses IIR filter to provide smoothened values of azimuth and
 * elevation angles. The filtered values are evaluated with following formula:
 * [n] = (1-a)*Y[n-1] + (a*current) = Y[n-1] - a*(Y[n-1] - current)
 *
 * @param[in]	results		current results
 * @param[out]	filtered	filtered results
 * @param[in]	alpha		coefficient used to evaluate how much historical data affect
 * 							final result
 *
 * @retval		zero if average evaluated successfully
 * @retval		-EINVAL if @p results or @p average is a NULL pointer
 */
int low_pass_filter_IIR(const struct aoa_results *results, struct aoa_results* filtered, float alpha);

/** @brief Does FIR filtration of azimuth and elevation angles
 *
 * The function uses FIR filter to provide smoothened values of azimuth and
 * elevation angles. It uses current value and number of historical data
 * stored in internal ring buffer. Number of historical items stored
 * in the ring buffer is equivalent to max ring buffer capacity
 * @see FR_INTERNAL_BUFFER_SIZE.
 *
 * Current result is stored in the ring buffer to be used in a next call
 * as historical data.
 *
 * @param[in]	results		current results
 * @param[out]	filtered	filtered results
 *
 * @retval		zero if average evaluated successfully
 * @retval		-EINVAL if @p results or @p average is a NULL pointer
 */
int low_pass_filter_FIR(const struct aoa_results *results, struct aoa_results* filtered);

#endif /* SRC_AVERAGE_RESULTS_H_ */
```

## src/ble.c
```c
/*
 * Copyright (c) 2020 Nordic Semiconductor ASA
 *
 * SPDX-License-Identifier: LicenseRef-BSD-5-Clause-Nordic
 */

#include <sys/printk.h>
#include <bluetooth/bluetooth.h>
#include <bluetooth/hci.h>

#include "ble.h"


int ble_initialization(void)
{
	struct bt_le_scan_param scan_param = {
		.type       = BT_HCI_LE_SCAN_PASSIVE,
		.filter_dup = BT_HCI_LE_SCAN_FILTER_DUP_DISABLE,
		.interval   = 0x0020,
		.window     = 0x0020,
	};
	int err;

	printk("[BT] Initialization started\r\n");

	err = bt_enable(NULL);
	if (err)
	{
		printk("[BT] Initialization failed (err %d)\r\n", err);
		return err;
	}

	printk("[BT] Starting scanning\r\n");
	err = bt_le_scan_start(&scan_param, NULL);
	if (err)
	{
		printk("[BT] Start scanning failed (err %d)\n", err);
		return err;
	}
	return 0;
}
```

## src/ble.h
```c
/*
 * Copyright (c) 2020 Nordic Semiconductor ASA
 *
 * SPDX-License-Identifier: LicenseRef-BSD-5-Clause-Nordic
 */

#ifndef __BLE_H
#define __BLE_H

/** @brief Initialize Bluetooth stack and starts scanning
 */
int ble_initialization();

#endif
```

## src/ble_struct.h
```c
#ifndef __BLE_STRUCT_H
#define __BLE_STRUCT_H



#endif
```

## src/common.c
```c
#include <math.h>

#include "common.h"


static void reverse(char *str, int len)
{
    int i=0, j=len-1, temp;
    while (i<j)
    {
        temp = str[i];
        str[i] = str[j];
        str[j] = temp;
        i++; j--;
    }
}

int int_to_string(int x, char str[], int d)
{
    int i = 0;

    if (x == 0)
    {
    	str[i++] = '0';
    }
    else
    {
        while (x)
        {
            str[i++] = (x%10) + '0';
            x = x/10;
        }
    }

    // If number of digits required is more, then
    // add 0s at the beginning
    while (i < d)
        str[i++] = '0';

    reverse(str, i);
    str[i] = '\0';
    return i;
}

void float_to_string(float n, char *res, int afterpoint)
{
    // Extract integer part
    int ipart = (int)n;

    // Extract floating part
    float fpart = n - (float)ipart;

    // convert integer part to string
    int i = int_to_string(ipart, res, 0);

    // check for display option after point
    if (afterpoint != 0)
    {
        res[i] = '.';  // add dot

        // Get the value of fraction part upto given no.
        // of points after dot. The third parameter is needed
        // to handle cases like 233.007
        fpart = fpart * pow(10, afterpoint);

        int_to_string((int)fpart, res + i + 1, afterpoint);
    }
}
```

## src/common.h
```c
#ifndef __COMMON_H
#define __COMMON_H

#ifdef __cplusplus
extern "C" {
#endif


int int_to_string(int x, char str[], int d);
void float_to_string(float n, char *res, int afterpoint);


#ifdef __cplusplus
}
#endif

#endif
```

## src/dfe_data_preprocess.c
```c
/*
 * Copyright (c) 2020 Nordic Semiconductor ASA
 *
 * SPDX-License-Identifier: LicenseRef-BSD-5-Clause-Nordic
 */

#include <stddef.h>
#include <stdbool.h>
#include <assert.h>
#include <zephyr/types.h>
#include <kernel.h>

#include "dfe_local_config.h"
#include "dfe_data_preprocess.h"

void dfe_map_iq_samples_to_antennas(struct dfe_mapped_packet *mapped_data,
									struct dfe_iq_data_storage *iq_storage,
									struct dfe_slot_samples_storage *slots_storage,
									const struct dfe_packet *raw_data,
									const struct dfe_sampling_config *sampling_conf,
									const struct dfe_antenna_config *ant_config)
{
	assert(raw_data != NULL);
	assert(mapped_data != NULL);

	u16_t ref_samples_num = get_ref_samples_num(sampling_conf);
	mapped_data->ref_data.antenna_id = ant_config->ref_ant_idx;

	for(uint16_t idx = 0; idx < ref_samples_num; ++idx) {
		mapped_data->ref_data.data[idx].i = raw_data->data[idx].iq.i;
		mapped_data->ref_data.data[idx].q = raw_data->data[idx].iq.q;
	}
	mapped_data->ref_data.samples_num = ref_samples_num;

	/* Depending on DFE duration, the number of antennas used for sample
	 * may be greater than the number of antennas in configuration.
	 * If there is time left after end of antennas sequence, then radio
	 * starts to use the same antennas again.
	 */
	u16_t effective_slots_num = dfe_get_effective_slots_num(sampling_conf);

	u8_t samples_num = dfe_get_sampling_slot_samples_num(sampling_conf);

	u8_t effective_sample_idx;

	enum dfe_sampling_type sampling_type = dfe_get_sampling_type(sampling_conf);

	/* For regular sampling configuration antennas are assigned
	 * sequentially from antenna configuration with step 1.
	 *
	 * For undersampling radio does not take samples for every antenna,
	 * but switching continues according to antennae sequence configuration.
	 * So we have to assign every n-th antenna to sampling slot.
	 *
	 * For over sampling radio takes samples even in switching slot, so antenna
	 * step is slower than slots number increate by factor of two.
	 */
	u16_t ant_step = 1;
	if(sampling_type == DFE_UNDER_SAMPLING)
	{
		u16_t sampl_spacing = dfe_get_sample_spacing_ns(sampling_conf->sample_spacing);
		u16_t switch_spacing = dfe_get_switch_spacing_ns(sampling_conf->switch_spacing);

		assert(switch_spacing > 0);
		ant_step = sampl_spacing/switch_spacing;
	}

	for(u16_t slot_idx = 0, ant_idx = 0; slot_idx < effective_slots_num; ++slot_idx) {
		u8_t ant;
		struct dfe_samples *sample = &slots_storage->data[slot_idx];

		if (sampling_type == DFE_OVER_SAMPLING) {
			if (slot_idx & 0x1) {
				ant = DFE_ANT_INCORRECT;
			} else {
				ant = ant_config->antennae_switch_idx[ant_idx];
				ant_idx += ant_step;
				if (ant_idx >= ant_config->antennae_switch_idx_len) {
					ant_idx = 0;
				}
			}
		} else {
			ant = ant_config->antennae_switch_idx[ant_idx];
			ant_idx += ant_step;
			if (ant_idx >= ant_config->antennae_switch_idx_len) {
				ant_idx = 0;
			}
		}

		sample->antenna_id = ant;

		assert(slot_idx <= iq_storage->slots_num);
		assert(samples_num <= iq_storage->samples_num);
		union dfe_iq_f *iq_data = iq_storage->data[slot_idx];

		for(u8_t sample_idx = 0; sample_idx < samples_num; ++sample_idx) {
			effective_sample_idx = ref_samples_num + (slot_idx * samples_num) + sample_idx;
			iq_data[sample_idx].i = raw_data->data[effective_sample_idx].iq.i;
			iq_data[sample_idx].q = raw_data->data[effective_sample_idx].iq.q;
		}
		sample->samples_num = samples_num;
		sample->data = iq_data;
	}

	mapped_data->header.length = effective_slots_num;
	mapped_data->header.frequency = raw_data->hdr.frequency;
	mapped_data->sampl_data = slots_storage->data;
}

int remove_samples_from_switch_slot(struct dfe_mapped_packet *data,
				    const struct dfe_sampling_config *sampling_conf)
{
	assert(data != NULL);
	assert(sampling_conf != NULL);

	u16_t out_idx = 0;
	u16_t in_idx = 0;

	for( ; in_idx < data->header.length; ++in_idx) {
		assert(in_idx >= out_idx);
		const struct dfe_samples *sample_in = &data->sampl_data[in_idx];

		if (sample_in->antenna_id != DFE_ANT_INCORRECT) {
			struct dfe_samples *sample_out = &data->sampl_data[out_idx];

			sample_out->antenna_id = sample_in->antenna_id;
			sample_out->samples_num = sample_in->samples_num;

			for(u8_t sample_idx = 0; sample_idx <= sample_in->samples_num; ++sample_idx) {
				sample_out->data[sample_idx].i = sample_in->data[sample_idx].i;
				sample_out->data[sample_idx].q = sample_in->data[sample_idx].q;
			}
			++out_idx;
		}
	}

	/* update length to new effective antenna number */
	data->header.length = out_idx;

	return 0;
}
```

## src/dfe_data_preprocess.h
```c
/*
 * Copyright (c) 2020 Nordic Semiconductor ASA
 *
 * SPDX-License-Identifier: LicenseRef-BSD-5-Clause-Nordic
 */

#ifndef SRC_DFE_DATA_PREPROCESS_H_
#define SRC_DFE_DATA_PREPROCESS_H_

#include <bluetooth/dfe_data.h>
#include "dfe_samples_data.h"

/** @brief Storage for IQ samples collected during CTE sampling
 *
 * Size of a storage is based on settings provided by application configuration
 * (@ref DFE_TOTAL_SLOTS_NUM, @ref DFE_SAMPLES_PER_SLOT_NUM).
 */
struct dfe_iq_data_storage {
	uint16_t slots_num;					//!< number of slots
	uint8_t samples_num;				//!< number of samples in a single slot
	union dfe_iq_f data[DFE_TOTAL_SLOTS_NUM][DFE_SAMPLES_PER_SLOT_NUM];
};

/** @brief Storage for slots data holding IQ samples
 *
 *  * Size of a storage is based on settings provided by application configuration
 * (@ref DFE_TOTAL_SLOTS_NUM).
 */
struct dfe_slot_samples_storage {
	uint16_t slots_num;					//!< number of slots holding IQ samples
	struct dfe_samples data[DFE_TOTAL_SLOTS_NUM];
};

/** @brief Maps IQ samples to antennas.
 *
 * Maps IQ samples to antennas used to collect particular samples.
 * Radio provides raw IQ samples without information about time and antenna
 * used to collect them.
 *
 * @note To decrease memory footprint the application is responsible to provide
 * storage for IQ samples and collect them into sets for every sampling slot
 * The library receives only pointers to data and mapping information.
 *
 * @param[out] mapped_data		Storage for mapped data for PDDA evaluation
 * @param[out] iq_storage		Storage for IQ samples
 * @param[out] slots_storage	Storage for sampling slots data
 * @param[in] raw_data		Raw IQ samples received from BLE controller
 * @param[in] sampl_conf	Sampling configuration
 * @param[in] ant_conf		Antenna switching configuration
 */
void dfe_map_iq_samples_to_antennas(struct dfe_mapped_packet *mapped_data,
									struct dfe_iq_data_storage *iq_storage,
									struct dfe_slot_samples_storage *slots_storage,
									const struct dfe_packet *raw_data,
									const struct dfe_sampling_config *sampling_conf,
									const struct dfe_antenna_config *ant_config);

/** @brief Removes samples collected in antenna switch slots
 *
 * If samples spacing is shorter than antenna switch spacing then part of samples
 * are collected during antenna switching slots. That samples may be invalid
 * and introduce error. Because of that they are removed from mapped samples set
 * before following steps of evaluation.
 *
 * @param[out]	data		Storage for mapped IQ samples
 * @param[in]	sampl_conf	Sampling configuration
 */
int remove_samples_from_switch_slot(struct dfe_mapped_packet *data,
				    const struct dfe_sampling_config *sampling_conf);

/** @brief Evaluates delay between last reference sample and first sample in
 * antenna switching period.
 *
 * @param[in]	sampling_conf	Sampling configuration
 *
 * @return	Time delay in [ns]
 */

#endif /* SRC_DFE_DATA_PREPROCESS_H_ */
```

## src/dfe_local_config.c
```c
/*
 * Copyright (c) 2020 Nordic Semiconductor ASA
 *
 * SPDX-License-Identifier: LicenseRef-BSD-5-Clause-Nordic
 */

#include <stddef.h>
#include <stdbool.h>
#include <assert.h>
#include <zephyr/types.h>
#include <kernel.h>
#include <nrf.h>

#include "dfe_local_config.h"

const static struct dfe_sampling_config g_sampl_config = {
	.dfe_mode = RADIO_DFEMODE_DFEOPMODE_AoA,
	.start_of_sampl = RADIO_DFECTRL1_DFEINEXTENSION_CRC,
	.number_of_8us = CONFIG_BT_CTLR_DFE_NUMBER_OF_8US,
	.en_sampling_on_crc_error = false,
	.dfe_trigger_task_only = true,
	.sampling_type = RADIO_DFECTRL1_SAMPLETYPE_IQ,
	.sample_spacing_ref = CONFIG_BT_CTLR_DFE_SAMPLE_SPACING_REF_VAL,
	.sample_spacing = CONFIG_BT_CTLR_DFE_SAMPLE_SPACING_VAL,
	.sample_offset = 1,
	.switch_spacing = CONFIG_BT_CTLR_DFE_SWITCH_SPACING_VAL,
	.switch_offset = 0,
	.guard_period_us = 4,
	.ref_period_us = 8,
};

const static struct dfe_antenna_config g_ant_conf = {
	.ref_ant_idx = 11,
	.idle_ant_idx = 11,
	.ant_gpio_pattern = {0, 5, 6, 4, 9, 10, 8, 13, 14, 12, 1, 2, 0},
	.ant_gpio_pattern_len = 13,
	.antennae_switch_idx = {12,1,2,10,3,9,4,8,7,6,5},
	.antennae_switch_idx_len = 11
};

const static struct dfe_ant_gpio g_gpio_conf[4] = {
		{0, 3}, {1,4}, {2, 28}, {3,29}
};

/** @brief Creates switching pattern array
 *
 * The function converts provided antenna indices into array of
 * switch patterns that will be applied by radios DFE module to switch antennas.
 *
 * @param[out]	array				Pointer where to store patterns
 * @param[in]	len					Length of @p array
 * @param[in]	gpio_patterns		Array of GPIO patterns
 * @param[in]	gpio_patterns_len	Length of @p gpio_patterns
 * @param[in]	switch_array		Array with antenna indices
 * @param[in]	switch_array_len	Length of @p switch_array
 *
 * @retval 0		switch pattern array created successfully
 * @retval -EINVAL	one of pointers is NULL or one of lengths is zero
 */
static int create_switching_pattern_array(u8_t *array, u8_t len,
		const u8_t *gpio_patterns, u8_t gpio_patterns_len,
		const u8_t *switch_array, u8_t switch_array_len);

/** @brief Evaluates duration of antenna switching period
 *
 * @param[in] sampling_conf	Sampling configuration
 *
 * @return Duration in [ns]
 */
static u32_t get_switching_duration_ns(const struct dfe_sampling_config *sampling_conf);


const struct dfe_sampling_config* dfe_get_sampling_config()
{
	return &g_sampl_config;
}

const struct dfe_antenna_config* dfe_get_antenna_config()
{
	return &g_ant_conf;
}

const struct dfe_ant_gpio* dfe_get_ant_gpios_config()
{
	return &g_gpio_conf[0];
}

u8_t dfe_get_ant_gpios_config_len()
{
	return ARRAY_SIZE(g_gpio_conf);
}

int dfe_init(const struct dfe_sampling_config *sampl_conf,
	     const struct dfe_antenna_config *ant_conf,
	     const struct dfe_ant_gpio *ant_gpio, u8_t ant_gpio_len)
{
	assert(sampl_conf != NULL);
	assert(ant_conf != NULL);
	assert(ant_gpio != NULL);
	assert(ant_gpio_len != 0);

	int err = 0;

	err = dfe_set_mode(sampl_conf->dfe_mode);
	if (err) {
		printk("[DFE] - DFE mode is unknown\n");
		return -EINVAL;
	}

	err = dfe_set_duration(sampl_conf->number_of_8us);
	if(err) {
		printk("Error! Number of 8us periods is out of allowed range!\r\n");
		return err;
	}

	err = dfe_set_start_point(sampl_conf->start_of_sampl);
	if(err) {
		printk("Error! DFE start point value is out of allowed range!\r\n");
		return err;
	}

	dfe_set_sample_on_crc_error(sampl_conf->en_sampling_on_crc_error);

	dfe_set_trig_dfe_start_task_only(true);

	err = dfe_set_sampling_spacing_ref(sampl_conf->sample_spacing_ref);
	if(err) {
		printk("Error! Reference sample spacing value is out of range!\r\n");
		return err;
	}
	err = dfe_set_sampling_type(sampl_conf->sampling_type);
	if(err) {
		printk("Error! Sampling type value is out of range!\r\n");
		return err;
	}
	err = dfe_set_sample_spacing(sampl_conf->sample_spacing);
	if(err) {
		printk("Error! Sample spacing value is out of range!\r\n");
		return err;
	}
	err = dfe_set_backoff_gain(0);
	if(err) {
		printk("Error! Gain backoff value is out of range!\r\n");
		return err;
	}
	err = dfe_set_switch_offset(sampl_conf->switch_offset);
	if(err) {
		printk("Error! Switch offset value is out of range!\r\n");
		return err;
	}
	err = dfe_set_sample_offset(sampl_conf->sample_offset);
	if(err) {
		printk("Error! Sampling offset value is out of range!\r\n");
		return err;
	}

	err = dfe_set_ant_switch_spacing(sampl_conf->switch_spacing);
	if(err) {
		printk("Error! Antenna switch spacing is out of range!\r\n");
		return err;
	}

	err = dfe_set_ant_gpios(ant_gpio, ant_gpio_len);
	if(err) {
		printk("Error! Number of GPIO for antennas switching is to large!\r\n");
		return err;
	}

	u8_t pattern_array[ant_conf->antennae_switch_idx_len];
	err = create_switching_pattern_array(pattern_array,
				       ant_conf->antennae_switch_idx_len,
				       ant_conf->ant_gpio_pattern,
				       ant_conf->ant_gpio_pattern_len,
				       ant_conf->antennae_switch_idx,
				       ant_conf->antennae_switch_idx_len);
	if(err) {
		printk("Error! Preparation of switch patterns array failed!\r\n");
		return err;
	}

	err = dfe_set_ant_gpio_patterns(ant_conf->ant_gpio_pattern[ant_conf->idle_ant_idx],
					ant_conf->ant_gpio_pattern[ant_conf->ref_ant_idx],
					pattern_array,
					ant_conf->antennae_switch_idx_len);
	if(err) {
		printk("Error! Initialization of gpio patterns failed!\r\n");
		return err;
	}
	return 0;
}

static int create_switching_pattern_array(u8_t *array, u8_t len,
					  const u8_t *gpio_patterns,
					  u8_t gpio_patterns_len,
					  const u8_t *switch_array,
					  u8_t switch_array_len)
{

	if (array == NULL || len == 0 || gpio_patterns == NULL ||
	    gpio_patterns_len == 0 || switch_array == NULL ||
	    switch_array_len == 0 || len < switch_array_len) {
		return -EINVAL;
	}

	for (u8_t idx = 0; idx < switch_array_len; ++idx) {
		if (switch_array[idx] >= gpio_patterns_len)
			return -ERANGE;
	}

	for (u8_t idx = 0; idx < len; ++idx) {
		array[idx] = gpio_patterns[switch_array[idx]];
	}

	return 0;
}

static u32_t get_switching_duration_ns(const struct dfe_sampling_config *sampling_conf)
{
	assert(sampling_conf != NULL);

	u32_t swiching_duration_us = ((sampling_conf->number_of_8us * DFE_US(8)) -
			(sampling_conf->guard_period_us + sampling_conf->ref_period_us));

	return (swiching_duration_us * DFE_NS(1000));
}

uint16_t dfe_get_effective_slots_num(const struct dfe_sampling_config *sampling_conf)
{
	assert(sampling_conf != NULL);

	u32_t switching_duration_ns = get_switching_duration_ns(sampling_conf);
	u32_t switch_spacing_ns = dfe_get_switch_spacing_ns(sampling_conf->switch_spacing);

	u16_t effective_slots_num = (switching_duration_ns / switch_spacing_ns);
	enum dfe_sampling_type sampling_type = dfe_get_sampling_type(sampling_conf);

	switch(sampling_type)
	{
		case DFE_OVER_SAMPLING:
			effective_slots_num = (effective_slots_num*2);
			break;
		case DFE_UNDER_SAMPLING:
		{
			u8_t ant_num_divider = dfe_get_sample_spacing_ns(sampling_conf->sample_spacing) /
							       dfe_get_switch_spacing_ns(sampling_conf->switch_spacing);
			effective_slots_num = (effective_slots_num / ant_num_divider);
			break;
		}
		case DFE_REGULAR_SAMPLING:
		default:
			break;
	}

	return effective_slots_num;
}

uint16_t dfe_get_sampling_slots_num(const struct dfe_sampling_config *sampling_conf)
{
	assert(sampling_conf != NULL);

	u32_t switching_duration_ns = get_switching_duration_ns(sampling_conf);
	u32_t switch_spacing_ns = dfe_get_switch_spacing_ns(sampling_conf->switch_spacing);

	u16_t effective_slots_num = (switching_duration_ns / switch_spacing_ns);
	enum dfe_sampling_type sampling_type = dfe_get_sampling_type(sampling_conf);

	switch(sampling_type)
	{
		case DFE_UNDER_SAMPLING:
		{
			u8_t ant_num_divider = dfe_get_sample_spacing_ns(sampling_conf->sample_spacing) /
							       dfe_get_switch_spacing_ns(sampling_conf->switch_spacing);
			effective_slots_num = (effective_slots_num / ant_num_divider);
			break;
		}
		case DFE_OVER_SAMPLING:
		case DFE_REGULAR_SAMPLING:
		default:
			break;
	}

	return effective_slots_num;
}

u16_t dfe_get_switch_spacing_ns(u8_t spacing)
{
	u16_t spacing_ns = 0;
	switch(spacing) {
		case 0:
			spacing_ns = DFE_NS(8000);
			break;
		case RADIO_DFECTRL1_TSWITCHSPACING_4us:
			spacing_ns = DFE_NS(4000);
			break;
		case RADIO_DFECTRL1_TSWITCHSPACING_2us:
			spacing_ns = DFE_NS(2000);
			break;
		case RADIO_DFECTRL1_TSWITCHSPACING_1us:
			spacing_ns = DFE_NS(1000);
			break;
		default:
			return -1;
	}
	return spacing_ns;
}

u16_t dfe_get_sample_spacing_ns(u8_t sampling)
{
	u16_t sampling_ns = 0;
	switch(sampling) {
		case RADIO_DFECTRL1_TSAMPLESPACING_4us:
			sampling_ns = DFE_NS(4000);
			break;
		case RADIO_DFECTRL1_TSAMPLESPACING_2us:
			sampling_ns = DFE_NS(2000);
			break;
		case RADIO_DFECTRL1_TSAMPLESPACING_1us:
			sampling_ns = DFE_NS(1000);
			break;
		case RADIO_DFECTRL1_TSAMPLESPACING_500ns:
			sampling_ns = DFE_NS(500);
			break;
		case RADIO_DFECTRL1_TSAMPLESPACING_250ns:
			sampling_ns = DFE_NS(250);
			break;
		case RADIO_DFECTRL1_TSAMPLESPACING_125ns:
			sampling_ns = DFE_NS(125);
			break;
		default:
			sampling_ns = -1;
	}
	return sampling_ns;
}

u16_t dfe_get_sample_spacing_ref_ns(u8_t sampling) {

	u16_t sampling_ns = 0;
	switch(sampling) {
		case RADIO_DFECTRL1_TSAMPLESPACINGREF_4us:
			sampling_ns = DFE_NS(4000);
			break;
		case RADIO_DFECTRL1_TSAMPLESPACINGREF_2us:
			sampling_ns = DFE_NS(2000);
			break;
		case RADIO_DFECTRL1_TSAMPLESPACINGREF_1us:
			sampling_ns = DFE_NS(1000);
			break;
		case RADIO_DFECTRL1_TSAMPLESPACINGREF_500ns:
			sampling_ns = DFE_NS(500);
			break;
		case RADIO_DFECTRL1_TSAMPLESPACINGREF_250ns:
			sampling_ns = DFE_NS(250);
			break;
		case RADIO_DFECTRL1_TSAMPLESPACINGREF_125ns:
			sampling_ns = DFE_NS(125);
			break;
		default:
			sampling_ns = -1;
	}
	return sampling_ns;
}

u16_t dfe_get_sampling_slot_samples_num(const struct dfe_sampling_config *sampling_conf)
{
	assert(sampling_conf != NULL);

	u16_t sample_spacing_ns = dfe_get_sample_spacing_ns(sampling_conf->sample_spacing);
	u16_t swich_spacing_ns = dfe_get_switch_spacing_ns(sampling_conf->switch_spacing);
	/* Switch spacing time is a duration between antenna switch so it holds
	 * switch slot and sample slot. Because of that in case of over sampling
	 * we take as valid samples only half of them. In case sampling duration
	 * is greater or equal all samples are valid.
	 * of
	 */
	assert(sample_spacing_ns != 0);

	if (swich_spacing_ns > sample_spacing_ns) {
		return swich_spacing_ns / (sample_spacing_ns * 2);
	} else {
		return sample_spacing_ns / sample_spacing_ns;
	}
}

u16_t get_ref_samples_num(const struct dfe_sampling_config* sampling_conf)
{
	assert(sampling_conf != NULL);

	u16_t sample_spacing_ns = dfe_get_sample_spacing_ref_ns(sampling_conf->sample_spacing_ref);
	return sampling_conf->ref_period_us * DFE_NS(1000) / sample_spacing_ns;
}

enum dfe_sampling_type dfe_get_sampling_type(const struct dfe_sampling_config *sampling_conf)
{
	assert(sampling_conf != NULL);

	/* Please note that values used by radio to set switch spacing and
	 * sample spacing are in reverse order. That means higher value, shorter
	 * duration. E.g. :
	 *  - RADIO_DFECTRL1_TSAMPLESPACING_4us (1UL) [4us]
	    - RADIO_DFECTRL1_TSAMPLESPACING_2us (2UL) [2us]
	 * Because of that logic here is opposite.
	 */
	if (sampling_conf->switch_spacing > sampling_conf->sample_spacing) {
		return DFE_UNDER_SAMPLING;
	} else if (sampling_conf->switch_spacing == sampling_conf->sample_spacing) {
		return DFE_REGULAR_SAMPLING;
	} else {
		return DFE_OVER_SAMPLING;
	}
}

u16_t dfe_delay_before_first_sampl(const struct dfe_sampling_config* sampling_conf)
{
	assert(sampling_conf != NULL);

	u16_t swich_spacing_ns = dfe_get_switch_spacing_ns(sampling_conf->switch_spacing);
	u16_t ref_spacing_ns = dfe_get_sample_spacing_ref_ns(sampling_conf->sample_spacing_ref);

	assert(swich_spacing_ns != 0);
	return (swich_spacing_ns >> 1) + ref_spacing_ns;
}
```

## src/dfe_local_config.h
```c
/*
 * Copyright (c) 2020 Nordic Semiconductor ASA
 *
 * SPDX-License-Identifier: LicenseRef-BSD-5-Clause-Nordic
 */


#ifndef SRC_DFE_LOCAL_CONFIG_H_
#define SRC_DFE_LOCAL_CONFIG_H_

#include <bluetooth/dfe_config.h>
#include <bluetooth/dfe_data.h>
#include "dfe_samples_data.h"

#define DFE_NS(ns)	(ns)
#define DFE_US(us)	(us)

/** Macro for incorrect antenna index */
#define DFE_ANT_INCORRECT (0xFF)

/** @brief DFE antennas switching configuration structure
 */
struct dfe_antenna_config
{
	/** Index of antenna used for reference period */
	u8_t ref_ant_idx;
	/** Index of antenna used at start of CTE and after end of CTE
	* (suggested to use the same antenna as for ref period)
	*/
	u8_t idle_ant_idx;
	 /** The array stores values that should be set to GPIO to enable antenna
	 * with given index. The index of the particular value is the antenna
	 * number. Single bit of the value is set as a value for single GPIO pin.
	 */
	u8_t ant_gpio_pattern[16];
	u8_t ant_gpio_pattern_len;
	/** Array stores indices of antennas to be enabled in particular switch state.
	 * The array does not include reference period antenna and idle antenna.
	 */
	u8_t antennae_switch_idx[48];
	u8_t antennae_switch_idx_len;
};

/** @brief DFE Sampling configuration structure
 */
struct dfe_sampling_config
{
	/** Mode of DFE, currently we support on AoA */
	u8_t dfe_mode;
	/** Start point when CTE is added and start point when switching/sampling
	 * is done: after CRC, during packet payload
	 */
	u8_t start_of_sampl;
	/** Length of AoA/AoD procedure in number of 8[us] */
	u8_t number_of_8us;
	/** @brief Process sampling even if CRC error occurs
	 */
	bool en_sampling_on_crc_error;
	/** Limits start DFE to be triggered by TASKS_DFESTART only */
	bool dfe_trigger_task_only;
	/** Type of samples: I/Q or magnitude/phase */
	u8_t sampling_type;
	/** Interval between samples in REFERENCE period */
	u8_t sample_spacing_ref;
	/** Interval between samples in SWITCH period */
	u8_t sample_spacing;
	/** Time delay relative to beginning of reference period before starting
	 * sampling, number of 16M cycles ?
	 */
	s16_t sample_offset;
	/** Time between consecutive antenna switches in SWITCH period of CTE */
	u16_t switch_spacing;
	/** Time delay after end of CRC before starting switching, number of 16M cycles */
	s16_t switch_offset;
	/** Length of guard period - BT defines that to be 4[us] */
	u8_t guard_period_us;
	/** Length of reference period - BT defines that to be 8[us] */
	u8_t ref_period_us;
};

/** @brief DFE sampling type.
 *
 * Sampling of received CTE may be configured to produce:
 * - regular sampling, when antenna switch spacing is equal to samples spacing
 * - over sampling, when antenna switch spacing is longer than samples spacing
 * - under sampling, when antenna switch spacing is shorter than samples spacing
 *
 * @note This applies for samples taken in antenna switching period of CTE receive.
 */
enum dfe_sampling_type {
	DFE_REGULAR_SAMPLING = 0,
	DFE_OVER_SAMPLING,
	DFE_UNDER_SAMPLING
};


/** @brief Returns instance of DFE sampling configuration data structure.
 *
 * @return instance of sampling configuration
 */
const struct dfe_sampling_config *dfe_get_sampling_config();

/** @brief Returns instance of DFE sampling configuration data structure.
 *
 * @return instance of antenna switching configuration
 */
const struct dfe_antenna_config *dfe_get_antenna_config();

/** @brief Returns configuration of GPIOs that should be used to drive antenna
 * switching by DFE module.
 *
 * @return pointer to GPIOs array
 */
const struct dfe_ant_gpio* dfe_get_ant_gpios_config();

/** @brief Returns length of array returned by dfe_get_ant_gpios_config
 *
 * @return length of array of GPIOs to drive antenna switches
 */
u8_t dfe_get_ant_gpios_config_len();

/** @brief Initializes DFE in Bluetooth controller
 *
 * @param[in] sampl_conf	Sampling configuration
 * @param[in] ant_conf		Antenna switching configuration
 * @param[in] ant_gpio		Array of GPIOs to use to drive antenna switches
 * @param[in] ant_gpio_len	Length of @p ant_gpio array
 *
 * @return Returns zero if DFE is initialized successfully, non zero value in
 * 		   other case.
 */
int dfe_init(const struct dfe_sampling_config *sampl_conf,
	     const struct dfe_antenna_config *ant_conf,
	     const struct dfe_ant_gpio *ant_gpio, u8_t ant_gpio_len);

/** @brief Provide information about sampling type.
 *
 * Function provides information about type of a sampling that is
 * configured for DFE. To check possible sampling types see @ref dfe_sampling_type.
 *
 * @param[in] sampling_conf	Sampling configuration
 *
 * @return dfe_sampling_type Configured type of a sampling
 */
enum dfe_sampling_type dfe_get_sampling_type(const struct dfe_sampling_config *sampling_conf);

/** @brief Evaluates delay between last reference sample and first sample in
 * antenna switching period.
 *
 * @param[in]	sampling_conf	Sampling configuration
 *
 * @return	Time delay in [ns]
 */
u16_t dfe_delay_before_first_sampl(const struct dfe_sampling_config* sampling_conf);

/** @brief Converts sample spacing settings value to nanoseconds.
 *
 * @param[in] sampling	Value of sampling setting
 *
 * @return Sample spacing in [ns]
 */
u16_t dfe_get_sample_spacing_ns(u8_t sampling);

/** @brief Converts reference sample spacing settings value to nanoseconds.
 *
 * @param[in] sampling	Value of reference sampling setting
 *
 * @return Sample spacing in [ns]
 */
u16_t dfe_get_sample_spacing_ref_ns(u8_t sampling);

/** @brief Converts antenna switch spacing settings value to nanoseconds.
 *
 * @param[in] spacing	Value of antenna switching setting
 *
 * @return Sample spacing in [ns]
 */
u16_t dfe_get_switch_spacing_ns(u8_t spacing);

/** @brief Provides number of samples collected in single sampling slot
 *
 * @param[in] sampl_conf	Sampling configuration
 *
 * @return Number of samples collected in sampling slot
 */
u16_t dfe_get_sampling_slot_samples_num(const struct dfe_sampling_config *sampling_conf);

/** @brief Provides effective number of slots during antenna switching period.
 *
 * It includes valid sampling slots and slots when IQ samples are collected
 * during antenna switching.
 *
 * @param[in] sampl_conf	Sampling configuration
 *
 * @return Number of slots used to collect IQ samples except reference period
 */
uint16_t dfe_get_effective_slots_num(const struct dfe_sampling_config *sampling_conf);

/** @brief Provides number of valid sampling slots during antenna switching period.
 *
 * Number returned provides information about valid slots only.
 *
 * @param[in] sampl_conf	Sampling configuration
 *
 * @return Number of slots used to collect IQ samples except reference period
 */
uint16_t dfe_get_sampling_slots_num(const struct dfe_sampling_config *sampling_conf);

/** @brief Evaluates number of samples collected in reference period
 *
 * @param[in] sampling_conf	Sampling configuration
 *
 * @return Number of samples
 */
u16_t get_ref_samples_num(const struct dfe_sampling_config* sampling_conf);

#endif /* SRC_DFE_LOCAL_CONFIG_H_ */
```

## src/float_ring_buffer.c
```c
#include "float_ring_buffer.h"
#include <errno.h>
#include <string.h>
#include <assert.h>

static size_t advance_pointer(size_t ptr, size_t max_size)
{
	return ((ptr + 1) < max_size) ? (ptr+1) : 0;
}

void ring_buffer_reset(struct float_ring_buffer *buf)
{
	assert(buf != NULL);
	buf->tail = 0;
	buf->head = 0;
	memset(buf, 0, buf->max_len * sizeof(float));
}

void ring_buffer_init(struct float_ring_buffer *buf)
{
	assert(buf != NULL);
	buf->max_len = FR_INTERNAL_BUFFER_SIZE;
	ring_buffer_reset(buf);
}

bool ring_buffer_is_full(struct float_ring_buffer *buf)
{
	assert(buf != NULL);
	size_t head = advance_pointer(buf->head, buf->max_len);;

	return (buf->tail == head);
}

bool ring_buffer_is_empty(struct float_ring_buffer *buf)
{
	return (buf->tail == buf->head);
}

size_t ring_buffer_max_len(struct float_ring_buffer *buf)
{
	assert(buf != NULL);
	return buf->max_len-1;
}

size_t ring_buffer_len(struct float_ring_buffer *buf)
{
	assert(buf != NULL);
	int len;

	if (buf->head >= buf->tail) {
		len = (buf->head - buf->tail);
	} else {
		len = ((buf->max_len - buf->tail) + buf->head);
	}

	return len;
}

void ring_buffer_push(struct float_ring_buffer *buf, struct complex *data)
{
	assert(buf != NULL);
	buf->buffer[buf->head] = *data;

	buf->head = advance_pointer(buf->head, buf->max_len);

	if(buf->head == buf->tail) {
		buf->tail = advance_pointer(buf->tail, buf->max_len);
	}
}

int ring_buffer_pop(struct float_ring_buffer *buf, struct complex *data)
{
	if (buf == NULL || data == NULL) {
		return -EINVAL;
	}

	int err;

	if (ring_buffer_is_empty(buf)) {
		err = -ENODATA;
	} else {
		*data = buf->buffer[buf->tail];
		buf->tail = advance_pointer(buf->tail, buf->max_len);
		err = 0;
	}

	return err;
}


int ring_buffer_get_iterator(struct float_ring_buffer *buf,
			     struct float_ring_buffer_iter *iter)
{
	if ( buf == NULL || iter == NULL) {
		return -EINVAL;
	}

	iter->buf = buf;
	iter->idx = buf->tail;

	return 0;
}

int ring_buffer_iter_advance(struct float_ring_buffer_iter *iter)
{
	if (iter == NULL) {
		return -EINVAL;
	}

	iter->idx = (iter->idx + 1) % iter->buf->max_len;

	return 0;
}

int ring_buffer_iter_reset(struct float_ring_buffer_iter *iter)
{
	if (iter == NULL) {
		return -EINVAL;
	}

	iter->idx = iter->buf->tail;

	return 0;
}

bool ring_buffer_iter_is_end(struct float_ring_buffer_iter *iter)
{
	assert(iter != NULL);
	if (iter->idx == iter->buf->head) {
		return true;
	} else {
		return false;
	}
}

int ring_buffer_iter_get(struct float_ring_buffer_iter *iter, struct complex *data)
{
	if (iter == NULL || data == NULL) {
		return -EINVAL;
	}

	int err = ring_buffer_iter_read(iter, data);
	if (!err) {
		err = ring_buffer_iter_advance(iter);
	}

	return err;
}

int ring_buffer_iter_read(struct float_ring_buffer_iter *iter, struct complex *data)
{
	if (iter == NULL || data == NULL) {
		return -EINVAL;
	}

	*data = iter->buf->buffer[iter->idx];

	return 0;
}
```
