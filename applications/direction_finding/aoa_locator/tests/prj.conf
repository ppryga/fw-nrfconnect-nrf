## CMakeLists.txt
```
# SPDX-License-Identifier: Apache-2.0

cmake_minimum_required(VERSION 3.13.1)
include($ENV{ZEPHYR_BASE}/cmake/app/boilerplate.cmake NO_POLICY_SCOPE)
project("aoa_locator_tests" VERSION 0.1)

set(NRF_SUPPORTED_BUILD_TYPES
	ZDebug
	ZRelease
  )

if (NOT CMAKE_BUILD_TYPE)
	set(CMAKE_BUILD_TYPE ZDebug)
endif()

#Include DF library
set(DF_LIB_BASE_PATH ${CMAKE_CURRENT_SOURCE_DIR}/../../../../../df_aoa_library)
target_include_directories(app PRIVATE ${DF_LIB_BASE_PATH}/include
					../src)

#application settins
target_sources(app PRIVATE src/main.c
	src/dfe_samples_mapping_test.c
	src/configuration_fixtures.c
	src/dfe_configuration_tests.c
	../src/dfe_data_preprocess.c
	../src/dfe_local_config.c)

target_sources(app PRIVATE ${app_sources})
```

## prj.conf
```kconfig
#Set name of final binaries (*.hex and *.elf)
CONFIG_KERNEL_BIN_NAME="aoa_locator_tests"

CONFIG_ZTEST=y

# All below configuarion entries are required to provide
# required configuration options to get everything that
# is required to compile code that depends on types and macros
# created for Direction Finding
# If there is a split between Controller and Application then
# this part should be not required to include.

# BT options
CONFIG_BT=y
CONFIG_BT_CTLR=y

# Enable the Direction finding subsystem
CONFIG_BT_CTLR_DF_SUBSYSTEM=y

# Enable receive of CTE(DFE) extension by Bluetooth stack
CONFIG_BT_CTLR_DFE_RX=y

# Set length of CTE
CONFIG_BT_CTLR_DFE_NUMBER_OF_8US=20

# Set antennas switching time
CONFIG_BT_CTLR_DFE_SWITCH_SPACING_2US=y

# Enable oversampling configuration to provide enough memory for all kind
# of tests. Pay attention if you change it some tests may fail or even 
# some fault exception may be thrown.
CONFIG_BT_CTLR_DFE_SAMPLE_SPACING_2US=n
CONFIG_BT_CTLR_DFE_SAMPLE_SPACING_250NS=y
CONFIG_BT_CTLR_DFE_SAMPLE_SPACING_REF_1US=n
CONFIG_BT_CTLR_DFE_SAMPLE_SPACING_REF_250NS=y
```

## src/main.c
```c
/*
 * Copyright (c) 2017 Intel Corporation
 *
 * SPDX-License-Identifier: Apache-2.0
 */

#if !defined(CONFIG_CPU_CORTEX_M)
  #error project can only run on Cortex-M
#endif

#include <ztest.h>
#include "dfe_samples_mapping_test.h"
#include "configuration_fixtures.h"
#include "dfe_configuration_tests.h"

void test_main(void)
{
	ztest_test_suite(sampling_type_tests,
		ztest_unit_test_setup_teardown(test_sampling_type_when_oversampling_configured, setup_fixture_prepare_over_sampling, common_teardown),
		ztest_unit_test_setup_teardown(test_sampling_type_when_bt_1us_slot_configured, setup_fixture_prepare_bt_sampling_1us_switch_slot, common_teardown),
		ztest_unit_test_setup_teardown(test_sampling_type_when__bt_2us_slot_configured, setup_fixture_prepare_bt_sampling_2us_switch_slot, common_teardown),
		ztest_unit_test_setup_teardown(test_sampling_type_when_undersampling_configured_ommit_2nd_slot, setup_fixture_prepare_undersampling_sample_every_2nd_slot, common_teardown),
		ztest_unit_test_setup_teardown(test_sampling_type_when_undersampling_configured_ommit_4nd_slot, setup_fixture_prepare_undersampling_sample_every_4th_slot, common_teardown));

	ztest_test_suite(calculation_of_effective_slots_tests,
		ztest_unit_test_setup_teardown(test_calculation_of_effective_slots_number_for_oversampling, setup_fixture_prepare_over_sampling, common_teardown),
		ztest_unit_test_setup_teardown(test_calculation_of_effective_slots_number_for_ble_1us_slot, setup_fixture_prepare_bt_sampling_1us_switch_slot, common_teardown),
		ztest_unit_test_setup_teardown(test_calculation_of_effective_slots_number_for_ble_2us_slot, setup_fixture_prepare_bt_sampling_2us_switch_slot, common_teardown),
		ztest_unit_test_setup_teardown(test_calculation_of_effective_slots_number_for_under_sampling, setup_fixture_prepare_undersampling_sample_every_2nd_slot, common_teardown),
		ztest_unit_test_setup_teardown(test_calculation_of_effective_slots_number_for_under_sampling, setup_fixture_prepare_undersampling_sample_every_4th_slot, common_teardown));

	ztest_test_suite(test_iq_samples_and_antenna_mapping,
		ztest_unit_test_setup_teardown(test_iq_samples_to_ant_mapping_if_oversampling_configured, setup_fixture_prepare_iq_data_and_over_sampling_config, common_teardown),
		ztest_unit_test_setup_teardown(test_iq_samples_to_ant_mapping_if_ble_compliant_sampling_is_configured, setup_fixture_prepare_bt_sampling_1us_switch_slot, common_teardown),
		ztest_unit_test_setup_teardown(test_iq_samples_to_ant_mapping_if_ble_compliant_sampling_is_configured, setup_fixture_prepare_bt_sampling_2us_switch_slot, common_teardown),
		ztest_unit_test_setup_teardown(test_iq_samples_to_ant_mapping_if_undersampling_is_configured, setup_fixture_prepare_undersampling_sample_every_2nd_slot, common_teardown),
		ztest_unit_test_setup_teardown(test_iq_samples_to_ant_mapping_if_undersampling_is_configured, setup_fixture_prepare_undersampling_sample_every_4th_slot, common_teardown));

	ztest_test_suite(test_remove_samples_from_switching_slots,
		ztest_unit_test_setup_teardown(test_remove_samples_from_switching_slots_every_2nd_slot_to_remove, setup_fixture_prepare_over_sampling, common_teardown),
		ztest_unit_test_setup_teardown(test_remove_samples_from_switching_slots_all_slots_to_remove, setup_fixture_prepare_over_sampling, common_teardown),
		ztest_unit_test_setup_teardown(test_remove_samples_from_switching_slots_no_slot_to_remove, setup_fixture_prepare_over_sampling, common_teardown));


	ztest_run_test_suite(sampling_type_tests);
	ztest_run_test_suite(calculation_of_effective_slots_tests);
	ztest_run_test_suite(test_iq_samples_and_antenna_mapping);
	ztest_run_test_suite(test_remove_samples_from_switching_slots);
}
```

## src/configuration_fixtures.c
```c
/*
 * Copyright (c) 2020 Nordic Semiconductor ASA
 *
 * SPDX-License-Identifier: LicenseRef-BSD-5-Clause-Nordic
 */
#include <ztest.h>

#include <dfe_local_config.h>
#include "configuration_fixtures.h"

/** @brief Test instance for the DFE configuration */
static struct dfe_sampling_config g_test_sampl_config = {
	.dfe_mode = RADIO_DFEMODE_DFEOPMODE_AoA,
	.start_of_sampl = RADIO_DFECTRL1_DFEINEXTENSION_CRC,
	.number_of_8us = CONFIG_BT_CTLR_DFE_NUMBER_OF_8US,
	.en_sampling_on_crc_error = false,
	.dfe_trigger_task_only = true,
	.sampling_type = RADIO_DFECTRL1_SAMPLETYPE_IQ,
	.sample_spacing_ref = CONFIG_BT_CTLR_DFE_SAMPLE_SPACING_REF_VAL,
	.sample_spacing = CONFIG_BT_CTLR_DFE_SAMPLE_SPACING_VAL,
	.sample_offset = 1,
	.switch_spacing = CONFIG_BT_CTLR_DFE_SWITCH_SPACING_VAL,
	.switch_offset = 0,
	.guard_period_us = 4,
	.ref_period_us = 8,
};

/** @brief Test instance for the DFE antenna configuration */
static struct dfe_antenna_config g_test_ant_conf = {
	.ref_ant_idx = 11,
	.idle_ant_idx = 11,
	.ant_gpio_pattern = {0, 5, 6, 4, 9, 10, 8, 13, 14, 12, 1, 2, 0},
	.ant_gpio_pattern_len = 13,
	.antennae_switch_idx = {12,1,2,10,3,9,4,8,7,6,5},
	.antennae_switch_idx_len = 11
};

void setup_fixture_prepare_over_sampling()
{
	g_test_sampl_config.number_of_8us = 20;	/* 20 * 8us = 160us */
	g_test_sampl_config.sample_spacing_ref = TSAMPLESPACING_REF_250ns;
	g_test_sampl_config.sample_spacing = TSAMPLESPACING_250ns;
	g_test_sampl_config.switch_spacing = TSWITCHSPACING_2us;
}

void prepare_config_cte160_sampling2us_switch2us()
{
	g_test_sampl_config.number_of_8us = 20;	/* 20 * 8us = 160us */
	g_test_sampl_config.sample_spacing_ref = TSAMPLESPACING_REF_1us;
	g_test_sampl_config.sample_spacing = TSAMPLESPACING_2us;
	g_test_sampl_config.switch_spacing = TSWITCHSPACING_2us;
}

void setup_fixture_prepare_bt_sampling_1us_switch_slot()
{
	g_test_sampl_config.number_of_8us = 20;	/* 20 * 8us = 160us */
	g_test_sampl_config.sample_spacing_ref = TSAMPLESPACING_REF_1us;
	g_test_sampl_config.sample_spacing = TSAMPLESPACING_2us;
	g_test_sampl_config.switch_spacing = TSWITCHSPACING_2us;
}

void setup_fixture_prepare_bt_sampling_2us_switch_slot()
{
	g_test_sampl_config.number_of_8us = 20;	/* 20 * 8us = 160us */
	g_test_sampl_config.sample_spacing_ref = TSAMPLESPACING_REF_1us;
	g_test_sampl_config.sample_spacing = TSAMPLESPACING_4us;
	g_test_sampl_config.switch_spacing = TSWITCHSPACING_4us;
}

void setup_fixture_prepare_undersampling_sample_every_2nd_slot()
{
	g_test_sampl_config.number_of_8us = 20;	/* 20 * 8us = 160us */
	g_test_sampl_config.sample_spacing_ref = TSAMPLESPACING_REF_1us;
	g_test_sampl_config.sample_spacing = TSAMPLESPACING_4us;
	g_test_sampl_config.switch_spacing = TSWITCHSPACING_2us;
}

void setup_fixture_prepare_undersampling_sample_every_4th_slot()
{
	g_test_sampl_config.number_of_8us = 20;	/* 20 * 8us = 160us */
	g_test_sampl_config.sample_spacing_ref = TSAMPLESPACING_REF_1us;
	g_test_sampl_config.sample_spacing = TSAMPLESPACING_4us;
	g_test_sampl_config.switch_spacing = TSWITCHSPACING_1us;
}

void common_teardown()
{

}

struct dfe_sampling_config  *get_test_sampl_config()
{
	return &g_test_sampl_config;
}

struct dfe_antenna_config *get_test_ant_config()
{
	return &g_test_ant_conf;
}
```

## src/configuration_fixtures.h
```c
/*
 * Copyright (c) 2020 Nordic Semiconductor ASA
 *
 * SPDX-License-Identifier: LicenseRef-BSD-5-Clause-Nordic
 */

#ifndef TESTS_SRC_CONFIGURATION_FIXTURES_H_
#define TESTS_SRC_CONFIGURATION_FIXTURES_H_

enum sample_spacing {
	TSAMPLESPACING_4us = (1UL), 	/*!< 1us */
	TSAMPLESPACING_2us = (2UL), 	/*!< 2us */
	TSAMPLESPACING_1us = (3UL), 	/*!< 1us */
	TSAMPLESPACING_500ns = (4UL), 	/*!< 0.5us */
	TSAMPLESPACING_250ns = (5UL), 	/*!< 0.25us */
	TSAMPLESPACING_125ns = (6UL), 	/*!< 0.125us */
};

enum ref_spacing {
	TSAMPLESPACING_REF_4us = (1UL), 	/*!< 1us */
	TSAMPLESPACING_REF_2us = (2UL), 	/*!< 2us */
	TSAMPLESPACING_REF_1us = (3UL), 	/*!< 1us */
	TSAMPLESPACING_REF_500ns = (4UL), 	/*!< 0.5us */
	TSAMPLESPACING_REF_250ns = (5UL), 	/*!< 0.25us */
	TSAMPLESPACING_REF_125ns = (6UL), 	/*!< 0.125us */
};

enum switch_spacing {
	TSWITCHSPACING_4us = (1UL), 	/*!< 1us */
	TSWITCHSPACING_2us = (2UL), 	/*!< 2us */
	TSWITCHSPACING_1us = (3UL), 	/*!< 1us */
};

/** @brief Fixture to prepare IQ sampling configuration with settings
 * that enable oversampling.
 *
 * The function prepares configuration of CTE receive with following
 * parameters:
 * - CTE duration
 * - antenna switch spacing
 * - samples spacing in reference period
 * - samples spacing in antenna switching period
 * The configuration here is an oversampling it means there will be more
 * samples than allowed by BLE Specification.
 *
 * @Note Pay attention that Nordics radio does sampling also in switch slots.
*/
void setup_fixture_prepare_over_sampling();

/** @brief Fixture to prepare IQ sampling configuration with settings
 * that enable regular sampling with 1us switch slot (BLE compliant configuration).
 *
 * The function prepares configuration of CTE receive with following
 * parameters:
 * - CTE duration
 * - antenna switch spacing
 * - samples spacing in reference period
 * - samples spacing in antenna switching period
 * The configuration here is a regular sampling it complies with BLE Specification.
 * Also it means there will be the same number of samples as number of sampling slots.
*/
void setup_fixture_prepare_bt_sampling_1us_switch_slot();

/** @brief Fixture to prepare IQ sampling configuration with settings
 * that enable regular sampling with 2us switch slot (BLE compliant configuration).
 *
 * The function prepares configuration of CTE receive with following
 * parameters:
 * - CTE duration
 * - antenna switch spacing
 * - samples spacing in reference period
 * - samples spacing in antenna switching period
 * The configuration here is a regular sampling it complies with BLE Specification.
 * Also it means there will be the same number of samples as number of sampling slots.
*/
void setup_fixture_prepare_bt_sampling_2us_switch_slot();

/** @brief Fixture to prepare IQ sampling configuration with settings
 * that enable under sampling with every 2nd sampling slot taken.
 *
 * The function prepares configuration of CTE receive with following
 * parameters:
 * - CTE duration
 * - antenna switch spacing
 * - samples spacing in reference period
 * - samples spacing in antenna switching period
 * The configuration here is an under sampling it does not comply with BLE Specification.
 * Also it means there will be a sample provided every n-th sampling slot.
*/
void setup_fixture_prepare_undersampling_sample_every_2nd_slot();

/** @brief Fixture to prepare IQ sampling configuration with settings
 * that enable under sampling with every 4th sampling slot taken.
 *
 * The function prepares configuration of CTE receive with following
 * parameters:
 * - CTE duration
 * - antenna switch spacing
 * - samples spacing in reference period
 * - samples spacing in antenna switching period
 * The configuration here is an under sampling it does not comply with BLE Specification.
 * Also it means there will be a sample provided every n-th sampling slot.
*/
void setup_fixture_prepare_undersampling_sample_every_4th_slot();

/** @brief Common teardown procedure
 */
void common_teardown();

/** @brief Returns test instance of sampling configuration
 *
 * @return dfe_sampling_config* Pointer to sampling configuration instance.
 */
struct dfe_sampling_config *get_test_sampl_config();

/** @brief Returns test instance of antennas configuration
 *
 * @return dfe_antenna_config* Pointer to antenna configuration instance.
 */
struct dfe_antenna_config *get_test_ant_config();

#endif /* TESTS_SRC_CONFIGURATION_FIXTURES_H_ */
```

## src/dfe_configuration_tests.c
```c
/*
 * Copyright (c) 2020 Nordic Semiconductor ASA
 *
 * SPDX-License-Identifier: LicenseRef-BSD-5-Clause-Nordic
 */

#include <ztest.h>
#include "configuration_fixtures.h"
#include "dfe_configuration_tests.h"
#include "configuration_fixtures.h"
#include <dfe_local_config.h>

void test_sampling_type_when_oversampling_configured()
{
	struct dfe_sampling_config *sampl_config = get_test_sampl_config();

	enum dfe_sampling_type sampling_type = dfe_get_sampling_type(sampl_config);
	zassert_equal(DFE_OVER_SAMPLING, sampling_type, "Wrong sampling type");
}

void test_sampling_type_when_bt_1us_slot_configured()
{
	struct dfe_sampling_config *sampl_config = get_test_sampl_config();

	enum dfe_sampling_type sampling_type = dfe_get_sampling_type(sampl_config);
	zassert_equal(DFE_REGULAR_SAMPLING, sampling_type, "Wrong sampling type");
}

void test_sampling_type_when__bt_2us_slot_configured()
{
	struct dfe_sampling_config *sampl_config = get_test_sampl_config();

	enum dfe_sampling_type sampling_type = dfe_get_sampling_type(sampl_config);
	zassert_equal(DFE_REGULAR_SAMPLING, sampling_type, "Wrong sampling type");
}

void test_sampling_type_when_undersampling_configured_ommit_2nd_slot()
{
	struct dfe_sampling_config *sampl_config = get_test_sampl_config();

	enum dfe_sampling_type sampling_type = dfe_get_sampling_type(sampl_config);
	zassert_equal(DFE_UNDER_SAMPLING, sampling_type, "Wrong sampling type");
}

void test_sampling_type_when_undersampling_configured_ommit_4nd_slot()
{
	struct dfe_sampling_config *sampl_config = get_test_sampl_config();

	enum dfe_sampling_type sampling_type = dfe_get_sampling_type(sampl_config);
	zassert_equal(DFE_UNDER_SAMPLING, sampling_type, "Wrong sampling type");
}

void test_calculation_of_effective_slots_number_for_oversampling()
{
	struct dfe_sampling_config *sampl_config = get_test_sampl_config();

	uint16_t effective_slots_num = dfe_get_effective_slots_num(sampl_config);
	const uint16_t expected_slots_num = 148; // (148 / 2us) * 2 -> CTE divided by ant switch, times 2 because of oversampling
	zassert_equal(effective_slots_num, expected_slots_num,
				  "Wrong slots number for oversampling configuration");
}

void test_calculation_of_effective_slots_number_for_ble_1us_slot()
{
	struct dfe_sampling_config *sampl_config = get_test_sampl_config();

	uint16_t effective_slots_num = dfe_get_effective_slots_num(sampl_config);
	const uint16_t expected_slots_num = 74; // 148us / 2us = 74 - sample is taken only in sampling slot
	zassert_equal(effective_slots_num, expected_slots_num,
				  "Wrong slots number for regular configuration");
}

void test_calculation_of_effective_slots_number_for_ble_2us_slot()
{
	struct dfe_sampling_config *sampl_config = get_test_sampl_config();

	uint16_t effective_slots_num = dfe_get_effective_slots_num(sampl_config);
	const uint16_t expected_slots_num = 37; // 148us / 4us = 37 - sample is taken only in sampling slot
	zassert_equal(effective_slots_num, expected_slots_num,
				  "Wrong slots number for regular configuration");
}

void test_calculation_of_effective_slots_number_for_under_sampling()
{
	struct dfe_sampling_config *sampl_config = get_test_sampl_config();

	uint16_t effective_slots_num = dfe_get_effective_slots_num(sampl_config);
	printk("ef slots num %d", effective_slots_num);
	const uint16_t expected_slots_num = 37; // 148us/2us/(2us/4us) = 37 - sample is taken every second sampling slot
	zassert_equal(effective_slots_num, expected_slots_num,
				  "Wrong slots number for under sampling configuration");
}
```

## src/dfe_configuration_tests.h
```c
/*
 * Copyright (c) 2020 Nordic Semiconductor ASA
 *
 * SPDX-License-Identifier: LicenseRef-BSD-5-Clause-Nordic
 */
#ifndef TESTS_SRC_DFE_CONFIGURATION_TESTS_H_
#define TESTS_SRC_DFE_CONFIGURATION_TESTS_H_

void test_sampling_type_when_oversampling_configured();
void test_sampling_type_when_bt_1us_slot_configured();
void test_sampling_type_when__bt_2us_slot_configured();
void test_sampling_type_when_undersampling_configured_ommit_2nd_slot();
void test_sampling_type_when_undersampling_configured_ommit_4nd_slot();

void test_calculation_of_effective_slots_number_for_oversampling();
void test_calculation_of_effective_slots_number_for_ble_1us_slot();
void test_calculation_of_effective_slots_number_for_ble_2us_slot();
void test_calculation_of_effective_slots_number_for_under_sampling();

#endif /* TESTS_SRC_DFE_CONFIGURATION_TESTS_H_ */
```

## src/dfe_samples_mapping_test.c
```c
/*
 * Copyright (c) 2020 Nordic Semiconductor ASA
 *
 * SPDX-License-Identifier: LicenseRef-BSD-5-Clause-Nordic
 */
#include <ztest.h>

#include "dfe_samples_mapping_test.h"
#include <dfe_local_config.h>
#include <dfe_data_preprocess.h>
#include "configuration_fixtures.h"

/** @brief Storage for artificial DFE data packet.*/
static struct dfe_packet g_test_df_data_packet;
static struct dfe_mapped_packet g_test_df_data_mapped;

/** @brief Test buffer for IQ samples */
static struct dfe_iq_data_storage g_test_iq_storage = {
	.slots_num = DFE_TOTAL_SLOTS_NUM,
	.samples_num = DFE_SAMPLES_PER_SLOT_NUM,
};

/** @brief Test buffer for slots storage */
static struct dfe_slot_samples_storage g_test_slots_storage = {
		.slots_num = DFE_TOTAL_SLOTS_NUM,
};

/** @brief Prepare artificial IQ data as if they were collected
 * by radio when oversampling is enabled.
 *
 * The data are prepared in as if they were collected by radio with following
 * settings:
 * - CTE duration 160us
 * - Reference sampling 250ns
 * - Antenna switch spacing 2us (1us for switch slot, 1us for sample slot)
 * - Samples spacing 250ns
 *
 * Total number of samples in reference period is 8us * 1us/0.250 = 32
 * Antenna switching duration is: 160us - 12us = 148us
 * Total number of samples in antenna switching period is 148 * (1us/0.250) = 592
 */
static void prepare_raw_iq_data_for_max_storage(struct dfe_packet* df_data_packet)
{
	for(int idx = 0; idx < DFE_TOTAL_SAMPLES_NUM; ++idx) {
		df_data_packet->data[idx].iq.i = idx;
		df_data_packet->data[idx].iq.q = 2*idx;
	}
	df_data_packet->hdr.length = DFE_TOTAL_SAMPLES_NUM;
}

void setup_fixture_prepare_iq_data_and_over_sampling_config()
{
	setup_fixture_prepare_over_sampling();
	prepare_raw_iq_data_for_max_storage(&g_test_df_data_packet);
}

void test_iq_samples_to_ant_mapping_if_oversampling_configured(void)
{
	memset(&g_test_df_data_mapped, 0, sizeof(g_test_df_data_mapped));

	struct dfe_sampling_config *sampl_config = get_test_sampl_config();
	struct dfe_antenna_config *ant_conf = get_test_ant_config();

	dfe_map_iq_samples_to_antennas(&g_test_df_data_mapped,
								   &g_test_iq_storage,
								   &g_test_slots_storage,
								   &g_test_df_data_packet,
								   sampl_config, ant_conf);

	/* In case of oversampling a number of samples must be set as taken in
	 * switching slot. Those samples must be discarded before angles evaluation.
	 * Check if appropriate samples are marked as invalid by ant idx set to 0xFF.
	 * If we take 4 samples in a slot, then we have following series:
	 * ANT_X, ANT_X, ANT_X, ANT_X, 0xFF, 0xFF, 0xFF, 0xFF, ANT_X1, ANT_X1...
	 * For configuration where 8 samples is taken in a slot the sequence will
	 * consist of following 8 valid samples, then 8 invalid, etc...
	 */

	uint8_t samples_in_slot = dfe_get_sampling_slot_samples_num(sampl_config);
	zassert_not_equal(samples_in_slot, 0, "There may not be 0 samples in a single slot");

	uint16_t effective_slots_num = dfe_get_effective_slots_num(sampl_config);
	zassert_equal(g_test_df_data_mapped.header.length, effective_slots_num,
				  "Wrong length of mapped IQ data");

	for(uint16_t slot_idx = 0, ant_idx=0; slot_idx < effective_slots_num; ++slot_idx) {
		if(slot_idx & 0x1) {
			zassert_equal(g_test_df_data_mapped.sampl_data[slot_idx].antenna_id, 0xFF,
						  "Wrong antenna id, it should be 0xFF for discarded samples");
		} else {
			uint8_t ant_num = ant_conf->antennae_switch_idx[ant_idx++];
			if(ant_idx >= ant_conf->antennae_switch_idx_len) {
				ant_idx = 0;
			}
			zassert_equal(g_test_df_data_mapped.sampl_data[slot_idx].antenna_id, ant_num,
						  "Wrong antenna idx found. Does not match to configuration");
		}
	}
}

void test_iq_samples_to_ant_mapping_if_ble_compliant_sampling_is_configured(void)
{
	struct dfe_sampling_config *sampl_config = get_test_sampl_config();
	struct dfe_antenna_config *ant_conf = get_test_ant_config();

	memset(&g_test_df_data_mapped, 0, sizeof(g_test_df_data_mapped));

	dfe_map_iq_samples_to_antennas(&g_test_df_data_mapped,
								   &g_test_iq_storage,
								   &g_test_slots_storage,
								   &g_test_df_data_packet,
								   sampl_config, ant_conf);

	/* In case of sampling that complies BLE specification There are no slots
	 * that should be discarded.
	 */
	uint8_t samples_in_slot = dfe_get_sampling_slot_samples_num(sampl_config);
	zassert_not_equal(samples_in_slot, 0, "There may not be 0 samples in a single slot");

	uint16_t effective_slots_num = dfe_get_effective_slots_num(sampl_config);
	zassert_equal(g_test_df_data_mapped.header.length, effective_slots_num,
				  "Wrong length of mapped IQ data");

	for(uint16_t slot_idx = 0; slot_idx < effective_slots_num; ++slot_idx) {
		uint8_t ant_num = ant_conf->antennae_switch_idx[slot_idx % ant_conf->antennae_switch_idx_len];
		zassert_equal(g_test_df_data_mapped.sampl_data[slot_idx].antenna_id, ant_num,
					  "Wrong antenna idx found. Does not match to configuration");
	}
}

void test_iq_samples_to_ant_mapping_if_undersampling_is_configured(void)
{
	struct dfe_sampling_config *sampl_config = get_test_sampl_config();
	struct dfe_antenna_config *ant_conf = get_test_ant_config();

	memset(&g_test_df_data_mapped, 0, sizeof(g_test_df_data_mapped));

	dfe_map_iq_samples_to_antennas(&g_test_df_data_mapped,
								   &g_test_iq_storage,
								   &g_test_slots_storage,
								   &g_test_df_data_packet,
								   sampl_config, ant_conf);

	/* In case of under-sampling there will be no slot to be discarded (no antenna
	 * with 0xFF. Antenna identifiers will map to every n-th antenna from configuration.
	 * N-th step depends on sample spacing in comparison to switch spacing.
	 */
	uint16_t samples_spacing = dfe_get_sample_spacing_ref_ns(sampl_config->sample_spacing);
	zassert_not_equal(samples_spacing, 0, "Samples spacing may not be zero");

	uint16_t switch_spacing = dfe_get_switch_spacing_ns(sampl_config->switch_spacing);
	zassert_not_equal(switch_spacing, 0, "Switch spacing may not be zero");

	uint16_t ant_step = samples_spacing / switch_spacing;
	zassert_true(ant_step > 0, "Antenna step in undersampling should be greater than 0");

	uint16_t effective_slots_num = dfe_get_effective_slots_num(sampl_config);
	zassert_equal(g_test_df_data_mapped.header.length, effective_slots_num,
				  "Wrong length of mapped IQ data");

	for(uint16_t slot_idx = 0, ant_idx = 0; slot_idx < effective_slots_num; ++slot_idx) {
		uint8_t ant_num = ant_conf->antennae_switch_idx[ant_idx];
		ant_idx += ant_step;
		if(ant_idx >= ant_conf->antennae_switch_idx_len) {
			ant_idx = 0;
		}
		zassert_equal(g_test_df_data_mapped.sampl_data[slot_idx].antenna_id, ant_num,
					  "Wrong antenna idx found. Does not match to configuration");
	}
}

void prepare_samples_mapped_to_antennas_every_2nd_slot_to_remove()
{
	struct dfe_sampling_config *sampl_config = get_test_sampl_config();

	uint16_t effective_slots_num = dfe_get_effective_slots_num(sampl_config);
	uint8_t samples_num = dfe_get_sampling_slot_samples_num(sampl_config);

	zassert_true((effective_slots_num <= g_test_iq_storage.slots_num), "There is not enough memory for IQ samples for effective slots number");
	zassert_true((effective_slots_num <= g_test_slots_storage.slots_num), "There is not enough memory for slots data storage");
	zassert_true((samples_num <= g_test_iq_storage.samples_num), "Samples number for a slot is greater than memory available in a slot");

	for (uint16_t slot_idx = 0; slot_idx < effective_slots_num; ++slot_idx) {
		union dfe_iq_f *iq_data = g_test_iq_storage.data[slot_idx];

		uint8_t sample_idx = 0;
		for ( ; sample_idx < samples_num; ++sample_idx) {
			iq_data->i = sample_idx;
			iq_data->q = sample_idx;
		}

		if(slot_idx & 0x1) {
			g_test_slots_storage.data[slot_idx].antenna_id = DFE_ANT_INCORRECT;
		} else {
			g_test_slots_storage.data[slot_idx].antenna_id = slot_idx;
		}
		g_test_slots_storage.data[slot_idx].samples_num = samples_num;
		g_test_slots_storage.data[slot_idx].data = iq_data;
	}

	g_test_df_data_mapped.header.length = effective_slots_num;
	g_test_df_data_mapped.sampl_data = g_test_slots_storage.data;
}

void prepare_samples_mapped_to_antennas_no_slots_to_remove()
{
	struct dfe_sampling_config *sampl_config = get_test_sampl_config();

	uint16_t effective_slots_num = dfe_get_effective_slots_num(sampl_config);
	uint8_t samples_num = dfe_get_sampling_slot_samples_num(sampl_config);

	zassert_true((effective_slots_num <= g_test_iq_storage.slots_num), "There is not enough memory for IQ samples for effective slots number");
	zassert_true((effective_slots_num <= g_test_slots_storage.slots_num), "There is not enough memory for slots data storage");
	zassert_true((samples_num <= g_test_iq_storage.samples_num), "Samples number for a slot is greater than memory available in a slot");

	for (uint16_t slot_idx = 0; slot_idx < effective_slots_num; ++slot_idx) {
		union dfe_iq_f *iq_data = g_test_iq_storage.data[slot_idx];

		uint8_t sample_idx = 0;
		for ( ; sample_idx < samples_num; ++sample_idx) {
			iq_data->i = sample_idx;
			iq_data->q = sample_idx;
		}

		g_test_slots_storage.data[slot_idx].antenna_id = slot_idx;
		g_test_slots_storage.data[slot_idx].samples_num = samples_num;
		g_test_slots_storage.data[slot_idx].data = iq_data;
	}

	g_test_df_data_mapped.header.length = effective_slots_num;
	g_test_df_data_mapped.sampl_data = g_test_slots_storage.data;
}

void prepare_samples_mapped_to_antennas_remove_all_slots()
{
	struct dfe_sampling_config *sampl_config = get_test_sampl_config();

	uint16_t effective_slots_num = dfe_get_effective_slots_num(sampl_config);
	uint8_t samples_num = dfe_get_sampling_slot_samples_num(sampl_config);

	zassert_true((effective_slots_num <= g_test_iq_storage.slots_num), "There is not enough memory for IQ samples for effective slots number");
	zassert_true((effective_slots_num <= g_test_slots_storage.slots_num), "There is not enough memory for slots data storage");
	zassert_true((samples_num <= g_test_iq_storage.samples_num), "Samples number for a slot is greater than memory available in a slot");

	for (uint16_t slot_idx = 0; slot_idx < effective_slots_num; ++slot_idx) {
		union dfe_iq_f *iq_data = g_test_iq_storage.data[slot_idx];

		uint8_t sample_idx = 0;
		for ( ; sample_idx < samples_num; ++sample_idx) {
			iq_data->i = sample_idx;
			iq_data->q = sample_idx;
		}

		g_test_slots_storage.data[slot_idx].antenna_id = DFE_ANT_INCORRECT;
		g_test_slots_storage.data[slot_idx].samples_num = samples_num;
		g_test_slots_storage.data[slot_idx].data = iq_data;
	}

	g_test_df_data_mapped.header.length = effective_slots_num;
	g_test_df_data_mapped.sampl_data = g_test_slots_storage.data;
}

void test_remove_samples_from_switching_slots_every_2nd_slot_to_remove()
{
	struct dfe_sampling_config *sampl_config = get_test_sampl_config();

	prepare_samples_mapped_to_antennas_every_2nd_slot_to_remove(&g_test_df_data_packet);
	remove_samples_from_switch_slot(&g_test_df_data_mapped, sampl_config);

	uint16_t effective_slots_num = dfe_get_effective_slots_num(sampl_config);

	for (int slot_idx = 0; slot_idx < g_test_df_data_mapped.header.length; ++slot_idx) {
		zassert_not_equal(g_test_df_data_mapped.sampl_data[slot_idx].antenna_id, DFE_ANT_INCORRECT, "Slot marked as to be discarded found in mapped data");
	}
	effective_slots_num /= 2;
	zassert_equal(g_test_df_data_mapped.header.length, effective_slots_num, "Wrong number of slots found in mapped data");
}

void test_remove_samples_from_switching_slots_no_slot_to_remove()
{
	struct dfe_sampling_config *sampl_config = get_test_sampl_config();

	prepare_samples_mapped_to_antennas_no_slots_to_remove(&g_test_df_data_packet);
	remove_samples_from_switch_slot(&g_test_df_data_mapped, sampl_config);

	uint16_t effective_slots_num = dfe_get_effective_slots_num(sampl_config);

	for (int slot_idx = 0; slot_idx < g_test_df_data_mapped.header.length; ++slot_idx) {
		zassert_not_equal(g_test_df_data_mapped.sampl_data[slot_idx].antenna_id, DFE_ANT_INCORRECT, "Slot marked as to be discarded found in mapped data");
	}

	zassert_equal(g_test_df_data_mapped.header.length, effective_slots_num, "Wrong number of slots found in mapped data");
}

void test_remove_samples_from_switching_slots_all_slots_to_remove()
{
	struct dfe_sampling_config *sampl_config = get_test_sampl_config();

	prepare_samples_mapped_to_antennas_remove_all_slots(&g_test_df_data_packet);
	remove_samples_from_switch_slot(&g_test_df_data_mapped, sampl_config);

	for (int slot_idx = 0; slot_idx < g_test_df_data_mapped.header.length; ++slot_idx) {
		zassert_not_equal(g_test_df_data_mapped.sampl_data[slot_idx].antenna_id, DFE_ANT_INCORRECT, "Slot marked as to be discarded found in mapped data");
	}

	zassert_equal(g_test_df_data_mapped.header.length, 0, "Wrong number of slots found in mapped data");
}
```

## src/dfe_samples_mapping_test.h
```c
/*
 * Copyright (c) 2020 Nordic Semiconductor ASA
 *
 * SPDX-License-Identifier: LicenseRef-BSD-5-Clause-Nordic
 */
#ifndef TESTS_SRC_DFE_SAMPLES_MAPPING_TEST_H_
#define TESTS_SRC_DFE_SAMPLES_MAPPING_TEST_H_

void setup_fixture_prepare_iq_data_and_over_sampling_config();

void test_iq_samples_to_ant_mapping_if_oversampling_configured();
void test_iq_samples_to_ant_mapping_if_ble_compliant_sampling_is_configured();
void test_iq_samples_to_ant_mapping_if_undersampling_is_configured();

void test_remove_samples_from_switching_slots_every_2nd_slot_to_remove();
void test_remove_samples_from_switching_slots_no_slot_to_remove();
void test_remove_samples_from_switching_slots_all_slots_to_remove();

#endif /* TESTS_SRC_DFE_SAMPLES_MAPPING_TEST_H_ */
```
