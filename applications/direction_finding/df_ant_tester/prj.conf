## CMakeLists.txt
```
# SPDX-License-Identifier: Apache-2.0

cmake_minimum_required(VERSION 3.13.1)
include($ENV{ZEPHYR_BASE}/cmake/app/boilerplate.cmake NO_POLICY_SCOPE)
project("nrf_ant_tester" VERSION 0.1)

set(NRF_SUPPORTED_BUILD_TYPES
  ZDebug
  ZRelease
  )

if (NOT CMAKE_BUILD_TYPE)
  set(CMAKE_BUILD_TYPE ZDebug)
endif()

zephyr_compile_definitions(
   ARM_MATH_CM4
)

zephyr_include_directories(
    .
 )

target_sources(app PRIVATE src/main.c
	src/if.c
	src/protocol.c
	src/ble.c
	src/dfe_local_config.c
	src/antenna_test.c
	src/iq_samples_statistics.c
)

target_include_directories(app PRIVATE $ENV{ZEPHYR_BASE}/samples/bluetooth)
target_include_directories(app PRIVATE $ENV{ZEPHYR_BASE}/subsys/bluetooth/controller)
```

## prj.conf
```kconfig
# General Kernel Options
CONFIG_MAIN_STACK_SIZE=2048
CONFIG_HEAP_MEM_POOL_SIZE=2048
CONFIG_SYSTEM_WORKQUEUE_STACK_SIZE=2048
CONFIG_NEWLIB_LIBC=y
CONFIG_DEBUG=y
CONFIG_DEBUG_OPTIMIZATIONS=y
#Set name of final binaries (*.hex and *.elf)
CONFIG_KERNEL_BIN_NAME="df_antenna_tester"

# BT options
CONFIG_BT=y
CONFIG_BT_OBSERVER=y
CONFIG_BT_DEBUG_LOG=y
CONFIG_BT_CTLR=y
CONFIG_BT_CTLR_DF_SUBSYSTEM=y

# Uart driver and UART configuration
CONFIG_SERIAL=y
CONFIG_UART_NRFX=y
CONFIG_UART_INTERRUPT_DRIVEN=y

# Enable the Direction finding subsystem
CONFIG_BT_CTLR_DF_SUBSYSTEM=y
# Enable receive of CTE(DFE) extension by Bluetooth stack
CONFIG_BT_CTLR_DFE_RX=y
# Set length of CTE
CONFIG_BT_CTLR_DFE_NUMBER_OF_8US=5
# Set antennas switching time
CONFIG_BT_CTLR_DFE_SWITCH_SPACING_2US=y
# Enable regular sampling configuration
CONFIG_BT_CTLR_DFE_SAMPLE_SPACING_250NS=y
CONFIG_BT_CTLR_DFE_SAMPLE_SPACING_REF_250NS=y

# Enable logging
CONFIG_LOG=y
CONFIG_LOG_MODE_OVERFLOW=y
CONFIG_LOG_BUFFER_SIZE=4096
CONFIG_LOG_STRDUP_BUF_COUNT=16
CONFIG_LOG_STRDUP_MAX_STRING=256
CONFIG_LOG_PRINTK=y

#CONFIG_LOG_BACKEND_RTT=y

CONFIG_USE_SEGGER_RTT=y
CONFIG_RTT_CONSOLE=y
CONFIG_UART_CONSOLE=n
CONFIG_SEGGER_RTT_BUFFER_SIZE_UP=4096

#enable RTT shell
CONFIG_SHELL=y
CONFIG_SHELL_BACKEND_SERIAL=n
CONFIG_SHELL_BACKEND_RTT=y
CONFIG_SHELL_PROMPT_RTT="nrf-ant-tester:~$ "
```

## src/main.c
```c
/*
 * Copyright (c) 2020 Nordic Semiconductor ASA
 *
 * SPDX-License-Identifier: LicenseRef-BSD-5-Clause-Nordic
 */

#include <assert.h>
#include <string.h>

#include <stdlib.h>
#include <kernel.h>
#include <zephyr/types.h>
#include <bluetooth/dfe_data.h>
#include <shell/shell.h>
#include <shell/shell_rtt.h>

#include "if.h"
#include "protocol.h"
#include "dfe_local_config.h"
#include "ble.h"
#include "antenna_test.h"

#define MODULE df_main
#include <logging/log.h>
LOG_MODULE_REGISTER(MODULE, CONFIG_DF_APP_LOG_LEVEL);

/** @brief Number of ms to wait for a data before printing no data note
 */
#define WAIT_FOR_DATA_BEFORE_PRINT (1000)

/** @brief Shell command handler responsible for antenna testing procedure
 *
 * The command handler accepts single argument that is verbosity.
 * Allowed verbosity levels are in range: @ref TEST_VERBOSITY_LOW to
 * @ref TEST_VERBOSITY_HIGH.
 *
 * @param[in] shell	pointer to shell object
 * @param[in] argc	number of command arguments
 * @param[in] argv	array providing command arguments
 *
 * @retval	0 always return zero
 */
static int start_test(const struct shell *shell, size_t argc, const char **argv)
{
	int verbosity = 1;

	if(argc > 1) {
		int user_verbosity = atoi(argv[1]);
		if (user_verbosity >= TEST_VERBOSITY_LOW &&
			user_verbosity <= TEST_VERBOSITY_HIGH) {
			verbosity = user_verbosity;
		} else {
			shell_print(shell, "Error, verbosity level out of range: %d",
						user_verbosity);
		}
	}

	shell_print(shell, "Antenna matrix test started");

	bool result = run_antenna_test_suite(verbosity);

	if(!result) {
		shell_print(shell, "Antenna matrix test FAILED");
	} else {
		shell_print(shell, "Antenna matrix test SUCCESS");
	}

	return 0;
}

SHELL_CMD_ARG_REGISTER(test, NULL, "Start antennas test. Optionally accepts " \
					   "verbosity level 1-3.", start_test, 0, 1);

/** @brief Main function of the test example.
 *
 */
void main(void)
{
	LOG_INF("Starting DF antenna tester!");
	/* initialize UART interface to provide I/Q samples */
	struct if_data* iface = if_initialization();

	if (iface == NULL) {
		LOG_ERR("Locator stopped!");
		return;
	}

	int err;

	err = protocol_initialization(iface);
	if (err) {
		LOG_ERR("Locator stopped!");
		return;
	}

	LOG_INF("Initialize Bluetooth");
	ble_initialization();

	 while(1)
	 {
	 	k_sleep(K_MSEC(CONFIG_AOA_LOCATOR_DATA_SEND_WAIT_MS));
	 }

	LOG_INF("nRF antenna tester End");
}
```

## src/antenna_test.h
```c
/*
 * Copyright (c) 2020 Nordic Semiconductor ASA
 *
 * SPDX-License-Identifier: LicenseRef-BSD-5-Clause-Nordic
 */

#ifndef DF_ANTENNA_TEST_H_
#define DF_ANTENNA_TEST_H_

/** @brief Verbosity level of test output */
enum test_verbosity_level {
	/** Log most important information as success, fail */
	TEST_VERBOSITY_LOW = 1,
	/** Log information about test substeps evaluation results for */
	TEST_VERBOSITY_MED,
	/** Log detailed information for every tested IQ sample */
	TEST_VERBOSITY_HIGH
};

/* @brief Run antenna tests suite
 *
 * @param[in] verbosity level of test log verbosity
 *
 * @return true if test successful, false otherwise.
 */
bool run_antenna_test_suite(enum test_verbosity_level verbosity);

#endif /* DF_ANTENNA_TEST_H_ */
```

## src/ble.c
```c
/*
 * Copyright (c) 2020 Nordic Semiconductor ASA
 *
 * SPDX-License-Identifier: LicenseRef-BSD-5-Clause-Nordic
 */

#include <sys/printk.h>
#include <bluetooth/bluetooth.h>
#include <bluetooth/hci.h>

#include "ble.h"

#define MODULE df_ble
#include <logging/log.h>
LOG_MODULE_REGISTER(MODULE, CONFIG_DF_APP_LOG_LEVEL);

int ble_initialization(void)
{
	LOG_INF("Initialization started");

	int err = bt_enable(NULL);

	if (err)
	{
		LOG_ERR("Initialization failed (err %d)", err);
	}

	return err;
}


int bt_start_scanning()
{
	struct bt_le_scan_param scan_param = {
		.type       = BT_HCI_LE_SCAN_PASSIVE,
		.filter_dup = BT_HCI_LE_SCAN_FILTER_DUP_DISABLE,
		.interval   = 0x0020,
		.window     = 0x0020,
	};
	int err;

	err = bt_le_scan_start(&scan_param, NULL);
	if (err && err != -EALREADY)
	{
		LOG_ERR("Start scanning failed (err %d)", err);

	}
	return err;
}

int bt_stop_scanning()
{
	int err = bt_le_scan_stop();

	if (err && err != -EALREADY)
	{
		LOG_ERR("Stop scanning failed (err %d)", err);

	}

	return err;
}
```

## src/iq_samples_statistics.c
```c
/*
 * Copyright (c) 2020 Nordic Semiconductor ASA
 *
 * SPDX-License-Identifier: LicenseRef-BSD-5-Clause-Nordic
 */

#include <assert.h>
#include <zephyr/types.h>
#include "dfe_local_config.h"
#include "iq_samples_statistics.h"

/** @brief Number of wave periods in reference data */
#define PERIODS_NUM_IN_REF 2

#define MODULE ant_iq_stats
#include <logging/log.h>
LOG_MODULE_REGISTER(MODULE, CONFIG_DF_APP_LOG_LEVEL);

/** @brief Evaluate average phase change in reference period based on difference
 * of phase in two consecutive wave periods
 *
 * The function evaluates average phase offset(or phase drift) in reference
 * period. The offset returned is an angle value in degrees. Value is an average
 * change of phase between samples (or in a samples spacing time).
 *
 * @note There is an assumption that reference data have samples from at least
 * two complete wave periods. That assumption is required by algorithm used
 * to evaluate phase offset. It is done by subtraction of phase of corresponding
 * samples in consecutive periods.
 *
 * @param[in] dfe_ref_samples	IQ samples from reference period
 * @param[in] samples_in_period	Number of samples in single wave period
 *
 * @return Average phase offset in degrees
 */
static float eval_avg_phase_offset_in_ref_period_comp(const struct dfe_ref_samples *ref_data,
						      int samples_in_period)
{
	assert((ref_data->samples_num % samples_in_period) == 0);

	float phase1, phase2, diff;
	float temp_sum = 0.0;

	for (int idx = 0; idx < samples_in_period; ++idx) {
		phase1 = eval_sample_phase(ref_data->data[idx]);
		phase2 = eval_sample_phase(ref_data->data[idx + samples_in_period]);

		diff = phase1 - phase2;
		diff = wrapp_phase_around_pi(diff);

		temp_sum += diff;
	}

	float avg_phase_diff = temp_sum/(float)samples_in_period;

	/* change RAD to DEG */
	avg_phase_diff = rad_to_deg(avg_phase_diff);
	return avg_phase_diff;
}

/** @brief Evaluate average phase change in reference period based on phase
 * differences between consecutive samples.
 *
 * The function evaluates average phase offset error. The error is a difference
 * between actual phase offset of consecutive samples and ideal phase offset
 * evaluated for a given frequency. *
 *
 * @param[in] dfe_ref_samples		IQ samples from reference period
 * @param[in] frequency			Expected ideal frequency in Hz
 * @param[in] samples_spacign_ns	Time delay between consecutive samples in nanoseconds
 *
 * @return Average phase offset in degrees
 */
static float eval_avg_phase_offset_in_ref_samples_diff(const struct dfe_ref_samples *ref_data,
						       float frequency, u16_t samples_spacing_ns)
{
	assert(ref_data != NULL);
	assert(frequency != 0);
	assert(samples_spacing_ns != 0);

	float phase1, phase2, diff;
	float temp_sum = 0.0;
	float expected_phase_diff;

	expected_phase_diff = get_expected_phase_offset(frequency, samples_spacing_ns);

	for (int idx = 0; idx < ref_data->samples_num-1; ++idx) {
		phase1 = eval_sample_phase(ref_data->data[idx]);
		phase2 = eval_sample_phase(ref_data->data[idx+1]);

		diff = phase2 - phase1;
		diff = wrapp_phase_around_pi(diff);

		if (diff < expected_phase_diff)
			diff = expected_phase_diff - diff;
		else
			diff = diff - expected_phase_diff;

		temp_sum += diff;
		LOG_DBG("Ref sample phase diff: %.3f\r\n", rad_to_deg(diff));
	}

	float avg_phase_diff = temp_sum/(float)ref_data->samples_num;

	/* change RAD to DEG */
	avg_phase_diff = avg_phase_diff * 180.0f/M_PI;
	return avg_phase_diff;
}

/** @brief Evaluate average magnitude in reference period
 *
 * @param[in] dfe_ref_samples	IQ samples from reference period
 *
 * @return Evaluated average magnitude value
 */
static float eval_avg_magnitude_in_ref(const struct dfe_ref_samples *ref_data)
{
	assert(ref_data != NULL);

	float temp_mag_sum = 0.0;

	for (int idx = 0; idx < ref_data->samples_num; ++idx) {
		temp_mag_sum += eval_sample_magnitude(ref_data->data[idx]);
	}

	return temp_mag_sum/ref_data->samples_num;
}

void evaluate_stats_in_ref(const struct dfe_ref_samples* ref_samples,
			   const struct dfe_sampling_config* sampl_conf,
			   u32_t frequency,
			   float *avg_phase_off_sampl,
			   float *avg_phase_off_periods,
			   float *avg_mag)
{
	assert(ref_samples != NULL);
	assert(sampl_conf != NULL);
	assert(avg_phase_off_sampl != NULL);
	assert(avg_phase_off_periods != NULL);
	assert(avg_mag != NULL);

	float avg_value;
	u16_t samples_spacing_ns = dfe_get_sample_spacing_ref_ns(sampl_conf->sample_spacing_ref);
	u8_t samples_in_period = dfe_get_ref_samples_num(sampl_conf) / PERIODS_NUM_IN_REF;

	avg_value = eval_avg_phase_offset_in_ref_samples_diff(ref_samples, frequency, samples_spacing_ns);
	*avg_phase_off_sampl = avg_value;
	avg_value = eval_avg_phase_offset_in_ref_period_comp(ref_samples, samples_in_period);
	*avg_phase_off_periods = avg_value;
	*avg_mag = eval_avg_magnitude_in_ref(ref_samples);
}
```

## src/iq_samples_statistics.h
```c
/*
 * Copyright (c) 2020 Nordic Semiconductor ASA
 *
 * SPDX-License-Identifier: LicenseRef-BSD-5-Clause-Nordic
 */
#ifndef DF_IQ_SAMPLES_STATISTICS_H_
#define DF_IQ_SAMPLES_STATISTICS_H_

#include <complex.h>
#include <math.h>
#include "dfe_samples_data.h"

#ifndef M_PI
/** PI constant */
#define M_PI		3.14159265358979323846
#endif

/** @brief An alias for 360 degree */
#define FULL_ANGLE 360.0
/** @brief Multiplier to change nanosecond to seconds */
#define NS_TO_SEC_MULT (1.0e-9)

/** @brief Evaluates phase of a IQ sample
 *
 * @param[in] iq_sample IQ representation of a sample
 *
 * @return Value of a phase
 */
static inline float eval_sample_phase(union dfe_iq_f iq_sample)
{
	float complex complex_sample;

	complex_sample = iq_sample.i + iq_sample.q*I;
	return cargf(complex_sample);
}

/** @brief Evaluates magnitude of a IQ sample
 *
 * @param[in] iq_sample IQ representation of a sample
 *
 * @return Value of a magnitude
 */
static inline float eval_sample_magnitude(union dfe_iq_f iq_sample)
{
	return cabs(iq_sample.i + iq_sample.q*I);
}

/** @brief Wrap phase angles if exceed PI or -PI
 *
 * @param[in] phase	Value in radians to be wrapped
 *
 * @return Wrapped phase value in RAD
 */
static inline float wrapp_phase_around_pi(float phase)
{
	if( phase > M_PI ) {
		do {
			phase -= 2.0f * M_PI;
		} while( phase > M_PI );
	}
	if (phase < -M_PI ) {
		do {
			phase += 2.0f * M_PI;
		} while (phase < -M_PI );
	}

	return phase;
}

/** @brief Wrap phase angles if exceed 180 or -180 degrees
 *
 * @param[in] phase	Value in degrees to be wrapped
 *
 * @return Wrapped phase value in degrees
 */
static inline float wrapp_phase_around_180(float phase)
{
	if( phase > 180.0 ) {
		do {
			phase -= 360;
		} while( phase > 180.0 );
	}
	if (phase < -180 ) {
		do {
			phase += 360;
		} while( phase < -180.0 );
	}

	return phase;
}

/** @brief Converts angle values from radians to degrees
 *
 * @param[in] rad	Angle value in radians
 *
 * @return Angle value in degrees
 */
static inline float rad_to_deg(float rad) {
	return rad * 180 / M_PI;
}

/** @brief Converts angle values from degrees to radians
 *
 * @param[in] rad	Angle value in degrees
 *
 * @return Angle value in radians
 */
static inline float deg_to_rad(float rad) {
	return rad * M_PI / 180.0;
}

/** @brief Evaluates expected phase diff for a weve with given frequency and
 * samples spacing
 *
 * @param[in] frequency				Frequency in Hz
 * @param[in] samples_spacing_ns	Spacing between consecutive samples in nanoseconds
 *
 * @return Angle value in radians
 */
static inline float get_expected_phase_offset(float frequency, u16_t samples_spacing_ns)
{
	float expected_phase_diff;

	expected_phase_diff = FULL_ANGLE / ((1.0f/frequency) / (samples_spacing_ns * NS_TO_SEC_MULT));
	expected_phase_diff = deg_to_rad(expected_phase_diff);
	return expected_phase_diff;
}
/** @brief Evaluates statistics for IQ data in reference period
 *
 * Evaluates following statistic for reference IQ samples:
 * - average average phase offset per sample
 * - average magnitude
 *
 * @param[in] ref_samples				Pointer to reference period data
 * @param[in] sampl_conf 				Pointer to sampling configuration
 * @param[in] frequency					Expected ideal frequency in Hz
 * @param[out] avg_phase_off_sampl		Pointer to return evaluated average phase based
 * 										on phase difference of consecutive samples
 * @param[out] avg_phase_off_periods	Pointer to return evaluated average phase based
 * 										on phase difference of consecutive periods
 * @param[out] avg_mag					Pointer to return evaluated average magnitude
 */
void evaluate_stats_in_ref(const struct dfe_ref_samples* ref_samples,
						   const struct dfe_sampling_config* sampl_conf,
						   u32_t frequency,
						   float *avg_phase_ofF_sampl,
						   float *avg_phase_off_periods,
						   float *avg_mag);

#endif /* DF_IQ_SAMPLES_STATISTICS_H_ */
```
