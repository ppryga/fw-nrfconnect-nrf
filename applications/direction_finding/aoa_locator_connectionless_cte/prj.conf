## CMakeLists.txt
```
# SPDX-License-Identifier: Apache-2.0

cmake_minimum_required(VERSION 3.13.1)
set(ZEPHYR_TOOLCHAIN_VARIANT gnuarmemb)
set(ZEPHYR_BASE ../../zephyr)
include($ENV{ZEPHYR_BASE}/cmake/app/boilerplate.cmake NO_POLICY_SCOPE)
project("aoa_locator_cl" VERSION 0.1)

set(NRF_SUPPORTED_BUILD_TYPES
  ZDebug
  ZRelease
  )

if (NOT CMAKE_BUILD_TYPE)
  set(CMAKE_BUILD_TYPE ZDebug)
endif()

zephyr_compile_definitions(
   ARM_MATH_CM4
)

zephyr_include_directories(
    .
 )

#FILE(GLOB_RECURSE app_sources src/*.c)
#target_sources(app PRIVATE ${app_sources})
target_sources(app PRIVATE src/main.c
	src/if.c
	src/protocol.c
	src/ble.c
	src/dfe_local_config.c
)

target_include_directories(app PRIVATE $ENV{ZEPHYR_BASE}/samples/bluetooth)
target_include_directories(app PRIVATE $ENV{ZEPHYR_BASE}/subsys/bluetooth/controller)
```

## Kconfig
```
#
# Copyright (c) 2018 Nordic Semiconductor ASA
#
# SPDX-License-Identifier: LicenseRef-BSD-5-Clause-Nordic
#

menu "Aoa Locator Connection Less CTE"

config AOA_LOCATOR_UART_PORT
	string "Name of the UART port"
	default "UART_0"

choice
	prompt "CTE sampling configuration type"
	default AOA_LOCATOR_REGULAR_CTE
	help
	  Select type of configuration used for CTE sampling:
	  the one that comply with Bluetooth specification,
	  or Nordics proprietary that uses Noridcs radio oversampling
	  feature.

config AOA_LOCATOR_REGULAR_CTE
	bool "Enable regular sampling of CTE"
	help
	  Enables configuration that provides sampling settings
	  that are allowed by BT specification. It is 1us sample
	  spacing for reference period and 1us sample spacing for
	  sampling period.

config AOA_LOCATOR_OVERSAMPLING_CTE
	bool "Enable Oversampling of CTE" 
	help
	  Enables configuration that provides oversampling settings
	  for CTE. The reference perios samples spacing is set to 
	  250ns. Antenna switching period sample spacing is 250ns.
endchoice

endmenu

menu "Zephyr Kernel"
source "$ZEPHYR_BASE/Kconfig.zephyr"
endmenu
```

## prj.conf
```kconfig
# General Kernel Options
CONFIG_MAIN_STACK_SIZE=2048
CONFIG_HEAP_MEM_POOL_SIZE=2048
CONFIG_SYSTEM_WORKQUEUE_STACK_SIZE=2048
CONFIG_NEWLIB_LIBC=y
CONFIG_DEBUG=y
CONFIG_DEBUG_OPTIMIZATIONS=y

# BT options
CONFIG_BT=y
CONFIG_BT_OBSERVER=y
CONFIG_BT_DEBUG_LOG=y
CONFIG_BT_CTLR=y
CONFIG_BT_LL_SW_LEGACY=y
CONFIG_BT_CTLR_DF_SUBSYSTEM=y

# Uart driver and UART configuration
CONFIG_SERIAL=y
CONFIG_UART_0_NRF_UART=y
CONFIG_UART_INTERRUPT_DRIVEN=y

# Enable the Direction finding subsystem
CONFIG_BT_CTLR_DF_SUBSYSTEM=y
# Enable receive of CTE(DFE) extension by Bluetooth stack
CONFIG_BT_CTLR_DFE_RX=y
# Enable sample spacing that comply with Bluetooth specification
CONFIG_AOA_LOCATOR_REGULAR_CTE=y
```

## src/main.c
```c
/*
 * Copyright (c) 2020 Nordic Semiconductor ASA
 *
 * SPDX-License-Identifier: LicenseRef-BSD-5-Clause-Nordic
 */

#include <assert.h>
#include <string.h>

#include <kernel.h>
#include <zephyr/types.h>
#include <misc/printk.h>
#include <bluetooth/dfe_data.h>

#include "if.h"
#include "protocol.h"
#include "dfe_local_config.h"
#include "ble.h"

/*number of loops to to avid when printing */
#define MAIN_LOOP_NO_MSG_COUNT (1000)

extern struct k_msgq df_packet_msgq;

void main(void)
{
	printk("Starting AoA Locator CL!\r\n");
	/* initialize UART interface to provide I/Q samples */
	struct if_data* iface = if_initialization();

	if (iface == NULL) {
		printk("Locator stopped!\r\n");
		return;
	}

	int err;

	err = protocol_initialization(iface);
	if (err) {
		printk("Locator stopped!\r\n");
		return;
	}

	const struct df_sampling_config* sampl_conf = NULL;
	const struct df_antenna_config* ant_conf = NULL;
	const struct dfe_ant_gpio* ant_gpio = NULL;
	u8_t ant_gpio_len = 0;

	sampl_conf = df_get_sampling_config();
	ant_conf = df_get_antenna_config();
	ant_gpio_len = dfe_get_ant_gpios_config_len();
	dfe_get_ant_gpios_config(&ant_gpio);

	assert(sampl_conf != NULL);
	assert(ant_conf != NULL);
	assert(ant_gpio != NULL);
	assert(ant_gpio_len != 0);

	printk("Initialize DFE\r\n");
	err = dfe_init(sampl_conf, ant_conf, ant_gpio, ant_gpio_len);
	if (err) {
		printk("Locator stopped!\r\n");
		return;
	}

	printk("Initialize Bluetooth\r\n");
	ble_initialization();

	while(1)
	{
		static bool no_data = false;
		static struct df_packet df_data_packet;
		static struct dfe_mapped_packet df_data_mapped;

		memset(&df_data_packet, 0, sizeof(df_data_packet));
		memset(&df_data_mapped, 0, sizeof(df_data_mapped));
		k_msgq_get(&df_packet_msgq, &df_data_packet, K_NO_WAIT);
		if (df_data_packet.hdr.length != 0) {
			no_data = false;
			printk("\r\nData arrived...\r\n");

			df_map_iq_samples_to_antennas(&df_data_mapped,
						      &df_data_packet,
						      sampl_conf, ant_conf);
			err = protocol_handling(sampl_conf, &df_data_mapped);
			if (err) {
				printk("Error in protocol handling!\r\n");
				printk("Locator stopped!\r\n");
				return;
			}
		}
		else
		{
			static u16_t counter = 0;
			if(!no_data) {
				no_data = true;
				if (counter <= MAIN_LOOP_NO_MSG_COUNT) {
					++counter;
				} else {
					printk("\r\nNo data received.");
					counter = 0;
				}
			} else {
				counter = 0;
			}
		}
	 	k_sleep(K_MSEC(1));
	}
}
```

## src/ble.c
```c
#include <misc/printk.h>
#include <bluetooth/bluetooth.h>
#include <bluetooth/hci.h>

#include "ble.h"


int BLE_Initialization(void)
{
	struct bt_le_scan_param scan_param = {
		.type       = BT_HCI_LE_SCAN_PASSIVE,
		.filter_dup = BT_HCI_LE_SCAN_FILTER_DUP_DISABLE,
		.interval   = 0x0020,
		.window     = 0x0020,
	};
	int err;

	printk("[BT] Initialization started\r\n");

	err = bt_enable(NULL);
	if (err)
	{
		printk("[BT] Initialization failed (err %d)\r\n", err);
		return err;
	}

	printk("[BT] Starting scanning\r\n");
	err = bt_le_scan_start(&scan_param, NULL);
	if (err)
	{
		printk("[BT] Start scanning failed (err %d)\n", err);
		return err;
	}
	return 0;
}
```

## src/ble.h
```c
#ifndef __BLE_H
#define __BLE_H

int BLE_Initialization();

#endif
```

## src/dfe_local_config.c
```c
/*
 * Copyright (c) 2020 Nordic Semiconductor ASA
 *
 * SPDX-License-Identifier: LicenseRef-BSD-5-Clause-Nordic
 */

#include <stddef.h>
#include <stdbool.h>
#include <assert.h>
#include <zephyr/types.h>
#include <kernel.h>
#include <nrf.h>

#include "dfe_local_config.h"

const static struct df_sampling_config g_sampl_config = {
	.dfe_mode = RADIO_DFEMODE_DFEOPMODE_AoA,
	.start_of_sampl = RADIO_DFECTRL1_DFEINEXTENSION_CRC,
	.number_of_8us = 5,
	.en_sampling_on_crc_error = false,
	.dfe_trigger_task_only = true,
	.sampling_type = RADIO_DFECTRL1_SAMPLETYPE_IQ,
#if defined(CONFIG_AOA_LOCATOR_REGULAR_CTE)
	.sample_spacing_ref = RADIO_DFECTRL1_TSAMPLESPACINGREF_1us,
	.sample_spacing = RADIO_DFECTRL1_TSAMPLESPACING_1us,
#elif defined(CONFIG_AOA_LOCATOR_OVERSAMPLING_CTE)
	.sample_spacing_ref = RADIO_DFECTRL1_TSAMPLESPACINGREF_250ns,
	.sample_spacing = RADIO_DFECTRL1_TSAMPLESPACING_250ns,
#else
#error "Missing configuration of CTE sampling."
#endif
	.sample_offset = 1,
	.switch_spacing = RADIO_DFECTRL1_TSWITCHSPACING_2us,
	.switch_offset = 0,
	.guard_period_us = 4,
	.ref_period_us = 8,
};

const static struct df_antenna_config g_ant_conf = {
		.ref_ant_idx = 11,
		.idle_ant_idx = 11,
		.ant_gpio_pattern = {0, 5, 6, 4, 9, 10, 8, 13, 14, 12, 1, 2, 0},
		.ant_gpio_pattern_len = 13,
		.antennae_switch_idx = {12,1,2,10,3,9,4,8,7,6,5},
		.antennae_switch_idx_len = 11,
		.gpio = {3,4,28,29},
	};

const static struct dfe_ant_gpio g_gpio_conf[4] = {
		{0, 3}, {1,4}, {2, 28}, {3,29}
};

static int create_switching_pattern_array(u8_t *array, u8_t len,
		const u8_t *gpio_patterns, u8_t gpio_patterns_len,
		const u8_t *switch_array, u8_t switch_array_len);
static u32_t get_switching_duration_ns(const struct df_sampling_config *sampling_conf);
static u16_t get_switch_period_samples_num(const struct df_sampling_config *sampling_conf);
static uint8_t get_effective_ant_num(const struct df_sampling_config *sampling_conf);
static u16_t get_switch_spacing_ns(u8_t spacing);
static u16_t get_ref_samples_num(const struct df_sampling_config* sampling_conf);
static u16_t get_sampling_slot_samples_num(const struct df_sampling_config *sampling_conf);
static inline bool is_oversampling_enabled(const struct df_sampling_config *sampling_conf);

const struct df_sampling_config* df_get_sampling_config()
{
	return &g_sampl_config;
}

const struct df_antenna_config* df_get_antenna_config()
{
	return &g_ant_conf;
}

void dfe_get_ant_gpios_config(const struct dfe_ant_gpio** ant_gpio)
{
	assert(ant_gpio != NULL);
	*ant_gpio = &g_gpio_conf[0];
}

u8_t dfe_get_ant_gpios_config_len()
{
	return ARRAY_SIZE(g_gpio_conf);
}

int dfe_init(const struct df_sampling_config *sampl_conf,
	     const struct df_antenna_config *ant_conf,
	     const struct dfe_ant_gpio *ant_gpio, u8_t ant_gpio_len)
{
	assert(sampl_conf != NULL);
	assert(ant_conf != NULL);
	assert(ant_gpio != NULL);
	assert(ant_gpio_len != 0);

	int err = 0;

	err = dfe_set_mode(sampl_conf->dfe_mode);
	if (err) {
		printk("[DFE] - DFE mode is unknown\n");
		return -EINVAL;
	}

	err = dfe_set_duration(sampl_conf->number_of_8us);
	if(err) {
		printk("Error! Number of 8us periods is out of allowed range!\r\n");
		return err;
	}

	err = dfe_set_start_point(sampl_conf->start_of_sampl);
	if(err) {
		printk("Error! DFE start point value is out of allowed range!\r\n");
		return err;
	}

	dfe_set_sample_on_crc_error(sampl_conf->en_sampling_on_crc_error);

	dfe_set_trig_dfe_start_task_only(true);

	err = dfe_set_sampling_spacing_ref(sampl_conf->sample_spacing_ref);
	if(err) {
		printk("Error! Reference sample spacing value is out of range!\r\n");
		return err;
	}
	err = dfe_set_sampling_type(sampl_conf->sampling_type);
	if(err) {
		printk("Error! Sampling type value is out of range!\r\n");
		return err;
	}
	err = dfe_set_sample_spacing(sampl_conf->sample_spacing);
	if(err) {
		printk("Error! Sample spacing value is out of range!\r\n");
		return err;
	}
	err = dfe_set_backoff_gain(0);
	if(err) {
		printk("Error! Gain backoff value is out of range!\r\n");
		return err;
	}
	err = dfe_set_switch_offset(sampl_conf->switch_offset);
	if(err) {
		printk("Error! Switch offset value is out of range!\r\n");
		return err;
	}
	err = dfe_set_sample_offset(sampl_conf->sample_offset);
	if(err) {
		printk("Error! Sampling offset value is out of range!\r\n");
		return err;
	}

	err = dfe_set_ant_switch_spacing(sampl_conf->switch_spacing);
	if(err) {
		printk("Error! Antenna switch spacing is out of range!\r\n");
		return err;
	}

	err = dfe_set_ant_gpios(ant_gpio, ant_gpio_len);
	if(err) {
		printk("Error! Number of GPIO for antennas switching is to large!\r\n");
		return err;
	}

	u8_t pattern_array[ant_conf->antennae_switch_idx_len];
	err = create_switching_pattern_array(pattern_array,
				       ant_conf->antennae_switch_idx_len,
				       ant_conf->ant_gpio_pattern,
				       ant_conf->ant_gpio_pattern_len,
				       ant_conf->antennae_switch_idx,
				       ant_conf->antennae_switch_idx_len);
	if(err) {
		printk("Error! Preparation of switch patterns array failed!\r\n");
		return err;
	}

	err = dfe_set_ant_gpio_patterns(ant_conf->ant_gpio_pattern[ant_conf->idle_ant_idx],
					ant_conf->ant_gpio_pattern[ant_conf->ref_ant_idx],
					pattern_array,
					ant_conf->antennae_switch_idx_len);
	if(err) {
		printk("Error! Initialization of gpio patterns failed!\r\n");
		return err;
	}
	return 0;
}

int df_map_iq_samples_to_antennas(struct dfe_mapped_packet *mapped_data,
				  const struct df_packet *raw_data,
				  const struct df_sampling_config *sampling_conf,
				  const struct df_antenna_config *ant_config)
{
	assert(raw_data != NULL);
	assert(mapped_data != NULL);

	u16_t ref_samples_num = get_ref_samples_num(sampling_conf);
	mapped_data->ref_data.antenna_id = ant_config->ref_ant_idx;

	for(uint16_t idx = 0; idx < ref_samples_num; ++idx) {
		mapped_data->ref_data.data[idx].i = raw_data->data[idx].iq.i;
		mapped_data->ref_data.data[idx].q = raw_data->data[idx].iq.q;
	}
	mapped_data->ref_data.samples_num = ref_samples_num;

	/* Depending on DFE duration, the number of antennas used for sample
	 * may be greater than the number of antennas in configuration.
	 * If there is time left after end of antennas sequence, then radio
	 * starts to use the same antennas again.
	 */
	u16_t effective_ant_num = get_effective_ant_num(sampling_conf);

	u8_t samples_num = get_sampling_slot_samples_num(sampling_conf);

	u8_t effective_sample_idx;

	bool oversampl = is_oversampling_enabled(sampling_conf);

	if (oversampl) {
		effective_ant_num = (effective_ant_num*2);
	}

	for(u16_t ant_idx = 0; ant_idx < effective_ant_num; ++ant_idx) {
		u8_t ant;
		struct dfe_samples *sample = &mapped_data->sampl_data[ant_idx];

		if (oversampl) {
			if (ant_idx & 0x1) {
				ant = 255;
			} else {
				u8_t idx = (ant_idx >> 1) % ant_config->antennae_switch_idx_len;
				ant = ant_config->antennae_switch_idx[idx];
			}
		} else {
			u8_t idx = ant_idx % ant_config->antennae_switch_idx_len;
			ant = ant_config->antennae_switch_idx[idx];
		}

		sample->antenna_id = ant;

		for(u8_t sample_idx = 0; sample_idx < samples_num; ++sample_idx) {
			effective_sample_idx = ref_samples_num + (ant_idx * samples_num) + sample_idx;
			sample->data[sample_idx].i = raw_data->data[effective_sample_idx].iq.i;
			sample->data[sample_idx].q = raw_data->data[effective_sample_idx].iq.q;
		}
		sample->samples_num = samples_num;
	}

	mapped_data->header.length = effective_ant_num;
	mapped_data->header.frequency = raw_data->hdr.frequency;
	return 0;
}


static int create_switching_pattern_array(u8_t *array, u8_t len,
					  const u8_t *gpio_patterns,
					  u8_t gpio_patterns_len,
					  const u8_t *switch_array,
					  u8_t switch_array_len)
{

	if (array == NULL || len == 0 || gpio_patterns == NULL ||
	    gpio_patterns_len == 0 || switch_array == NULL ||
	    switch_array_len == 0 || len < switch_array_len) {
		return -EINVAL;
	}

	for (u8_t idx = 0; idx < switch_array_len; ++idx) {
		if (switch_array[idx] >= gpio_patterns_len)
			return -ERANGE;
	}

	for (u8_t idx = 0; idx < len; ++idx) {
		array[idx] = gpio_patterns[switch_array[idx]];
	}

	return 0;
}

static u32_t get_switching_duration_ns(const struct df_sampling_config *sampling_conf)
{
	assert(sampling_conf != NULL);

	u32_t swiching_duration_us = ((sampling_conf->number_of_8us * K_MSEC(8)) -
			(sampling_conf->guard_period_us + sampling_conf->ref_period_us));

	return (swiching_duration_us * K_NSEC(1000));
}

static u16_t get_switch_period_samples_num(const struct df_sampling_config *sampling_conf)
{
	assert(sampling_conf != NULL);

	u16_t sample_spacing_ns = df_get_sample_spacing_ns(sampling_conf->sample_spacing);
	u16_t swich_spacing_ns = get_switch_spacing_ns(sampling_conf->switch_spacing);
	/* Switch spacing time is a duration between antenna switch so it holds
	 * swich slot and sample slot. Because of that
	 */
	return swich_spacing_ns / sample_spacing_ns;
}

static uint8_t get_effective_ant_num(const struct df_sampling_config *sampling_conf)
{
	assert(sampling_conf != NULL);

	u32_t switching_duration_ns = get_switching_duration_ns(sampling_conf);
	u32_t switch_spacing_ns = get_switch_spacing_ns(sampling_conf->switch_spacing);

	return (uint8_t)(switching_duration_ns / switch_spacing_ns);
}

static u16_t get_switch_spacing_ns(u8_t spacing) {

	u16_t spacing_ns = 0;
	switch(spacing) {
		case 0:
			spacing_ns = K_NSEC(8000);
			break;
		case RADIO_DFECTRL1_TSWITCHSPACING_4us:
			spacing_ns = K_NSEC(4000);
			break;
		case RADIO_DFECTRL1_TSWITCHSPACING_2us:
			spacing_ns = K_NSEC(2000);
			break;
		case RADIO_DFECTRL1_TSWITCHSPACING_1us:
			spacing_ns = K_NSEC(1000);
			break;
		default:
			return -1;
	}
	return spacing_ns;
}

u16_t df_get_sample_spacing_ns(u8_t sampling)
{
	u16_t sampling_ns = 0;
	switch(sampling) {
		case RADIO_DFECTRL1_TSAMPLESPACING_4us:
			sampling_ns = K_NSEC(4000);
			break;
		case RADIO_DFECTRL1_TSAMPLESPACING_2us:
			sampling_ns = K_NSEC(2000);
			break;
		case RADIO_DFECTRL1_TSAMPLESPACING_1us:
			sampling_ns = K_NSEC(1000);
			break;
		case RADIO_DFECTRL1_TSAMPLESPACING_500ns:
			sampling_ns = K_NSEC(500);
			break;
		case RADIO_DFECTRL1_TSAMPLESPACING_250ns:
			sampling_ns = K_NSEC(250);
			break;
		case RADIO_DFECTRL1_TSAMPLESPACING_125ns:
			sampling_ns = K_NSEC(125);
			break;
		default:
			sampling_ns = -1;
	}
	return sampling_ns;
}

u16_t df_get_sample_spacing_ref_ns(u8_t sampling) {

	u16_t sampling_ns = 0;
	switch(sampling) {
		case RADIO_DFECTRL1_TSAMPLESPACINGREF_4us:
			sampling_ns = K_NSEC(4000);
			break;
		case RADIO_DFECTRL1_TSAMPLESPACINGREF_2us:
			sampling_ns = K_NSEC(2000);
			break;
		case RADIO_DFECTRL1_TSAMPLESPACINGREF_1us:
			sampling_ns = K_NSEC(1000);
			break;
		case RADIO_DFECTRL1_TSAMPLESPACINGREF_500ns:
			sampling_ns = K_NSEC(500);
			break;
		case RADIO_DFECTRL1_TSAMPLESPACINGREF_250ns:
			sampling_ns = K_NSEC(250);
			break;
		case RADIO_DFECTRL1_TSAMPLESPACINGREF_125ns:
			sampling_ns = K_NSEC(125);
			break;
		default:
			sampling_ns = -1;
	}
	return sampling_ns;
}

static u16_t get_sampling_slot_samples_num(const struct df_sampling_config *sampling_conf)
{
	assert(sampling_conf != NULL);

	u16_t sample_spacing_ns = df_get_sample_spacing_ns(sampling_conf->sample_spacing);
	u16_t swich_spacing_ns = get_switch_spacing_ns(sampling_conf->switch_spacing);
	/* Switch spacing time is a duration between antenna switch so it holds
	 * swich slot and sample slot. Because of that in case of over sampling
	 * we take as valid samples only half of them. In case sampling duration
	 * is greater or equal all samples are valid.
	 * of
	 */
	assert(sample_spacing_ns != 0);

	if (swich_spacing_ns > sample_spacing_ns) {
		return swich_spacing_ns / (sample_spacing_ns * 2);
	} else {
		return sample_spacing_ns / sample_spacing_ns;
	}
}

static u16_t get_ref_samples_num(const struct df_sampling_config* sampling_conf)
{
	assert(sampling_conf != NULL);

	u16_t sample_spacing_ns = df_get_sample_spacing_ref_ns(sampling_conf->sample_spacing_ref);
	return sampling_conf->ref_period_us * K_NSEC(1000) / sample_spacing_ns;
}

static inline bool is_oversampling_enabled(const struct df_sampling_config *sampling_conf)
{
	assert(sampling_conf != NULL);

	if (sampling_conf->switch_spacing > sampling_conf->sample_spacing) {
		return false;
	} else {
		return true;
	}
}

u16_t df_delay_before_first_sampl(const struct df_sampling_config* sampling_conf)
{
	assert(sampling_conf != NULL);

	u16_t swich_spacing_ns = get_switch_spacing_ns(sampling_conf->switch_spacing);
	u16_t ref_spacing_ns = df_get_sample_spacing_ref_ns(sampling_conf->sample_spacing_ref);

	assert(swich_spacing_ns != 0);
	return (swich_spacing_ns >> 1) + ref_spacing_ns;
}
```

## src/dfe_local_config.h
```c
/*
 * dfe_config.h
 *
 *  Created on: Feb 20, 2020
 *      Author: ppryga
 */

#ifndef SRC_DFE_LOCAL_CONFIG_H_
#define SRC_DFE_LOCAL_CONFIG_H_

#include <bluetooth/dfe_config.h>
#include <bluetooth/dfe_data.h>
#include "dfe_samples_data.h"

#define K_NSEC(ns)	(ns)

struct df_antenna_config{
	/* Index of antenna used for reference period */
	u8_t ref_ant_idx;
	/* Index of antenna used at start of CTE and after end of CTE
	 * (suggested to use the same antenna as for ref period) */
	u8_t idle_ant_idx;
	/* The array stores values that should be set to GPIO to enable antenna
	 * with given index. The index of the particular value is the antenna
	 * number. Single bit of the value is set as a value for signle GPIO pin. */
	u8_t ant_gpio_pattern[16];
	u8_t ant_gpio_pattern_len;
	/* Array stores indices of antennas to be enabled in particular switch state.
	 * The array does not include reference period antenna and idle antenna. */
	u8_t antennae_switch_idx[48];
	u8_t antennae_switch_idx_len;
	/* GPIOS used to switch antennae. */
	u32_t gpio[8];
};


struct df_sampling_config {
	/* Mode of DFE, currently we support on AoA */
	u8_t dfe_mode;
	/* Start point when CTE is added and start point when switching/sampling
	 * is done: after CRC, during packet payload */
	u8_t start_of_sampl;
	/* Length of AoA/AoD procedure in number of 8[us] */
	u8_t number_of_8us;
	/* Process sampling even if CRC error occurs */
	bool en_sampling_on_crc_error;
	/* Limits start DFE to be triggered by TASKS_DFESTART only */
	bool dfe_trigger_task_only;
	/* Type of samples: I/Q or magnitude/phase */
	u8_t sampling_type;
	/* Interval between samples in REFERENCE period */
	u8_t sample_spacing_ref;
	/* Interval between samples in SWITCH period */
	u8_t sample_spacing;
	/* Time delay relative to beginning of reference period before starting
	 * sampling, number of 16M cycles ? */
	s16_t sample_offset;
	/* Time between consecutive antenna switches in SWITCH period of CTE */
	u16_t switch_spacing;
	/* Time delay after end of CRC before starting switching, number of 16M cycles */
	s16_t switch_offset;
	/* length of guard period - BT defines that to be 4[us] */
	u8_t guard_period_us;
	/* length of reference period - BT defines that to be 8[us] */
	u8_t ref_period_us;
};

const struct df_sampling_config *df_get_sampling_config();
const struct df_antenna_config *df_get_antenna_config();
void dfe_get_ant_gpios_config(const struct dfe_ant_gpio **ant_gpio, u8_t *len);

int dfe_init(const struct df_sampling_config *sampl_conf,
	     const struct df_antenna_config *ant_conf,
	     const struct dfe_ant_gpio *ant_gpio, u8_t ant_gpio_len);

int df_map_iq_samples_to_antennas(struct dfe_mapped_packet *mapped_data,
				  const struct df_packet *raw_data,
				  const struct df_sampling_config *sampling_conf,
				  const struct df_antenna_config *ant_config);
u16_t df_delay_before_first_sampl(const struct df_sampling_config* sampling_conf);
u16_t df_get_sample_spacing_ns(u8_t sampling);
u16_t df_get_sample_spacing_ref_ns(u8_t sampling);
#endif /* SRC_DFE_LOCAL_CONFIG_H_ */
```

## src/dfe_samples_data.h
```c
#ifndef SRC_DFE_SAMPLES_DATA_H_
#define SRC_DFE_SAMPLES_DATA_H_

#include <stdint.h>

struct dfe_header {
	uint32_t length;
	uint32_t frequency;
} __attribute__((packed));

union dfe_iq_f {
	struct {
		float i; //12bit
		float q; //12bit
	};
	float data[2];
} __attribute__((packed));

/* Max length of SWITH PERIOD supported by our radio is 8us.
 * Smallest samples spacing is 125ns.
 * Max total number of gathered samples is 32 (that includes only sampling slots)
 */
#define DF_SAMPLES_COUNT (32)

struct dfe_samples {
	union dfe_iq_f data[DF_SAMPLES_COUNT];
	uint8_t samples_num;
	uint8_t antenna_id;
} __attribute__((packed));

/* This is a fixed value for reference period duration 8us and min sampling
 * spacing 125ns.
 */
#define DF_REF_SAMPLES_COUNT (64)

struct dfe_ref_samples {
	union dfe_iq_f data[DF_REF_SAMPLES_COUNT];
	uint8_t samples_num;
	uint8_t antenna_id;
} __attribute__((packed));


/* Max length of CTE is 160us. With removed guard period(4us) and reference period(8us)
 * we have 148us. Smallest reasonable antenna switching period is 2us.
 * That gives us up to 74 samples set per antenna.
 */
#define DF_MAX_EFFECTIVE_ANT_COUNT (32)
struct dfe_mapped_packet {
	struct dfe_header header;
	struct dfe_ref_samples ref_data;
	struct dfe_samples sampl_data[DF_MAX_EFFECTIVE_ANT_COUNT];
} __attribute__((packed));

#endif /* SRC_DFE_SAMPLES_DATA_H_ */
```

## src/if.c
```c
#include <errno.h>
#include <device.h>
#include <uart.h>

#include "if.h"

static struct if_data g_if;
static void if_uart_app_isr(struct device *dev);
static void uart_send(uint8_t *buffer, uint16_t length);

struct if_data *IF_Initialization(void)
{
	g_if.uart_app.dev = device_get_binding(CONFIG_AOA_LOCATOR_UART_PORT);
	if (!g_if.uart_app.dev) {
		printk("[UART] - Device not found or cannot be used\r\n");
		return NULL;
	}

	uart_irq_rx_disable(g_if.uart_app.dev);
	uart_irq_tx_disable(g_if.uart_app.dev);
	uart_irq_callback_set(g_if.uart_app.dev, if_uart_app_isr);
	uart_irq_rx_enable(g_if.uart_app.dev);
	k_sleep(K_MSEC(100));

	g_if.uart_app.send = uart_send;

	return &g_if;
}

static void if_uart_app_isr(struct device *dev)
{
	struct device_vector *uart = &g_if.uart_app;
	uint16_t i = 0;
	uint16_t index = 0;
	char buffer[255] = {0};

	while (uart_irq_update(dev) && uart_irq_is_pending(dev))
	{
		if (!uart_irq_rx_ready(dev))
		{
			if (uart_irq_tx_ready(dev))
			{
				printk("[UART] - transmit ready");
			}
			else
			{
				printk("[UART] - spurious interrupt");
			}

			break;
		}

		index = uart_fifo_read(dev, buffer, sizeof(buffer)-1);

		for(i=0; i<index; i++)
		{
			uart->rx_buffer[uart->rx_index] = buffer[i];

			if (++uart->rx_index == sizeof(uart->rx_buffer))
			{
				uart->rx_index = 0;
			}
		}
	}
}

static void uart_send(uint8_t *buffer, uint16_t length)
{
	struct device_vector *uart = &g_if.uart_app;

	size_t i = 0;

	for(i=0; i<length; i++)
	{
		uart_poll_out(uart->dev, buffer[i]);
	}
}
```

## src/if.h
```c
#ifndef __IF_H
#define __IF_H

#define IF_BUFFER_SIZE		2048

struct device;

struct device_vector
{
	struct device *dev;
	uint8_t rx_buffer[IF_BUFFER_SIZE];
	uint8_t tx_buffer[IF_BUFFER_SIZE];
	uint16_t rx_index;
	uint16_t tx_index;

	void (*send)(uint8_t *, uint16_t);
};

struct if_data
{
	struct device_vector uart_app;
};

struct if_data* IF_Initialization(void);

#endif
```

## src/protocol.c
```c
#include <stddef.h>
#include <stdio.h>
#include <string.h>
#include <errno.h>
#include <assert.h>

#include <misc/printk.h>

#include "protocol.h"
#include "if.h"

#define SAMPLING_TIME_UNIT (125) //smallest possible time between samples [ns]

static struct protocol_data g_protocol_data;

static uint16_t protocol_convert_to_string(const struct df_sampling_config* sampl_conf,
					   const struct dfe_mapped_packet *mapped_data,
					   char *buffer, uint16_t length);

int PROTOCOL_Initialization(struct if_data* iface)
{
	if (iface == NULL) {
		printk("[PROTOCOL] - iface is NULL, cannot initialize\r\n");
		return -EINVAL;
	}

	g_protocol_data.uart = &iface->uart_app;
	return 0;
}

int PROTOCOL_Handling(const struct df_sampling_config *sampl_conf,
		      const struct dfe_mapped_packet *mapped_data)
{
	assert(sampl_conf != NULL);
	assert(mapped_data != NULL);
	uint16_t length = 0;

	length = protocol_convert_to_string(sampl_conf, mapped_data,
					    g_protocol_data.string_packet,
					    PROTOCOL_STRING_BUFFER_SIZE);
	//printk("PROTOCOL_Handling %s\r\n",protocol->string_packet);
	g_protocol_data.uart->send(g_protocol_data.string_packet, length);

	return 0;
}

static u16_t protocol_convert_to_string(const struct df_sampling_config* sampl_conf,
					   const struct dfe_mapped_packet *mapped_data,
					   char *buffer, uint16_t length)
{
	printk("DF_BEGIN\r\n");
	u16_t strlen = sprintf(buffer, "DF_BEGIN\r\n");

	strlen += sprintf(&buffer[strlen], "SW:%d\r\n", (int)sampl_conf->switch_spacing);
	strlen += sprintf(&buffer[strlen], "RR:%d\r\n", (int)sampl_conf->sample_spacing_ref);
	strlen += sprintf(&buffer[strlen], "SS:%d\r\n", (int)sampl_conf->sample_spacing);
	strlen += sprintf(&buffer[strlen], "FR:%d\r\n", (int)mapped_data->header.frequency);

	strlen += sprintf(&buffer[strlen], "ME:%d\r\n", (int)0);
	strlen += sprintf(&buffer[strlen], "MA:%d\r\n", (int)0);
	strlen += sprintf(&buffer[strlen], "KE:%d\r\n", (int)0);
	strlen += sprintf(&buffer[strlen], "KA:%d\r\n", (int)0);

	u16_t time_u = df_get_sample_spacing_ref_ns(sampl_conf->sample_spacing_ref) / SAMPLING_TIME_UNIT;
	u16_t ref_idx;

	for(ref_idx = 0; ref_idx < mapped_data->ref_data.samples_num; ++ref_idx)
	{
		strlen += sprintf(&buffer[strlen], "IQ:%d,%d,%d,%d,%d\r\n", ref_idx,
				time_u * ref_idx,
				 (int)mapped_data->ref_data.antenna_id,
				 (int)mapped_data->ref_data.data[ref_idx].q,
				 (int)mapped_data->ref_data.data[ref_idx].i);
	}
	/* copute delay  between last sample in reference period and first sample
	 * in antenna switching period.
	 */
	u16_t delay =  df_delay_before_first_sampl(sampl_conf) / SAMPLING_TIME_UNIT;
	delay += (time_u * (ref_idx-1));
	time_u = df_get_sample_spacing_ns(sampl_conf->sample_spacing) / SAMPLING_TIME_UNIT;

	for(u16_t idx=0; idx<mapped_data->header.length; ++idx)
	{
		const struct dfe_samples* sampl_data = &mapped_data->sampl_data[idx];

		for(u16_t jdx = 0; jdx < sampl_data->samples_num; ++jdx)
		{
			u16_t idx_offset = (sampl_data->samples_num * idx) + jdx;

			strlen += sprintf(&buffer[strlen], "IQ:%d,%d,%d,%d,%d\r\n", ref_idx + idx_offset,
					delay + (idx_offset) * time_u,
					 (int)sampl_data->antenna_id,
					 (int)sampl_data->data[jdx].q,
					 (int)sampl_data->data[jdx].i);
		}
	}

	strlen += sprintf(&buffer[strlen], "DF_END\r\n");

	return strlen;
}
```

## src/protocol.h
```c
#ifndef __PROTOCOL_H
#define __PROTOCOL_H

#include <zephyr/types.h>
#include <bluetooth/dfe_data.h>
#include "dfe_local_config.h"
#include "if.h"

#define PROTOCOL_HEAD				"+AoA"
#define PROTOCOL_BUFFER_SIZE			64
#define PROTOCOL_STRING_BUFFER_SIZE		10240

struct protocol_data
{
	struct device_vector *uart;
	char string_packet[PROTOCOL_STRING_BUFFER_SIZE];
};

int PROTOCOL_Initialization(struct if_data *iface);
int PROTOCOL_Handling(const struct df_sampling_config *sampl_conf,
		      const struct dfe_mapped_packet *mapped_data);
#endif
```
